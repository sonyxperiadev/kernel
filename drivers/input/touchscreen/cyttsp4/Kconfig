## drivers/media/platform/msm/Kconfig
```kconfig
source "drivers/media/platform/msm/vidc/Kconfig"

#
# MSM camera configuration
#

comment "Qualcomm MSM Camera And Video"

menuconfig MSM_CAMERA
	bool "Qualcomm MSM camera and video capture support"
	depends on ARCH_MSM && VIDEO_V4L2 && I2C
	---help---
	  Say Y here to enable selecting the video adapters for
	  Qualcomm msm camera and video capture drivers. enabling this
	  adds support for the camera driver stack including sensor, isp
	  and postprocessing drivers for legacy chipsets.

config MSM_CAMERA_DEBUG
	bool "Qualcomm MSM camera debugging with printk"
	depends on MSM_CAMERA
	default n
	---help---
	  Enable printk() debug for msm camera

config MSM_CAMERA_AUTOMOTIVE
	bool "Qualcomm MSM camera for automotive support"
	depends on MSM_CAMERA
	default n
	---help---
	  Enables support for automotive targets

menuconfig MSMB_CAMERA
	bool "Qualcomm MSM camera and video capture 2.0 support"
	depends on ARCH_MSM && VIDEO_V4L2 && I2C
	---help---
	  Say Y here to enable selecting the video adapters for
	  Qualcomm msm camera and video capture 2.0, enabling this
	  adds support for the camera driver stack including sensor, isp
	  and postprocessing drivers.

config MSMB_CAMERA_DEBUG
	bool "Qualcomm MSM camera 2.0 debugging with printk"
	depends on MSMB_CAMERA
	---help---
	  Enable printk() debug for msm camera 2.0

choice
	prompt "Choose a MSM camera implementation"
	depends on MSMB_CAMERA

	config MSMB_CAMERA_NEWGEN
		bool "New implementation for ARM-SMMU (MSM8996 and later)"
		default y
		---help---
		  This is the new camera implementation, found in official
		  CAF kernel 3.18 releases. It supports new SoCs using the
		  ARM SMMU. Not suitable for old SoCs using QC IOMMU v1 and v2.

	config MSMB_CAMERA_LEGACY
		bool "Old implementation for QC IOMMU (Legacy SoCs)"
		---help---
		  This is the old camera implementation, found in branch
		  3.18 LAW.BR.xxx. This implementation matches the CAF
		  kernel 3.10 LA.BR.1.3.x.xxx and supports only SoC with
		  QC IOMMU v1 and v2.
endchoice

if MSMB_CAMERA
 if MSMB_CAMERA_NEWGEN
 source "drivers/media/platform/msm/camera_v2/Kconfig"
 endif # MSMB_CAMERA_NEWGEN
 if MSMB_CAMERA_LEGACY
 source "drivers/media/platform/msm/camera_v2_legacy/Kconfig"
 endif # MSMB_CAMERA_LEGACY
endif # MSMB_CAMERA
source "drivers/media/platform/msm/dvb/Kconfig"
source "drivers/media/platform/msm/broadcast/Kconfig"
source "drivers/media/platform/msm/sde/Kconfig"
```

## drivers/media/platform/msm/vidc_3x/vmem/Kconfig
```kconfig
menuconfig MSM_VIDC_3X_VMEM
	bool "Qualcomm Technologies Inc MSM VMEM driver"
	depends on ARCH_QCOM && MSM_VIDC_3X_V4L2
```
