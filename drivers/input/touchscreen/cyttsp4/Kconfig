## drivers/input/touchscreen/cyttsp4/Kconfig
```kconfig
config CYPRESS_CYTTSP4_BUS
        bool "Cypress TTSP core bus"
        default n
        help
          This option enables support Cypress TTSP core bus.
          This support is needed for various device and drivers
          using Cypress TrueTouch(TM) Standard Product
          protocol.

config TOUCHSCREEN_CYPRESS_CYTTSP4
        tristate "Cypress TrueTouch Gen4 Touchscreen Driver"
        default n
        select CYPRESS_CYTTSP4_BUS
        help
          Core driver for Cypress TrueTouch(tm) Standard Product
          Geneartion4 touchscreen controllers.

          Say Y here if you have a Cypress Gen4 touchscreen.

          If unsure, say N.

          To compile this driver as a module, choose M here.

config TOUCHSCREEN_CYPRESS_CYTTSP4_DEVICETREE_SUPPORT
        bool "Enable Device Tree support"
        default n
        depends on TOUCHSCREEN_CYPRESS_CYTTSP4 && OF
        help
          This option enables support for device tree.

          Say Y here to enable device tree support.

config TOUCHSCREEN_CYPRESS_CYTTSP4_DEBUG
        bool "Enable debug output"
        depends on TOUCHSCREEN_CYPRESS_CYTTSP4
        default n
        help
          Enable Debug output for Cypress TrueTouch(tm)
          Standard Product Generation4 drivers set.

          Say Y here to enable debug output.

config TOUCHSCREEN_CYPRESS_CYTTSP4_VDEBUG
        bool "Enable verbose debug output"
        depends on TOUCHSCREEN_CYPRESS_CYTTSP4_DEBUG
        default n
        help
          Enable Verbose Debug output for Cypress TrueTouch(tm)
          Standard Product Generation4 drivers set.

          Say Y here to enable verbose debug output.

config TOUCHSCREEN_CYPRESS_CYTTSP4_I2C
        tristate "Cypress TrueTouch Gen4 I2C"
        depends on TOUCHSCREEN_CYPRESS_CYTTSP4
        select I2C
        default n
        help
          Cypress TrueTouch(tm) Standard Product Generation4
          I2C bus interface.

          Say Y here to enable I2C bus interface to TTSP
          touchscreen controller.

config TOUCHSCREEN_CYPRESS_CYTTSP4_MT_B
        tristate "Cypress TrueTouch Gen4 MultiTouch Protocol B"
        depends on TOUCHSCREEN_CYPRESS_CYTTSP4
        default n
        help
          Cypress TrueTouch(tm) Standard Product Generation4
          MutliTouch Protocol B support.

          Say Y here to enable MutiTouch touch reporting
          using protocol B.

config TOUCHSCREEN_CYPRESS_CYTTSP4_DEVICE_ACCESS
        tristate "Cypress TrueTouch Gen4 MultiTouch Device Access"
        depends on TOUCHSCREEN_CYPRESS_CYTTSP4
        default m
        help
          Cypress TrueTouch(tm) Standard Product Generation4
          Device access module.

          This modules adds an interface to access touchscreen
          controller using driver sysfs nodes.

config TOUCHSCREEN_CYPRESS_CYTTSP4_DEVICE_ACCESS_API
        bool "Enable Device Access kernel API"
        depends on TOUCHSCREEN_CYPRESS_CYTTSP4_DEVICE_ACCESS
        default n
        help
          Say Y here to enable Device access kernel API.

config TOUCHSCREEN_CYPRESS_CYTTSP4_TEST_DEVICE_ACCESS_API
        tristate "Simple Test module for Device Access kernel API"
        depends on TOUCHSCREEN_CYPRESS_CYTTSP4_DEVICE_ACCESS
        depends on TOUCHSCREEN_CYPRESS_CYTTSP4_DEVICE_ACCESS_API
        default n
        help
          Say Y here to enable test module for Device access kernel API.

config TOUCHSCREEN_CYPRESS_CYTTSP4_LOADER
        tristate "Cypress TrueTouch Gen4 MultiTouch Loader"
        depends on TOUCHSCREEN_CYPRESS_CYTTSP4
        default m
        help
          Cypress TrueTouch(tm) Standard Product Generation4
          FW Loader module.

          This module enables support for Firmware upgrade.

config TOUCHSCREEN_CYPRESS_CYTTSP4_PLATFORM_FW_UPGRADE
        bool "FW upgrade from header file"
        depends on TOUCHSCREEN_CYPRESS_CYTTSP4_LOADER
        default n
        help
          Include Cypress TrueTouch(tm) Standard Product
          Generation4 device Firmware into driver.

          Need proper header file for this.

config TOUCHSCREEN_CYPRESS_CYTTSP4_BINARY_FW_UPGRADE
        bool "FW upgrade from binary file"
        depends on TOUCHSCREEN_CYPRESS_CYTTSP4_LOADER
        default n
        help
          Include Cypress TrueTouch(tm) Standard Product
          Generation4 device Firmware into kernel itself.

          This should be enabled for manual FW upgrade.

config TOUCHSCREEN_CYPRESS_CYTTSP4_PLATFORM_TTCONFIG_UPGRADE
        bool "TT Configuration upgrade from header file"
        depends on TOUCHSCREEN_CYPRESS_CYTTSP4_LOADER
        default n
        help
          Include Cypress TrueTouch(tm) Standard Product
          Generation4 device TrueTouch Configuration into
          kernel itself.

          Need proper header file for this.

config TOUCHSCREEN_CYPRESS_CYTTSP4_MANUAL_TTCONFIG_UPGRADE
        bool "TT Configuration upgrade via SysFs"
        depends on TOUCHSCREEN_CYPRESS_CYTTSP4_LOADER
        default n
        help
          Provides a SysFs interface to upgrade TrueTouch
          Configuration with a binary configuration file.

config TOUCHSCREEN_CYPRESS_CYTTSP4_PLATFORM_YUKON
	bool "Yukon: Disable cyttsp4 in-kernel firmware"
	depends on TOUCHSCREEN_CYPRESS_CYTTSP4_LOADER
	default n
	help
	  Say Y to make sure we won't overwrite the
	  ts firmware with something bad on Yukon.

config TOUCHSCREEN_CYPRESS_CYTTSP4_DEBUG_MODULE
        tristate "Cypress TrueTouch Gen4 MultiTouch Debug Module"
        depends on TOUCHSCREEN_CYPRESS_CYTTSP4
        default n
        help
          Cypress TrueTouch(tm) Standard Product Generation4
          Debug module.

          This module adds support for verbose printing touch
          information.
```

## drivers/input/touchscreen/cyttsp5/Kconfig
```kconfig
#
# Touchscreen driver configuration
#
config TOUCHSCREEN_CYPRESS_CYTTSP5
	tristate "Cypress TrueTouch Gen5 Touchscreen Driver"
	default n
	help
	  Core driver for Cypress TrueTouch(tm) Standard Product
	  Geneartion5 touchscreen controllers.

	  Say Y here if you have a Cypress Gen5 touchscreen.

	  If unsure, say N.

	  To compile this driver as a module, choose M here: the
	  module will be called cyttsp5.

config TOUCHSCREEN_CYPRESS_CYTTSP5_DEVICETREE_SUPPORT
	bool "Enable Device Tree support"
	default n
	depends on TOUCHSCREEN_CYPRESS_CYTTSP5 && OF
	help
	  Say Y here to enable support for device tree.

	  If unsure, say N.

config TOUCHSCREEN_CYPRESS_CYTTSP5_DEBUG
	bool "Enable debug output"
	depends on TOUCHSCREEN_CYPRESS_CYTTSP5
	default n
	help
	  Say Y here to enable debug output for Cypress TrueTouch(tm)
	  Standard Product Generation5 drivers set.

	  If unsure, say N.

config TOUCHSCREEN_CYPRESS_CYTTSP5_VDEBUG
	bool "Enable verbose debug output"
	depends on TOUCHSCREEN_CYPRESS_CYTTSP5_DEBUG
	default n
	help
	  Say Y here to enable verbose debug output for Cypress TrueTouch(tm)
	  Standard Product Generation5 drivers set.

	  If unsure, say N.

config TOUCHSCREEN_CYPRESS_CYTTSP5_I2C
	tristate "Cypress TrueTouch Gen5 I2C"
	depends on TOUCHSCREEN_CYPRESS_CYTTSP5
	select I2C
	default n
	help
	  Say Y here to enable I2C bus interface to Cypress TrueTouch(tm)
	  Standard Product Generation5 touchscreen controller.

	  If unsure, say Y.

	  To compile this driver as a module, choose M here: the
	  module will be called cyttsp5_i2c.

config TOUCHSCREEN_CYPRESS_CYTTSP5_SPI
	tristate "Cypress TrueTouch Gen5 SPI"
	depends on TOUCHSCREEN_CYPRESS_CYTTSP5
	select SPI
	default n
	help
	  Say Y here to enable SPI bus interface to Cypress TrueTouch(tm)
	  Standard Product Generation5 touchscreen controller.

	  If unsure, say N.

	  To compile this driver as a module, choose M here: the
	  module will be called cyttsp5_spi.

choice
	bool "Cypress TrueTouch Gen5 MultiTouch Protocol"
	depends on TOUCHSCREEN_CYPRESS_CYTTSP5
	default TOUCHSCREEN_CYPRESS_CYTTSP5_MT_B
	help
	  This option controls which MultiTouch protocol will be used to
	  report the touch events.

config TOUCHSCREEN_CYPRESS_CYTTSP5_MT_A
	bool "Protocol A"
	help
	  Select to enable MultiTouch touch reporting using protocol A
	  on Cypress TrueTouch(tm) Standard Product Generation4 touchscreen
	  controller.

config TOUCHSCREEN_CYPRESS_CYTTSP5_MT_B
	bool "Protocol B"
	help
	  Select to enable MultiTouch touch reporting using protocol B
	  on Cypress TrueTouch(tm) Standard Product Generation4 touchscreen
	  controller.

endchoice

config TOUCHSCREEN_CYPRESS_CYTTSP5_BUTTON
	bool "Cypress TrueTouch Gen5 MultiTouch CapSense Button"
	depends on TOUCHSCREEN_CYPRESS_CYTTSP5
	default n
	help
	  Say Y here to enable CapSense reporting on Cypress TrueTouch(tm)
	  Standard Product Generation5 touchscreen controller.

	  If unsure, say N.

config TOUCHSCREEN_CYPRESS_CYTTSP5_PROXIMITY
	bool "Cypress TrueTouch Gen5 Proximity"
	depends on TOUCHSCREEN_CYPRESS_CYTTSP5
	default n
	help
	  Say Y here to enable proximity reporting on Cypress TrueTouch(tm)
	  Standard Product Generation5 touchscreen controller.

	  If unsure, say N.

config TOUCHSCREEN_CYPRESS_CYTTSP5_DEVICE_ACCESS
	tristate "Cypress TrueTouch Gen5 MultiTouch Device Access"
	depends on TOUCHSCREEN_CYPRESS_CYTTSP5
	default n
	help
	  Say Y here to enable Cypress TrueTouch(tm) Standard Product
	  Generation5 touchscreen controller device access module.

	  This modules adds an interface to access touchscreen
	  controller using driver sysfs nodes.

	  If unsure, say N.

	  To compile this driver as a module, choose M here: the
	  module will be called cyttsp5_device_access.

config TOUCHSCREEN_CYPRESS_CYTTSP5_DEVICE_ACCESS_API
	bool "Enable Device Access kernel API"
	depends on TOUCHSCREEN_CYPRESS_CYTTSP5_DEVICE_ACCESS
	default n
	help
	  Say Y here to enable Device access kernel API which provides
	  access to Cypress TrueTouch(tm) Standard Product Generation5
	  touchscreen controller for other modules.

	  If unsure, say N.

config TOUCHSCREEN_CYPRESS_CYTTSP5_TEST_DEVICE_ACCESS_API
	tristate "Simple Test module for Device Access kernel API"
	depends on TOUCHSCREEN_CYPRESS_CYTTSP5_DEVICE_ACCESS
	depends on TOUCHSCREEN_CYPRESS_CYTTSP5_DEVICE_ACCESS_API
	default n
	help
	  Say Y here to enable test module for Device access kernel API.

	  If unsure, say N.

	  To compile this driver as a module, choose M here: the
	  module will be called cyttsp5_test_device_access_api.

config TOUCHSCREEN_CYPRESS_CYTTSP5_LOADER
	tristate "Cypress TrueTouch Gen5 MultiTouch Loader"
	depends on TOUCHSCREEN_CYPRESS_CYTTSP5
	default n
	help
	  Say Y here to enable Cypress TrueTouch(tm) Standard Product
	  Generation5 touchscreen controller FW Loader module.

	  This module enables support for Firmware upgrade.

	  If unsure, say Y.

	  To compile this driver as a module, choose M here: the
	  module will be called cyttsp5_loader.

config TOUCHSCREEN_CYPRESS_CYTTSP5_PLATFORM_FW_UPGRADE
	bool "FW upgrade from header file"
	depends on TOUCHSCREEN_CYPRESS_CYTTSP5_LOADER
	default n
	help
	  Say Y here to include Cypress TrueTouch(tm) Standard Product
	  Generation5 device Firmware into driver.

	  Need proper header file for this.

	  If unsure, say N.

config TOUCHSCREEN_CYPRESS_CYTTSP5_BINARY_FW_UPGRADE
	bool "FW upgrade from binary file"
	depends on TOUCHSCREEN_CYPRESS_CYTTSP5_LOADER
	default n
	help
	  Say Y here to include Cypress TrueTouch(tm) Standard Product
	  Generation5 device Firmware into kernel as binary blob.

	  This should be enabled for manual FW upgrade support.

	  If unsure, say Y.

config TOUCHSCREEN_CYPRESS_CYTTSP5_PLATFORM_TTCONFIG_UPGRADE
	bool "TT Configuration upgrade from header file"
	depends on TOUCHSCREEN_CYPRESS_CYTTSP5_LOADER
	default n
	help
	  Say Y here to include Cypress TrueTouch(tm) Standard Product
	  Generation5 device TrueTouch Configuration into kernel itself.

	  Need proper header file for this.

	  If unsure, say N.

config TOUCHSCREEN_CYPRESS_CYTTSP5_MANUAL_TTCONFIG_UPGRADE
	bool "TT Configuration upgrade via SysFs"
	depends on TOUCHSCREEN_CYPRESS_CYTTSP5_LOADER
	default n
	help
	  Say Y here to provide a SysFs interface to upgrade TrueTouch
	  Configuration with a binary configuration file.

	  Need proper binary version of config file for this
	  feature.

	  If unsure, say Y.

config TOUCHSCREEN_CYPRESS_CYTTSP5_DEBUG_MDL
	tristate "Cypress TrueTouch Gen5 MultiTouch Debug Module"
	depends on TOUCHSCREEN_CYPRESS_CYTTSP5
	default n
	help
	  Say Y here to enable Cypress TrueTouch(tm) Standard Product
	  Generation5 Debug module.

	  This module adds support for verbose printing touch
	  information.

	  If unsure, say N.

	  To compile this driver as a module, choose M here: the
	  module will be called cyttsp5_debug.
```

## drivers/input/touchscreen/nt36672a/Kconfig
```kconfig
#
# Novatek NT36672 Touchscreen driver configuration
#

config TOUCHSCREEN_NT36672
	tristate "NT36672 i2c touchscreen driver"
	depends on I2C
	default n
	help
	  Say Y here if you have Novatek touch panel.
	  If unsure, say N.
```

## drivers/input/touchscreen/sec_ts/Kconfig
```kconfig
#
# Samsung Electronics TOUCH driver configuration
#

config TOUCHSCREEN_SEC_TS
        tristate "Samsung Electronics Touchscreen"
        depends on I2C
        help
          Say Y here if you want support for SEC touchscreen controllers.
          If unsure, say N.

          To compile this driver as a module, choose M here: the
          module will be called sec_ts.
```

## drivers/input/touchscreen/sec_ts_incell/Kconfig
```kconfig
#
# Samsung Electronics Incell Touchscreen driver configuration
#

config TOUCHSCREEN_SEC_TS_INCELL
	tristate "Samsung Electronics Incell Touchscreen"
	depends on I2C
	help
	  Say Y here if you want support for SEC incell touchscreen controllers.
	  If unsure, say N.

	  To compile this driver as a module, choose M here: the
	  module will be called sec_ts.
```

## drivers/input/touchscreen/siw/Kconfig
```kconfig
menu "SiW Touch Support"

config TOUCHSCREEN_SIW
	tristate "Silicon Works Touch Driver Core"
	depends on SPI_MASTER && I2C
	default n
	help
	  Say Y here if you have a touchscreen interface using
	  the Silicon Works touch device.

config TOUCHSCREEN_SIW_SW49501
	bool "Silicon Works Touch Driver for SW49501"
	depends on TOUCHSCREEN_SIW
	default n
	help
	  If your device is SW49501, say Y

source "drivers/input/touchscreen/siw/mon/Kconfig"

endmenu
```

## drivers/input/touchscreen/siw/mon/Kconfig
```kconfig
menu "SiW Touch Monitor"
	depends on TOUCHSCREEN_SIW

config TOUCHSCREEN_SIWMON
	tristate "Silicon Works Touch Driver Monitor"
	depends on TOUCHSCREEN_SIW
	default y
	help
	  If you select this option,
	  a component which captures the SiW operation traffic such as bus, input
	  will be build.

endmenu
```

## drivers/input/touchscreen/synaptics_tcm/Kconfig
```kconfig
menu "Synaptics TCM Touch Support"

config TOUCHSCREEN_SYNAPTICS_TCM
	tristate "Synaptics TCM Touchscreen Driver"
	depends on SPI_MASTER && I2C
	default n
	help
	  Say Y here if you have a touchscreen interface using
	  the Synaptics TCM touch device.

config TOUCHSCREEN_SYNAPTICS_TCM_DIAG
	tristate "Synaptics TCM Diagnostics"
	depends on TOUCHSCREEN_SYNAPTICS_TCM
	default n
	help
	  Say Y here if you want to diagnose the Synaptics TCM.

config TOUCHSCREEN_SYNAPTICS_TCM_TST
	tristate "Synaptics TCM Factory Testing sysfs interface"
	depends on TOUCHSCREEN_SYNAPTICS_TCM
	default n
	help
	  Say Y here if you want to support factory testing
	  on the Synaptics TCM.

config TOUCHSCREEN_SYNAPTICS_TCM_FWUPG
	tristate "Synaptics TCM Firmware Flashing"
	depends on TOUCHSCREEN_SYNAPTICS_TCM
	default n
	help
	  Say Y here if you want to support flashing the
	  firmware on the Synaptics TCM.

endmenu
```
