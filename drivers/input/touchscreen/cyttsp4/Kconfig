## drivers/misc/Kconfig.stm
```kconfig
menuconfig STM_TRACE
       bool "STM MIPI Trace driver"
       help
         Simple System Trace Module driver. It allows to use and configure the
         STM, either from kernel space, or from user space.

if STM_TRACE

config STM_NUMBER_OF_CHANNEL
       int
       default 512 if ARCH_U8500
       default 256
       help
         Number Max of channels always a multiple of 256

config STM_PRINTK
       bool "printk support"
       depends on STM_TRACE
       help
         Duplicate printk output on STM printk channel & activate stm_printk

config STM_PRINTK_CHANNEL
       int "printk channel"
       range 0 255
       depends on STM_PRINTK
       default 255
       help
         STM printk channel number

config STM_FTRACE
       bool "functions tracing"
       depends on FTRACE
       default n
       help
         Output function tracing on STM dedicated channel

config STM_FTRACE_CHANNEL
       int "ftrace channel"
       range 0 255
       depends on STM_FTRACE
       default 254
       help
         STM ftrace channel number

config STM_CTX_SWITCH
       bool "Context switch tracing"
       depends on CONTEXT_SWITCH_TRACER
       default n
       help
         Output scheduler context switch on STM dedicated channel

config STM_CTX_SWITCH_CHANNEL
       int "Context switch channel"
       range 0 255
       depends on STM_CTX_SWITCH
       default 253
       help
         STM Context switch channel number

config STM_WAKEUP
       bool "Scheduler wakeup tracing"
       depends on CONTEXT_SWITCH_TRACER
       default n
       help
         Output scheduler wakeup on STM dedicated channel

config STM_WAKEUP_CHANNEL
       int "Wakeup channel"
       range 0 255
       depends on STM_WAKEUP
       default 252
       help
         STM scheduler wakeup channel number

config STM_STACK_TRACE
       bool "Stack tracing"
       depends on STACKTRACE
       default n
       help
         Output stack tracing on STM dedicated channel

config STM_STACK_TRACE_CHANNEL
       int "Stack trace channel"
       range 0 255
       depends on STM_STACK_TRACE
       default 251
       help
         STM stack trace channel number

config STM_TRACE_PRINTK
       bool "trace printk & binary printk support"
       depends on TRACING
       default n
       help
         Duplicate trace printk output on STM printk channel

config STM_TRACE_PRINTK_CHANNEL
       int "trace_printk channel"
       range 0 255
       depends on STM_TRACE_PRINTK
       default 250
       help
         STM trace_printk channel number

config STM_TRACE_BPRINTK_CHANNEL
       int "trace_bprintk channel"
       range 0 255
       depends on STM_TRACE_PRINTK
       default 249
       help
         STM trace binary printk channel number

endif
```

## drivers/misc/bmc150/Kconfig
```kconfig
config SENSORS_BMA2X2
	tristate "BMA255/BMA250E/BMA222E/BMA280 acceleration sensor support"
         depends on I2C
	default n
	help
	  If you say yes here you get support for Bosch Sensortec's 
	  acceleration sensors BMA255/BMA250E/BMA222E/BMA280.


config SENSORS_BMM050
	tristate "BMM050 Magnetic Sensor Driver"
         depends on I2C
	default n
	help
	 BMM050 Magnetic Sensor Driver implemented by Bosch-Sensortec.
```

## drivers/misc/btport/Kconfig
```kconfig
#
# BRCM BT Port Driver
#

menuconfig BTPORT
	bool "BT port support"
	default n
	help
	  Redirect SPP driver to a fixed device node.
	  Say Y here to get to see options for device drivers from various
	  different categories. This option alone does not add any kernel code.

	  If you say N, all options in this submenu will be skipped and disabled.

if BTPORT

config BRCM_BTPORT_DRV
	tristate "BRCM BT Port Support"
	default y
	help
	  This option enables rfcomm support for Broadcom bluetooth serial profile.

	  To compile this driver as a module, choose M here: the module will
	  be called btport.

endif # BTPORT
```

## drivers/misc/cm36xx/Kconfig
```kconfig
config SENSORS_CM36XX
	tristate "cm3628x ambient&proximity sensor support"
	depends on I2C
	default n
	help
		If you say yes here you get support for capella
		ambient&proximity support. This sensor can work
		in polling mode and interrupt mode. It only suports
		below modes,
			(1)ambient[polling], proximity[interrput]
			(2)ambient[polling], proximity[polling]
			(3)ambient[interrupt], proximity[interrupt]


config CM36XX_WORK_MODE_POLL
	tristate "enable both ambient and proximity work in polling mode"
	depends on SENSORS_CM36XX
	default n
	help
		If you say yes here, you will make ambient and proximity
		work in polling mode. It will only support below polling
		modes:
			ambient[polling], proximity[interrput]
			ambient[polling], proximity[polling]

config CM36XX_WORK_MODE_INTR
	tristate "enable both ambient and proximity work in interrupt mode"
	depends on SENSORS_CM36XX
	default n
	help
		If you say yes here, you will make ambient and proximity
		work in interrupt mode. It will only support below intr.
		modes:
			ambient[interrupt], proximity[interrupt]
			ambient[polling], proximity[polling]


config CM36XX_WORK_MODE_PS_INTR
	int "make proximity work in interrupt mode"
	depends on SENSORS_CM36XX&&CM36XX_WORK_MODE_POLL
	default "0"
	help
		0: light sensor works in polling, proxmity sensor works in
			polling mode
		1: light sensor works in polling, proxmity sensor works in
			interrupt mode

config CM36XX_WORK_MODE_ALS_POLL
        int "make ambient work in polling mode"
        depends on SENSORS_CM36XX&&CM36XX_WORK_MODE_INTR
        default "0"
	help
		0: light sensor works in inteerupt, proxmity sensor works in
			polling mode
		1: light sensor works in polling, proxmity sensor works in
			polling mode
```

## drivers/misc/emmc_rpmb/Kconfig
```kconfig
#
#	BRCM eMMC RPMB Driver
#

menuconfig BRCM_EMMC_RPMB
	bool "BRCM eMMC RPMB implementation"
	default n
	---help---
	  Say Y here to see options for various RPMB utilities.
	  If you say N, all options in this submenu will be skipped and disabled.

if BRCM_EMMC_RPMB

config BRCM_EMMC_RPMB_SUPPORT
	bool "BRCM eMMC RPMB support"
	default n
	help
	  This driver basically implements eMMC RPMB protocol over the mmc
	  protocol. This can be used with in the kernel to read/write from
	  RPMB partition.

config BRCM_EMMC_RPMB_TEST
	bool "BRCM eMMC RPMB Test code"
	depends on !BRCM_EMMC_RPMB_SUPPORT
	default n
	help
	  This driver implements a very basic eMMC RPMB test
	  driver.

config BRCM_EMMC_RPMB_KEYBOX
	bool "BRCM KEYBOX function support"
	depends on BRCM_EMMC_RPMB_SUPPORT
	default n
	help
	  This driver implements a misc driver for read keybox from eMMC RPMB area.

endif # BRCM_EMMC_RPMB
```

## drivers/misc/haptic_nv/Kconfig
```kconfig
#
# Mediatek HAPTIC_NV Driver
#

config HAPTIC_NV
	tristate "Awinic haptic nv driver"
	depends on I2C
	help
	  Say Y here if you have Awinic haptic nv controller
	  chip in your system.
	  If unsure, say N.
	  To compile this driver as a module, choose M here: the
	  module will be called haptic_nv driver.
```

## drivers/misc/hscdtd00x/Kconfig
```kconfig
menu  "ALPS e-compass sensor fusion support"
	depends on I2C && INPUT_POLLDEV

config SENSORS_HSCD_INPUT
	tristate "ALPS input infrastructure"
	default n
        help
		This option enables alps input
		infrastructure

                If you say yes here, you will enable
                ALPS own input

config SENSORS_HSCDTD007A
	depends on SENSORS_HSCD_INPUT
	tristate "ALPS geomagnetic sensor HSCDTD007/HSCDTD008"
	default n
        help
		This option enables hscd alps HSCDTD007a
		magnetometer driver.

		If you say yes, you will get support for
		HSCDTD007 and HSCDTD008.

config SENSORS_HSCD_BMA222
	depends on SENSORS_HSCD_INPUT
	tristate "BMA222/BMA222E Acceleration Sensor Driver"
	default n
	help
		This option enables bma222/bma222e accelerometer
		driver with alps sensor fusion infrastructure.

		If you say yes here you get support for Bosch-Sensortec
		bma222/bma222e Acceleration Sensor

config SENSORS_HSCD_KXTF9
	depends on SENSORS_HSCD_INPUT
	tristate "Kionix Acceleration Sensor Driver"
	default n
	help
		This option enables kionix accelerometer driver
		with alps sensor fusion infrastructure.

		If you say yes here you get support for Kionix
		kxtik1004/kxtj2-1009/kxtjk-1013 Acceleration Sensor.
endmenu
```

## drivers/misc/huaqinhardware_info/Kconfig
```kconfig
#
#  Driver
#

config HQHARDWARE_INFO
	tristate "Huaqin hardwareinfo"
	help
	  Say Y here if you want use it 
	  chip in your system.

	  If unsure, say N.

	  To compile this driver as a module, choose M here: the
	  module will be called mpr121_touchkey.
```

## drivers/misc/mpu3050/Kconfig
```kconfig
menu "Motion Sensors Support"

config SENSORS_MPU3050
    tristate "MPU3050"
    default n
    depends on I2C
    help
      If you say yes here you get support for the MPU3050 Gyroscope driver
      This driver can also be built as a module.  If so, the module
      will be called mpu3050.

config SENSORS_BMA250
    bool "Bosch BMA250"
    default n
    depends on SENSORS_MPU3050
    help
      This enables support for the Bosch BMA250 accelerometer

config SENSORS_AKM8975
    bool "AKM ak8975"
    default n
    depends on SENSORS_MPU3050
    help
      This enables support for the AKM ak8975 compass

config SENSORS_AKM8972
    bool "AKM ak8972"
    default n
    depends on SENSORS_MPU3050
    help
      This enables support for the AKM ak8972 compass

config SENSORS_AKM8963
    bool "AKM ak8963"
    depends on SENSORS_MPU3050
    help
      This enables support for the AKM ak8963 compass

config MPU_SENSORS_TIMERIRQ
    tristate "Timer IRQ"
    default n
    help
      If you say yes here you get access to the timerirq device handle which
      can be used to select on.  This can be used instead of IRQ's, sleeping,
      or timer threads.  Reading from this device returns the same type of
      information as reading from the MPU and slave IRQ's.

endmenu
```

## drivers/misc/mpu6050/Kconfig
```kconfig
config MPU_SENSORS_TIMERIRQ
	tristate "MPU Timer IRQ"
	help
	  If you say yes here you get access to the timerirq device handle which
	  can be used to select on. This can be used instead of IRQ's, sleeping,
	  or timer threads.  Reading from this device returns the same type of
	  information as reading from the MPU and slave IRQ's.

config SENSORS_MPU6050
	bool "MPU6050 Motion Processing Unit"
	depends on I2C
	default n
	help
	  If you say yes here you get support for the MPU6050 Gyroscope driver
	  This driver can also be built as a module.  If so, the module
	  will be called mpu6050.

config MPU_SENSORS_AK8972
	bool "AKM ak8972"
	depends on SENSORS_MPU6050
	default n
	help
	  This enables support for the AKM ak8972 compass
	  This support is for integration with the MPU3050 or MPU6050 gyroscope
	  device driver.  Only one compass can be registered at a time.
	  Specifying more that one compass in the board file will result
	  in runtime errors.

config MPU_SENSORS_AK8963
	bool "AKM ak8963"
	depends on SENSORS_MPU6050
	default n
	help
	  This enables support for the AKM ak8963 compass
	  This support is for integration with the MPU3050 or MPU6050 gyroscope
	  device driver.  Only one compass can be registered at a time.
	  Specifying more that one compass in the board file will result
	  in runtime errors.
```
