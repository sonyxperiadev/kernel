## drivers/misc/pn547/Kconfig
```kconfig
config NFC_PN547
	bool "NXP PN547 NFC Controller Driver"
	depends on I2C
	default n
	help
	  NXP PN547 Near Field Communication controller support.
	  This option enables device driver support for the NFC.
	  It is used by many services. NFC is fully controlled using I2C
	  to communicate the AP chip.

config NFC_PN547_PMC_CLK_REQ
	bool "NXP PN547 NFC Controller Driver"
	depends on I2C
	default n
	help
	  PM8941 Clock request for NXP PN547 Near Field
	  Communication controller support.
	  This option enables d1 clock for NFC.
```

## drivers/misc/ti_haptics/Kconfig
```kconfig
# SPDX-License-Identifier: GPL-2.0-only
menuconfig LEDS_HAPTICS
	bool "LED Haptics support"
	depends on LEDS_CLASS
	help
	  This option enables haptics support for the leds class.
	  These triggers allow kernel events to drive the LEDs and can
	  be configured via sysfs. If unsure, say Y.

if LEDS_HAPTICS

config LEDS_HAPTICS_DRV2624_RAM
	tristate "LED Support for TI DRV2624 HAPTIC driver chip"
	depends on LEDS_CLASS && I2C
	select REGMAP_I2C
	select PM_WAKELOCKS 
	help
	  If you say yes here you get support for TI DRV2624 HAPTIC driver.
	  It is 4 channels chip with programmable engines.
	  Driver provides direct control via LED class and interface for
	  programming the engines.
endif # NEW_HAPTICS
```

## drivers/misc/tmg399x/Kconfig
```kconfig
config SENSORS_TMG399X
	tristate "tmd3992/tmg3993 ambient light&proximity&gesture sensor support"
	depends on I2C
	default n
	help
		If you say yes here you get support for AMS tmg3992/tmg3993
		ambient light proximity sensor support
```

## drivers/misc/vc04_services/Kconfig
```kconfig
#
# vmcs services module config
#

menuconfig BRCM_VIDEOCORE_SERVICES
	tristate "Broadcom VideoCore Services"
	depends on PROC_FS
	help
	  Broadcom's VideoCore related services modules

config BRCM_VIDEOCORE_ROOT
	string "Path to VideoCore Modules Directory"
	default "../../../../hardware/broadcom/bcm2727"
	depends on BRCM_VIDEOCORE_SERVICES
	help
	  This is required to tell the kernel where to pick up
	  the VideoCore modules from (relative or fixed paths are supported).
	  For all Android distributions, this will be fixed as above.

config BRCM_VIDEOCORE_VCEB
	string "Path to VCEB modules directory"
	default "vmcs/src/interface/vceb"
	depends on BRCM_VIDEOCORE_SERVICES
	help
	  This is required to tell the kernel where to pick up the
	  VCEB module from. Note that this is relative to the BRCM_VIDEOCORE_ROOT definition

config BRCM_VIDEOCORE_SANITIZED
	bool "BRCM VideoCore Santized Release"
	depends on BRCM_VIDEOCORE_SERVICES
	default n
	help
	  Switches between the sanitized release and the full software tree for VMCS-X

config VC_PLATFORM_DIR
	string "PATH to get to the vcfw plaform directory"
	default ""
	depends on BRCM_VIDEOCORE_SERVICES
	help
	  This is the path, to get from the top of the videocore tree down to the
	  platform director, so that we can read the config-shared.mk file.

config VC_GENERATION
	string "PATH to get to the videocore source tree"
	default ""
	depends on BRCM_VIDEOCORE_SERVICES
	help
	  This is the path, to get from the top of the linux source tree into
	  the videocore source tree.

config VC_VCHIQ
	tristate "VCHIQ service module"
	depends on BRCM_VIDEOCORE_SERVICES
	default BRCM_VIDEOCORE_SERVICES
	help
	  VCHIQ kernel service module used by almost all other services.

config VC_VCOS
	tristate "VCOS module"
	depends on BRCM_VIDEOCORE_SERVICES
	default BRCM_VIDEOCORE_SERVICES
	help
	  VCOS kernel module used by all videocore kernel services.

config VC_VCEB
	tristate "VCEB module"
	depends on BRCM_VIDEOCORE_SERVICES
	default BRCM_VIDEOCORE_SERVICES
	help
	  VCEB - early boot kernel module.

config BCM_VCHIQ_VC04
	tristate "VCHIQ stack model"
	default BRCM_VIDEOCORE_SERVICES
	depends on BRCM_VIDEOCORE_SERVICES
	help
	  VCHIQ stack model used by the current platform

config VC_VCHIQ_MEMDRV
	tristate "VCHIQ BUS Driver (internal videocore)"
	depends on BRCM_VIDEOCORE_SERVICES
	default y
	select VC_VCHIQ
        help
           Causes the vchiq stack used for communicating with
           internal videocores (via shared memory) to be compiled in.

config VC_VCHIQ_MEMDRV_HANA
	tristate "VCHIQ Internal Videocore (HANA)"
	depends on VC_VCHIQ_MEMDRV
	default y
        help
           Enables the internal videocore driver used on the Hana chip.
		   
config VC_VMCS_FB
	tristate "VMCS Frame Buffer"
	depends on FB
    select FB_CFB_FILLRECT
    select FB_CFB_COPYAREA
    select FB_CFB_IMAGEBLIT	
	default n
        help
          Support for the VC framebuffer on the Broadcom reference
          phone. Uses the VCHIQ stack.	   

config VC_VMCS_SM
	tristate "VMCS Shared Memory"
	default n
        help
          Support for the VC shared memory on the Broadcom reference
          design. Uses the VCHIQ stack.	   

config VC_OVL
	tristate "Videocore Overlay"
	default n
        help
          Tracker for videocore overlay allocation, used in integration
          with Android for multimedia support.	   

config VC_OMX
	tristate "Videocore OpenMAX"
	default n
        help
          Tracker for videocore openmax capabilities, used in integration
          with Android for multimedia support of StageFright.	   

config VC_HNFO
	tristate "Videocore HDMI Information"
	default n
        help
          Tracker for videocore hdmi capabilities, used in integration
          with Android for multimedia support.	   

config VC_DNFO
	tristate "Videocore Display Information"
	default n
        help
          Tracker for videocore display capabilities, used in integration
          with Android.	   

config VC_MEM
	tristate "Videocore Memory"
	default n
        help
          Helper for videocore memory access and total size allocation.	   
```

## drivers/misc/vmcs_services/Kconfig
```kconfig
#
# vmcs services module config
#

menuconfig BRCM_MISC_DRIVERS
	tristate "Broadcom Misc Drivers"
	depends on PROC_FS
	help
	  Broadcom's VideoCore related drivers

config VC_GENCMD
	tristate "GENCMD Driver"
	depends on BRCM_MISC_DRIVERS
	default BRCM_MISC_DRIVERS

config BCM2835_TVINTF
	tristate "TV Interface Driver"
	depends on BRCM_MISC_DRIVERS
	default BRCM_MISC_DRIVERS

config BCM2708_SMI
	tristate "SMI Driver"
	depends on BRCM_MISC_DRIVERS
	default BRCM_MISC_DRIVERS
	help
		SMI driver required for Nand
        
config VC_CAMERA
	tristate "CAMERA Driver"
	depends on BRCM_MISC_DRIVERS
	default BRCM_MISC_DRIVERS
	help
		Camera driver based on VC IPC

config BCM_VCHIQ_VC04
        tristate "VC04 VCHIQ driver"
        depends on BRCM_MISC_DRIVERS
        default BRCM_MISC_DRIVERS
        help
          VC04 VCHIQ driver
```

## drivers/mmc-poll/Kconfig
```kconfig
#
# MMC polling mode configuration

menuconfig MMCPOLL
	bool "Polling mode MMC stack"
	help
	  This selects MultiMediaCard support APIs that work on polling
	  mode. These APIs can be called from exception handler context
	  to write data into eMMC Flash (other MMC devices) without interrrupts, DMA etc.

menuconfig MMCPOLL_TEST
	tristate "Test module to verify polling mode MMC stack APIs"
	depends on MMCPOLL
	help
	  This selects the test code to validate polling mode MMC driver
	  Gives sysfs interface to initialize, read and write into the MMC
	  kpanic partition using MMC Poll APIs.
	  Disable the config as default.
```

## drivers/mmc/Kconfig
```kconfig
#
# MMC subsystem configuration
#

menuconfig MMC
	tristate "MMC/SD/SDIO card support"
	depends on HAS_IOMEM
	help
	  This selects MultiMediaCard, Secure Digital and Secure
	  Digital I/O support.

	  If you want MMC/SD/SDIO support, you should say Y here and
	  also to your specific host controller driver.

if MMC

source "drivers/mmc/core/Kconfig"

source "drivers/mmc/host/Kconfig"

config SONY_MMC_EXTENSION
	bool "Sony MMC drivers extensions"
	help
	  This selects MMC drivers extensions from Sony, like
	  handling for the UIM and optimizations for all the
	  Sony platforms.

endif # MMC
```

## drivers/mmc/core/Kconfig
```kconfig
#
# MMC core configuration
#

config MMC_RING_BUFFER
	bool "MMC_RING_BUFFER"
	depends on MMC
	default n
	help
	  This enables the ring buffer tracing of significant
	  events for mmc driver to provide command history for
	  debugging purpose.

	  If unsure, say N.

config MMC_EMBEDDED_SDIO
	boolean "MMC embedded SDIO device support (EXPERIMENTAL)"
	help
	  If you say Y here, support will be added for embedded SDIO
	  devices which do not contain the necessary enumeration
	  support in hardware to be properly detected.

config MMC_PARANOID_SD_INIT
	bool "Enable paranoid SD card initialization (EXPERIMENTAL)"
	help
	  If you say Y here, the MMC layer will be extra paranoid
	  about re-trying SD init requests. This can be a useful
	  work-around for buggy controllers and hardware. Enable
	  if you are experiencing issues with SD detection.

config MMC_CLKGATE
	bool "MMC host clock gating"
	help
	  This will attempt to aggressively gate the clock to the MMC card.
	  This is done to save power due to gating off the logic and bus
	  noise when the MMC card is not in use. Your host driver has to
	  support handling this in order for it to be of any use.

	  If unsure, say N.

config MMC_DDR50_MAX_DTR_LMT
	bool "DDR50 DTR limit"
	default n
	help
	  If you say Y here, DTR of DDR50 is limited.

config MMC_SUPPORT_SVS_INTERVAL
	bool "Support Signal Voltage Switch interval"
	help
	  If you say Y here, the signal voltage switch interval
	  is supported for to relieve Team's SD card.

config MMC_SOMC_LOW_VOLTAGE
	bool "Select low voltage if mmc host has the capability"
	default n
	help
	  Select low voltage 1.8v if mmc host has the capability
	  and other voltages are not available.
```

## drivers/mtd/bcmnand/Kconfig
```kconfig
menuconfig MTD_BCMNAND
	tristate "BCMNAND Device Support"
	depends on MTD && (ARCH_ISLAND || ARCH_KONA)
	select MTD_PARTITIONS
	help
	  This enables support for accessing BCMNAND flash devices. 
	  These devices do not provide direct access to NAND cmd, 
	  data, and address registers, but instead use a high
	  level interface on top of a microcode implementation.

if MTD_BCMNAND

config MTD_BCMNAND_VERIFY_WRITE
	bool "Verify NAND page writes"
	help
	  This adds an extra check when data is written to the flash. The
	  NAND flash device internally checks only bits transitioning
	  from 1 to 0. There is a rare possibility that even though the
	  device thinks the write was successful, a bit could have been
	  flipped accidentally due to device wear or something else.

endif # MTD_BCMNAND
```

## drivers/net/wireless/bcm4329_falcon/Kconfig
```kconfig
config BCM4329_FALCON
	tristate "Broadcom 4329 (FALCON driver) wireless card support"
	depends on MMC
	select WIRELESS_EXT
	select WEXT_PRIV
	---help---
	  This module adds support for wireless adapters based on
	  Broadcom 4329 chipset.
	  This driver uses the kernel's wireless extensions subsystem.
	  If you choose to build a module, it'll be called bcm4329_falcon. Say M if
	  unsure.


config BCM4330_FALCON
	tristate "Broadcom 4330 (FALCON driver) wireless card support"
	depends on MMC
	select WIRELESS_EXT
	select WEXT_PRIV
	---help---
	  This module adds support for wireless adapters based on
	  Broadcom 4330 chipset.
	  This driver uses the kernel's wireless extensions subsystem.
	  If you choose to build a module, it'll be called bcm4330_falcon. Say M if
	  unsure.

config BCM4329_FALCON_IF_PREFIX
	depends on BCM4329_FALCON
	string "Wireless interface prefix"
	default ""
	---help---
	 Name of wireless interface. The default value is "eth%d".



config BCM4330_FALCON_IF_PREFIX
	depends on BCM4330_FALCON
	string "Wireless interface prefix"
	default ""
	---help---
	 Name of wireless interface. The default value is "eth%d".
```

## drivers/net/wireless/bcmdhd/Kconfig
```kconfig
config BCMDHD
	tristate "Broadcom wireless cards support"
	depends on MMC || PCI
	---help---
	  This module adds support for wireless adapters based on
	  Broadcom chipset.

config BCMDHD_SDIO
	bool "SDIO bus interface support"
	depends on BCMDHD && MMC && !BCMDHD_PCIE

config BCMDHD_PCIE
	bool "PCIe bus interface support"
	depends on BCMDHD && PCI

config BCM4339
	bool "Broadcom 4339 wireless cards support"
	depends on BCMDHD && BCMDHD_SDIO
	---help---
	  This module adds support for wireless adapters based on
	  Broadcom 4339 chipset.

config BCM4354
	bool "Broadcom 4354 wireless cards support"
	depends on BCMDHD && (BCMDHD_SDIO || BCMDHD_PCIE)
	---help---
	  This module adds support for wireless adapters based on
	  Broadcom 4354 chipset.

config BCM4356
	bool "Broadcom 4356 wireless cards support"
	depends on BCMDHD && (BCMDHD_SDIO || BCMDHD_PCIE)
	---help---
	  This module adds support for wireless adapters based on
	  Broadcom 4356 chipset.

config BCM4359
	bool "Broadcom 4359 wireless cards support"
	depends on BCMDHD && BCMDHD_PCIE
	---help---
	  This module adds support for wireless adapters based on
	  Broadcom 4359 chipset.

config BCMDHD_FW_PATH
	depends on BCMDHD
	string "Firmware path"
	default "/system/vendor/firmware/fw_bcmdhd.bin"
	---help---
	  Path to the firmware file.

config BCMDHD_NVRAM_PATH
	depends on BCMDHD
	string "NVRAM path"
	default "/system/etc/wifi/bcmdhd.cal"
	---help---
	  Path to the calibration file.

config DHD_USE_STATIC_BUF
	bool "Enable memory preallocation"
	depends on BCMDHD
	default n
	---help---
	  Use memory preallocated in platform

config DHD_USE_SCHED_SCAN
	bool "Use CFG80211 sched scan"
	depends on BCMDHD && CFG80211
	default n
	---help---
	  Use CFG80211 sched scan

config BROADCOM_WIFI_RESERVED_MEM
	bool "BROADCOM Reserved memory for wifi device"
	depends on BCMDHD
	---help---
	  This is a configuration for broadcom WLAN driver.

config BCMDHD_DEBUG_PAGEALLOC
	bool "Enable Memory Pagealloc Debugging Support"
	depends on (BCM4354 || BCM4356 || BCM4359)
	---help---
	  Enable Memory Pagealloc Debugging

config DHD_SET_RANDOM_MAC_VAL
	hex "Vendor OUI"
	depends on BCMDHD
	default 0x001A11
	---help---
	  Set vendor OUI for SoftAP
```

## drivers/net/wireless/bcmdhd_4330/Kconfig
```kconfig
config BCM4330
	tristate "Broadcom 4330 wireless cards support"
	depends on WLAN
	---help---
	  This module adds support for wireless adapters based on
	  Broadcom 4330 chipset.
	  This driver uses the kernel's wireless extensions subsystem.
	  If you choose to build a module, it'll be called dhd. Say M if
	  unsure.

config BCMDHD_FW_PATH_4330
	depends on BCM4330
	string "Firmware path"
	default "/system/vendor/firmware/fw_wifi_4330.bin"
	---help---
	  Path to the firmware file.

config BCMDHD_NVRAM_PATH_4330
	depends on BCM4330
	string "NVRAM path"
	default "/system/vendor/firmware/fw_wifi_nvram_4330.txt"
	---help---
	  Path to the calibration file.

config BCMDHD_WEXT
	bool "Enable WEXT support"
	depends on BCMDHD && CFG80211 = n
	select WIRELESS_EXT
	select WEXT_PRIV
	---help---
	  Enables WEXT support

config DHD_USE_STATIC_BUF
	bool "Enable memory preallocation"
	depends on BCMDHD
	default n
	---help---
	  Use memory preallocated in platform

config DHD_USE_SCHED_SCAN
	bool "Use CFG80211 sched scan"
	depends on BCMDHD && CFG80211
	default n
	---help---
	  Use CFG80211 sched scan

config WIFI_CONTROL_FUNC
	bool "Use CFG80211 sched scan"
	depends on BCMDHD && CFG80211
	default y
	---help---
	  Use CFG80211 sched scan
```
