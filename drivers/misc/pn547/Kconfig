## drivers/net/wireless/bcmdhd_4334/Kconfig
```kconfig
config BCMDHD_4334
	tristate "Broadcom 4334 wireless cards support"
	depends on WLAN
	---help---
	  This module adds support for wireless adapters based on
	  Broadcom 4334 chipset.
	  This driver uses the kernel's wireless extensions subsystem.
	  If you choose to build a module, it'll be called dhd. Say M if
	  unsure.

config BCMDHD_FW_PATH_4334
	depends on BCMDHD_4334
	string "Firmware path"
	default "/system/vendor/firmware/fw_wifi_4334.bin"
	---help---
	  Path to the firmware file.

config BCMDHD_NVRAM_PATH_4334
	depends on BCMDHD_4334
	string "NVRAM path"
	default "/system/vendor/firmware/fw_wifi_nvram_4334.txt"
	---help---
	  Path to the calibration file.
```

## drivers/net/wireless/bcmdhd_43362/Kconfig
```kconfig
config BCMDHD_43362_ANDROID
	tristate "Broadcom 43362 Android wireless cards support"
	depends on MMC
	---help---
	  This module adds Android support for wireless adapters based on
	  Broadcom 43662 chipset.

	  If you choose to build a module, it'll be called bcmdhd. Say M if
	  unsure.

config BCMDHD_FW_PATH
	string "Firmware path"
	default "/system/vendor/firmware/fw_wifi.bin"
	depends on BCMDHD_43362_ANDROID
	---help---
	  Path to the firmware file.

config BCMDHD_NVRAM_PATH
	string "NVRAM path"
	default "/system/vendor/firmware/fw_wifi_nvram.txt"
	depends on BCMDHD_43362_ANDROID
	---help---
	  Path to the calibration file.
```

## drivers/net/wireless/bcmdhd_lnx/Kconfig
```kconfig
config BCMDHD_43362_LINUX
	tristate "Broadcom 43362_LINUX DRIVER wireless cards support"
	depends on MMC
	---help---
	  This module adds support for wireless adapters based on
	  Broadcom 43362_LINUX DRIVER chipset.
	  This driver uses the kernel's wireless extensions subsystem.
	  If you choose to build a module, it'll be called dhd. Say M if
	  unsure.

config BCMDHD_LNX_FW_PATH
	depends on BCMDHD_43362_LINUX
	string "Firmware path"
	default "/system/vendor/firmware_lnx/fw_bcmdhd.bin"
	---help---
	  Path to the firmware file.

config BCMDHD_LNX_NVRAM_PATH
	depends on BCMDHD_43362_LINUX
	string "NVRAM path"
	default "/system/vendor/firmware_lnx/fw_wifi_nvram.txt"
	---help---
	  Path to the calibration file.

config BCMDHD_LNX_IF_PREFIX
	depends on BCMDHD_43362_LINUX
	string "Wireless interface prefix"
	default "wlan"
	---help---
	  Name of wireless interface. The default value is "wlan%d".
```

## drivers/net/wireless/controlfnc/Kconfig
```kconfig
config WIFI_CONTROL_FUNC
	bool "Enable WiFi control function abstraction"
	help
	  Enables Power/Reset/Carddetect function abstraction
```

## drivers/nfc/sn1x0_i2c/Kconfig
```kconfig
# SPDX-License-Identifier: GPL-2.0-only

config NFC_SN1X0
	tristate "NXP NCI based NFC I2C Slave Driver for SNxxx"
	depends on I2C
	---help---
	  This module adds support for a NXP NCI based NFC I2C Slave Driver
	  for SNxxx.
	  Select this if your platform is using the I2C bus.

	  To compile this driver as a module, choose m here. The module will
	  be called sn1x0.
	  Say Y if unsure.
```

## drivers/nfc/sn1x0_spi/Kconfig
```kconfig
# SPDX-License-Identifier: GPL-2.0-only

config NXP_P73
	tristate "Nxp P73 secure element protocol driver (SPI) devices"
	depends on SPI && NFC_SN1X0
	---help---
	  This module adds support for a Nxp P73 secure element protocol
	  driver (SPI) devices.
	  Select this if your platform is using the SPI bus.

	  To compile this driver as a module, choose m here. The module will
	  be called p73.
	  Say Y if unsure.
```

## drivers/power/Kconfig
```kconfig
config QNS_SYSTEM
	bool "Qnovo QNS wrapper implementation"
	default n
	help
	  Say Y here to enable support for QNS system.
	  QNS is a battery charging controller and it necessary to access a
	  kernel driver for a battery charging.
	  This adds sysfs interface which enables QNS daemon to access it.

source "drivers/power/avs/Kconfig"
source "drivers/power/reset/Kconfig"
source "drivers/power/supply/Kconfig"
```

## drivers/pwm/Kconfig
```kconfig
#
# PWM infrastructure and devices
#

menuconfig GENERIC_PWM
	tristate "PWM Support"
	help
	  Enables PWM device support implemented via a generic
	  framework.  If unsure, say N.

config GPIO_PWM
       tristate "GPIO+hrtimer PWM device emulation"
       depends on GENERIC_PWM
       help
         When enabled, this feature emulates single-channel PWM
	 devices using high-resolution timers and GPIO pins.  You may
	 create as many of these devices as desired, subject to CPU
	 throughput limitations and GPIO pin availability.

	 To compile this feature as a module, chose M here; the module
	 will be called gpio-pwm.  If unsure, say N.

config ATMEL_PWMC
       tristate "Atmel AT32/AT91 PWMC support"
       depends on GENERIC_PWM && (AVR32 || ARCH_AT91SAM9263 || ARCH_AT91SAM9RL || ARCH_AT91CAP9)
       help
         This option enables support under the generic PWM
	 framework for PWMC peripheral channels found on
	 certain Atmel microcontrollers.  If unsure, say N.


config KONA_PWMC
       tristate "KONA PWM"
       depends on GENERIC_PWM && ARCH_KONA
       help
         When enabled, this feature supports PWM functionality for chip. If unsure, say N.
```

## drivers/sensors/Kconfig
```kconfig
menuconfig NEW_SENSORS
	bool "Sensors Support"
	help
		Say Y to enable Sensors support. This allows control of supported
		Sensors.

if NEW_SENSORS
config SENSORS_CORE
         bool "sensors_core"
         depends on I2C

config YAS_532_ENABLE
	bool "yas 532 sensor YAS 4.2.602"
	depends on I2C
	default n

source "drivers/sensors/yas532/Kconfig"
endif # NEW_SENSORS
```

## drivers/sensors/yas532/Kconfig
```kconfig
menuconfig INPUT_YAS_SENSORS
	bool "Sensors Support"
	help
	  Say Y to enable Sensors support.  This allows control of supported
	  Sensors.

if INPUT_YAS_SENSORS
source "drivers/sensors/yas532/geomagnetic/Kconfig"
source "drivers/sensors/yas532/orientation/Kconfig"
endif # INPUT_YAS_SENSORS
```

## drivers/sensors/yas532/geomagnetic/Kconfig
```kconfig
#
# Copyright (c) 2010 Yamaha Corporation
#
# This program is free software; you can redistribute it and/or
# modify it under the terms of the GNU General Public License
# as published by the Free Software Foundation; either version 2
# of the License, or (at your option) any later version.
#
# This program is distributed in the hope that it will be useful,
# but WITHOUT ANY WARRANTY; without even the implied warranty of
# MERCHANTABILITY or FITNESS FOR A PARTICULAR PURPOSE.  See the
# GNU General Public License for more details.
#
# You should have received a copy of the GNU General Public License
# along with this program; if not, write to the Free Software
# Foundation, Inc., 51 Franklin Street, Fifth Floor, Boston, MA  02110-1301,
# USA.
#

config INPUT_YAS_MAGNETOMETER
         tristate "YAS Geomagnetic Sensor"
         depends on I2C

config YAS_MAG_DRIVER_YAS532
	tristate "YAS Geomagnetic Sensor - yas532"
	depends on I2C
	help
	  Say Y here if you want support for the yas532 sensor
	  device.

	  To compile this driver as a module, choose M here: the
	  module will be called yas532.

config INPUT_YAS_MAGNETOMETER_POSITION
         int "YAS Geomagnetic Sensor Mounting Position on Board"
         depends on INPUT_YAS_MAGNETOMETER
         default "0"
         help
           Chip mounting position (pin 1).
              0: top, upper-left
              1: top, upper-right
              2: top, lower-right
              3: top, lower-left
              4: bottom, upper-left
              5: bottom, upper-right
              6: bottom, lower-right
              7: bottom, lower-left
```

## drivers/sony/last_logs/Kconfig
```kconfig
config RAMDUMP_LAST_LOGS
	bool "support last logs for system"
	depends on DEBUG_FS
	help
	  When a fatal error is encountered on system, system reboots and
	  saves the logs in last logs memory. This driver supports the mechanism
	  to read these logs and exports them via debugfs.
```

## drivers/sony/lxs_ts/Kconfig
```kconfig
menu "LXS Touch Support"

config TOUCHSCREEN_LXS
	tristate "LX Semicon Touch Driver Core"
	depends on SPI_MASTER || I2C
	default n
	help
	  Say Y here if you have a touchscreen interface using
	  the LX Semicon touch device.

config TOUCHSCREEN_LXS_SW82907
	bool "LX Semicon Touch Driver for SW82907"
	depends on TOUCHSCREEN_LXS
	default n
	help
	  If your device is SW82907, say Y

endmenu
```
