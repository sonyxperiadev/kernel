## drivers/staging/bcm_vcodec/Kconfig
```kconfig
config BCM_VCODEC
	bool "Broadcom Video Codec"
	depends on ARCH_HAWAII || ARCH_BCM
	default n
	help
	  Support for Broadcom video codec

	  Say N if you are unsure if this should be enabled

config BCM_HVA
	tristate "Hardware Video Accelerator Driver"
	depends on BCM_VCODEC
	help
	 This option enables the Hardware Video Accelerator driver. This
	 assists in accelerating video decode and encode.

config BCM_VCE
	tristate "VCE Driver"
	depends on BCM_VCODEC && BCM_HVA && ION_BCM
	help
	 This option enables the Video Control Engine driver. This accelerates
	 video decode and encode, hence improves the system performance.

config BCM_MCI
	tristate "MCI Driver"
	depends on BCM_VCODEC
	help
	 This config enables the MCI driver. The Video Core
	 MultiCodeIn is one of hardware video accelerator
	 component accelerates the video codec engine and
	 hence improves the system performance.

config BCM_CABAC
	tristate "CABAC Driver"
	depends on BCM_VCODEC
	help
	  This config enables the CABAC driver. This driver
	  accelerates Context-Adaptive Binary Arithmetic Coding for video
	  encode/decode and improves the system performance.

source "drivers/staging/bcm_vcodec/pwrctrl/Kconfig"

config BCM_CME
	tristate "MCI Driver"
	depends on BCM_VCODEC
	help
	 This config enables the CME driver. The Video Core
	 Coarse Motion Estimation is one of hardware video
	 accelerator components that accelerates the video
	 codec engine and hence improves the system performance.
```

## drivers/staging/bcm_vcodec/pwrctrl/Kconfig
```kconfig
config BCM_MM_PWRCTRL
        bool "BCM Multimedia Power Domain Manager Driver"
        depends on (ARCH_HAWAII || ARCH_BCM) && BCM_VCODEC
        default n
        help
	  This driver would expose multimedia (codec) specific power domain
	  functionlity.
```

## drivers/staging/iio/magnetometer/Kconfig
```kconfig
#
# Magnetometer sensors
#
menu "Magnetometer sensors"

config SENSORS_HMC5843
	tristate "Honeywell HMC5843/5883/5883L 3-Axis Magnetometer"
	depends on I2C
	help
	  Say Y here to add support for the Honeywell HMC5843, HMC5883 and
	  HMC5883L 3-Axis Magnetometer (digital compass).

	  To compile this driver as a module, choose M here: the module
	  will be called hmc5843.

config SENSORS_YAS532
        tristate "Yamaha YAS532 3-Axis Magnetometer"
        depends on I2C && SYSFS && IIO && IIO_BUFFER && IIO_KFIFO_BUF && IIO_TRIGGER
        help
          Say Y here to add support for the Yamaha YAS532 3-Axis Magnetometer.

config SENSORS_BMA250E
        tristate "Bosch BMA250E 3-Axis Accelerometer"
        depends on I2C && SYSFS && IIO && IIO_BUFFER && IIO_KFIFO_BUF && IIO_TRIGGER
        help
          Say Y here to add support for the Bosch BMA250E 3-Axis Accelerometer.

config SENSORS_KXTJ2
        tristate "Kionix KXTJ2 3-Axis Accelerometer"
        depends on I2C && SYSFS && IIO && IIO_BUFFER && IIO_KFIFO_BUF && IIO_TRIGGER
        help
          Say Y here to add support for the Kionix KXTJ2 3-Axis Accelerometer.

endmenu
```

## drivers/staging/wlan-qc/Kconfig
```kconfig
config QCA_CLD_WLAN
	tristate "Qualcomm Atheros CLD WLAN module"
	default n
	help
	  Add support for the Qualcomm Atheros CLD WLAN module.
```

## drivers/usb/typec/sm5038/Kconfig
```kconfig
# SPDX-License-Identifier: GPL-2.0

config SM5038_WATER_DETECTION_ENABLE
	bool "Using sm5714 Type-C Water Detection"
	depends on I2C
	help
	  If you say yes here you will get support for
	  the SM5038 Type-C Water detection functions.

config SM5038_SUPPORT_SBU
	bool "Using sm5714 Type-C support sbu"
	depends on I2C
	help
	  If you say yes here you will get support for
	  the SM5038 Type-C support SBU.
```

## drivers/video/broadcom/Kconfig
```kconfig
config FB_BRCM_KONA
	tristate "Broadcom KONA Platform Framebuffer support"
	depends on FB && ARM && ARCH_KONA
	select FB_CFB_FILLRECT
	select FB_CFB_COPYAREA
	select FB_CFB_IMAGEBLIT
	select KONA_DSI
	select KONA_VC4LITE
	select KONA_SMI
	help
	  This framebuffer device driver is for the Broadcom KONA platform.

config FB_BRCM_CP_CRASH_DUMP_IMAGE_SUPPORT
	bool "CP Crash Dump Image Support"
	depends on FB_BRCM_KONA && BCM_MODEM
	default Y
	help
	  This is used for LCD to show that cp goes into crahs dump state.
	  If you do not know about this config, please just say 'N' here.

config LCD_HX8369_SUPPORT
        tristate "LCD Panel- HX8369 controller"
        help
	  WVGA LCD panel (HX8369 controller)

config LCD_HX8369_CS02_SUPPORT
        tristate "LCD Panel- HX8369 controller"
        default N
        help
	  WVGA LCD panel (HX8369 controller)

config LCD_SC7798_CS02_SUPPORT
        tristate "LCD Panel- HX8369 controller"
        default N
        help
	  WVGA LCD panel (HX8369 controller)

config LCD_S6E63M0X_SUPPORT
        tristate "LCD Panel- S6E63M0X controller"
        default N
        help
	  WVGA LCD panel (S6E63M0X controller)

config LCD_NT35510_SUPPORT
        tristate "LCD Panel- NT35510 controller"
        default N
        help
	  WVGA LCD panel (NT35510 controller)

config LCD_NT35512_SUPPORT
        tristate "LCD Panel- NT35512 controller"
        default N
        help
	  WVGA LCD panel (NT35512 controller)

config FB_BRCM_LCD_EXIST_CHECK
		bool "Enable LCD exist check code"
	help
	  Say Y here to enable LCD exist check code

config LDI_MDNIE_SUPPORT
	  tristate "LDI mDNIe Driver"
	help
		LDI mDNIe Driver

config DSI_PKT_VID_SIMULTANEOUS
	tristate "Broadcom DSI simulataneous packet, video mode"
	depends on FB_BRCM_KONA
	default N
	help
	  the way DSI sending packet while video stream is active.
	  Y, the packets are sending simultaneously.
	  N, suspend video stram firstly, then sending packets.

config FB_NEED_PAGE_ALIGNMENT
	bool "Each buffer need page alignment"
	default N
	help
	  This is used for do page align for each frame .
	  If it is tk project, please say 'Y' here.
```

## drivers/video/fbdev/msm/somc_panel/Kconfig
```kconfig
config FB_MSM_MDSS_SPECIFIC_PANEL
	depends on FB_MSM_MDSS
	bool
	prompt "Sony Xperia Unified Panel Driver"
	default n
	---help---
	Restructured Unified display Panel Driver for Xperia Open Devices.
	Provides support for panels found in various Sony Xperia devices.

config SOMC_PANEL_LABIBB
	depends on FB_MSM_MDSS_SPECIFIC_PANEL && REGULATOR_QPNP_LABIBB_SOMC
	bool
	default y
	---help---
	LAB/IBB regulators handling for MSM8994 and later generation boards.

config FBDEV_SOMC_PANEL_INCELL
	depends on FB_MSM_MDSS_SPECIFIC_PANEL
	bool "SoMC Panel for In-Cell"
	default y
	---help---
	Handles incell panels and touchscreens.
	You probably want to also enable SOMC_PANEL_LABIBB.
```

## drivers/video/msm/mdss/mhl_simg_sony/Kconfig
```kconfig
config MHL_DEVICE_ID
	hex "MHL Device ID"
	depends on MHL_SIMG_SONY
	default 30

config MHL_UPSTREAM_HPD_PUSH_PULL
	bool "MHL: Set upstream HPD pin mode"
	depends on MHL_SIMG_SONY
	default y
	help
	  Say Y to this entry if your upstream HPD is push
	  pull mode, otherwise, say N for open drain mode.

config MHL_HPD_UPSTREAM_HDMI_IS_HIGH_TRIGGER
	bool "MHL: Upstream HPD high trigger"
	depends on MHL_SIMG_SONY
	default y
	help
	  Say Y to this entry if HPD is active high,
	  otherwise, say N for active low.

config MHL_SUPPORT_UNPOWERED_DONGLE
	bool "MHL: Support not powered dongle"
	depends on MHL_SIMG_SONY
	default n
	help
	  Support MHL dongle without external power.
	  This means that the device shall be capable of
	  providing power to the MHL dongle from its own.

config MHL_BIST
	bool "MHL: Add Built-In Self Test"
	depends on MHL_SIMG_SONY
	default n
	help
	  Add BIST support to the driver.
	  This will add a self test at driver/hw init time.
	  If unsure, say N.

config SUPPORT_CHG_TIMING
	bool "MHL: Support charge timing"
	depends on MHL_SIMG_SONY
	default n
```

## drivers/video/msm/mdss/somc_panel/Kconfig
```kconfig
config FB_MSM_MDSS_SPECIFIC_PANEL
	depends on FB_MSM_MDSS
	bool
	prompt "Sony Xperia Unified Panel Driver"
	default n
	---help---
	Restructured Unified display Panel Driver for Xperia Open Devices.
	Provides support for panels found in various Sony Xperia devices.

config SOMC_PANEL_LABIBB
	depends on FB_MSM_MDSS_SPECIFIC_PANEL && REGULATOR_QPNP_LABIBB_SOMC
	bool
	default y
	---help---
	LAB/IBB regulators handling for MSM8994 and later generation boards.

choice
	bool "SoMC Panel variant support"
	default SOMC_PANEL_INCELL if (ARCH_SONY_LOIRE || ARCH_SONY_TONE)
	default SOMC_PANEL_LEGACY if (ARCH_SONY_RHINE || ARCH_SONY_SHINANO || \
				      ARCH_SONY_KITAKAMI || ARCH_SONY_KANUTI)

config SOMC_PANEL_LEGACY
	depends on FB_MSM_MDSS_SPECIFIC_PANEL
	bool
	prompt "SoMC Panel for Legacy"
	---help---
	Handles legacy panels (with or without LAB/IBB).

config SOMC_PANEL_INCELL
	depends on FB_MSM_MDSS_SPECIFIC_PANEL
	bool
	prompt "SoMC Panel for In-Cell"
	---help---
	Handles incell panels and touchscreens.
	You probably want to also enable SOMC_PANEL_LABIBB.
endchoice
```

## drivers/video/msm/mdss/somc_panels/Kconfig
```kconfig
config FB_MSM_MDSS_SPECIFIC_PANEL
	depends on FB_MSM_MDSS
	bool
	prompt "MDSS Specific panel"
	default n
	---help---
	The MDSS Specific Panel provides support for specific panel driver
	file.
```

## drivers/videocore/host_support/Kconfig
```kconfig
#
# Videocore kernel configuration
#

menuconfig BRCM_VIDEOCORE_SERVICES
	tristate "Broadcom VideoCore Services"
	depends on PROC_FS
	help
	  Broadcom's VideoCore related services modules

if BRCM_VIDEOCORE_SERVICES

config VC_VCOS
	tristate "VCHIQ OS Abstraction (vcos)"
	help
	  VCHIQ OS Abstraction (vcos) used by the vchiq code.

config VC_MEM
	tristate "Videocore Memory"
	default BRCM_VIDEOCORE_SERVICES
        help
          Helper for videocore memory access and total size allocation.

config VC_VCEB
	tristate "Videocore Boot"
	default BRCM_VIDEOCORE_SERVICES
	help
	  Legacy code still required for booting the videocore.

config VC_VCHIQ
	tristate "VCHIQ service module"
	default BRCM_VIDEOCORE_SERVICES
	help
	  VCHIQ kernel service module used by almost all other services.

config VC_VCHIQ_MEMDRV
	tristate "VCHIQ BUS Driver (internal videocore)"
	default y
	select VC_VCHIQ
        help
           Causes the vchiq stack used for communicating with
           internal videocores (via shared memory) to be compiled in.

config VC_VCHIQ_MEMDRV_KONA
	tristate "VCHIQ Internal Videocore (KONA)"
	depends on VC_VCHIQ_MEMDRV
	default y
        help
           Enables the internal videocore driver used on the Kona chip.

config VC_FB
	tristate "Videocore Frame Buffer"
	depends on FB
	select FB_CFB_FILLRECT
	select FB_CFB_COPYAREA
	select FB_CFB_IMAGEBLIT	
	default y
        help
          Support for the VC framebuffer on the Broadcom reference
          phone. Uses the VCHIQ stack.

config VC_SM
	tristate "VMCS Shared Memory"
	default m
        help
          Support for the VC shared memory on the Broadcom reference
          design. Uses the VCHIQ stack.

config VC_OVL
	tristate "Videocore Overlay"
	default n
        help
          Tracker for videocore overlay allocation, used in integration
          with Android for multimedia support.

config VC_OMX
	tristate "Videocore OpenMAX"
	default n
        help
          Tracker for videocore openmax capabilities, used in integration
          with Android for multimedia support of StageFright.

config VC_HNFO
	tristate "Videocore HDMI Information"
	default n
        help
          Tracker for videocore hdmi capabilities, used in integration
          with Android for multimedia support.

config VC_DNFO
	tristate "Videocore Display Information"
	default n
        help
          Tracker for videocore display capabilities, used in integration
          with Android.

endif	# BRCM_VIDEOCORE_SERVICES
```

## mm/Kconfig.debug
```kconfig
config DEBUG_PAGEALLOC
	bool "Debug page memory allocations"
	depends on DEBUG_KERNEL
	depends on !HIBERNATION || ARCH_SUPPORTS_DEBUG_PAGEALLOC && !PPC && !SPARC
	depends on !KMEMCHECK
	select PAGE_POISONING if !ARCH_SUPPORTS_DEBUG_PAGEALLOC
	select PAGE_GUARD if ARCH_SUPPORTS_DEBUG_PAGEALLOC
	---help---
	  Unmap pages from the kernel linear mapping after free_pages().
	  This results in a large slowdown, but helps to find certain types
	  of memory corruption.

	  For architectures which don't enable ARCH_SUPPORTS_DEBUG_PAGEALLOC,
	  fill the pages with poison patterns after free_pages() and verify
	  the patterns before alloc_pages().  Additionally,
	  this option cannot be enabled in combination with hibernation as
	  that would result in incorrect warnings of memory corruption after
	  a resume because free pages are not saved to the suspend image.

config WANT_PAGE_DEBUG_FLAGS
	bool

config PAGE_POISONING
	bool
	select WANT_PAGE_DEBUG_FLAGS

config SHOW_FREE_LISTS
	bool "Show Free lists per migrate-type in show_free_areas()"
	---help---
	  Shows the free lists per zone at the end of show_free_areas(). The
	  list is identical to /proc/pagetypeinfo (In fact this uses the exact code
	  and replaces seq_prints by printks. Specially usefull to see the free
	  migrate type lists when kernel runs out of memory

config PAGE_GUARD
	bool
	select WANT_PAGE_DEBUG_FLAGS
```

## sound/caph/Kconfig
```kconfig
#/*******************************************************************************************
#Copyright 2010 Broadcom Corporation.  All rights reserved.                                */
#
#Unless you and Broadcom execute a separate written software license agreement
#governing use of this software, this software is licensed to you under the
#terms of the GNU General Public License version 2, available at
#http://www.gnu.org/copyleft/gpl.html (the "GPL").
#
#Notwithstanding the above, under no circumstances may you combine this software
#in any way with any other Broadcom software provided under a license other than
#the GPL, without Broadcom's express prior written consent.
#*******************************************************************************************/

config BCM_ALSA_SOUND
	boolean "Broadcom ALSA sound drivers"
	select SND_PCM
	select SND_HWDEP
	depends on SND
	depends on (ARCH_RHEA || ARCH_ISLAND)
        default y
        help
          Say Y here to activate an ALSA driver frontend to the BRCM endpoint
config BCM_AUDIO_SELFTEST
	boolean "Broadcom audio selftest driver"
	depends on BCM_ALSA_SOUND && MFD_BCMPMU
        default n
        help
          Say Y here to activate Brcm Audio selftest
config ENABLE_VOIF
	boolean "Broadcom enable VOIF feature"
        depends on BCM_MODEM
        default n
        help
          Say Y here to activate Brcm voif
config VOIF_DUPLUX_UL_PCM
	boolean "Broadcom VOIF support duplex UL PCM"
        depends on BCM_MODEM
        default n
        help
          Say Y here to enable VOIF duplex UL PCM
config IHF_EXT_AMPLIFIER
        boolean "Define if an external amp is used for IHF"
        depends on BCM_ALSA_SOUND
        default n
        help
          Say Y here to enable the external amp for IHF
config STEREO_SPEAKER
        boolean "Define if device has stereo speaker support"
        depends on BCM_ALSA_SOUND
        default n
        help
          Say Y here to enable the stereo speaker
```
