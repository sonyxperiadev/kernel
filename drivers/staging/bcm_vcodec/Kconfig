## sound/caph_hawaii/Kconfig
```kconfig
#/*******************************************************************************************
#Copyright 2010 Broadcom Corporation.  All rights reserved.                                */
#
#Unless you and Broadcom execute a separate written software license agreement
#governing use of this software, this software is licensed to you under the
#terms of the GNU General Public License version 2, available at
#http://www.gnu.org/copyleft/gpl.html (the "GPL").
#
#Notwithstanding the above, under no circumstances may you combine this software
#in any way with any other Broadcom software provided under a license other than
#the GPL, without Broadcom's express prior written consent.
#*******************************************************************************************/

config BCM_ALSA_SOUND
	boolean "Broadcom Hawaii ALSA sound drivers"
	select SND_PCM
	select SND_HWDEP
	depends on SND
	depends on (ARCH_JAVA || ARCH_HAWAII)
        default y
        help
          Say Y here to activate an ALSA driver frontend to the BRCM endpoint

config MAP_VOIP
	boolean "Broadcom MAP VOIP"
        default n
        help
         Say Y here to activate an ALSA driver for MAP VOIP

config CAPH_STEREO_IHF
	boolean "Broadcom CAPH stereo IHF support"
	depends on ((ARCH_JAVA || ARCH_HAWAII) && BCM_ALSA_SOUND)
	default n
	help
	 Say Y here to activate stereo IHF feature on CAPRI RAY platform
config BCM_AUDIO_SELFTEST
	boolean "Broadcom audio selftest driver"
	depends on BCM_ALSA_SOUND && MFD_BCMPMU
        default n
        help
          Say Y here to activate Brcm Audio selftest
config ENABLE_VOIF
	boolean "Broadcom enable VOIF feature"
        depends on BCM_MODEM
        default n
        help
          Say Y here to activate Brcm voif
config VOIF_DUPLUX_UL_PCM
	boolean "Broadcom VOIF support duplex UL PCM"
        depends on BCM_MODEM
        default n
        help
          Say Y here to enable VOIF duplex UL PCM
config IHF_EXT_AMPLIFIER
        boolean "Define if an external amp is used for IHF"
        depends on BCM_ALSA_SOUND
        default n
        help
          Say Y here to enable the external amp for IHF
config GPIO_2IN1_SPK
        boolean "Define if use 2in1 speaker"
        depends on BCM_ALSA_SOUND
        default n
        help
          Say Y here to use 2in1 speaker
config AUDIO_S2
        boolean "Define if S2 featuers are enabled"
        depends on BCM_ALSA_SOUND
        default n
        help
          Say Y here to enable Audio S2 features
config AUDIO_FEATURE_SET_DISABLE_ECNS
	boolean "Broadcom enable BT NREC off feature"
	depends on BCM_MODEM
	default n
	help
	  Say Y here to activate Brcm BT NREC OFF
config IHF_TWO_EXT_AMPLIFIER
        boolean "Define if two external amp is used for IHF"
        depends on BCM_ALSA_SOUND
        default n
        help
          Say Y here to enable the two external amp for IHF
config IHF_EXT_PA_TPA2026D2
        boolean "Define if TPA2026D2 is used for IHF"
        depends on BCM_ALSA_SOUND
        default n
        help
          Say Y here to enable the two external amp for IHF
```

## sound/soc/broadcom/Kconfig
```kconfig
#/*******************************************************************************************
#Copyright 2010 Broadcom Corporation.  All rights reserved.  */
#
#Unless you and Broadcom execute a separate written software license agreement
#governing use of this software, this software is licensed to you under the
#terms of the GNU General Public License version 2, available at
#http://www.gnu.org/copyleft/gpl.html (the "GPL").
#
#Notwithstanding the above, under no circumstances may you combine this software
#in any way with any other Broadcom software provided under a license other than
#the GPL, without Broadcom's express prior written consent.

#*******************************************************************************************/

config SND_BCM_SOC
	tristate "SoC Audio for Broadcom 21664 SoC"
	depends on SND_SOC && !BCM_ALSA_SOUND
	help
	 Say Y or M if you want to add support for codecs attached to
	 the 21664 I2S interface. You will also need to select the audio
	 interfaces to support below.

config SND_BCM_SOC_I2S
	tristate "SoC Audio (I2S protocol) for Broadcom 21664 Hawaii"
	depends on SND_BCM_SOC
	help
	 Say Y if you want to use I2S protocol and I2S codec on 21664 Hawaii
	 based boards.

config SND_BCM_SOC_HAWAII
	tristate "SoC Audio support for 21664 Hawaii"
	depends on SND_BCM_SOC
	select SND_SOC_BCM_CODEC
	help
	 Say Y if you want to add support for ASoC audio on 21664 Hawaii board
```

## techpack/Kconfig
```kconfig
source techpack/audio/Kconfig
source techpack/data-kernel/drivers/rmnet/perf/Kconfig
source techpack/data-kernel/drivers/rmnet/shs/Kconfig
```

## techpack/audio/Kconfig
```kconfig
config PINCTRL_LPI
	tristate "PINCTRL_LPI"
config PINCTRL_WCD
	tristate "PINCTRL_WCD"
config AUDIO_EXT_CLK
	tristate "AUDIO_EXT_CLK"
config SND_SOC_WCD9XXX_V2
	tristate "SND_SOC_WCD9XXX_V2"
config SND_SOC_WCD_MBHC
	tristate "SND_SOC_WCD_MBHC"
config SND_SOC_WSA881X
	tristate "SND_SOC_WSA881X"
	select REGMAP_SWR
config SND_SOC_WCD_DSP_MGR
	tristate "SND_SOC_WCD_DSP_MGR"
config SND_SOC_WCD_SPI
	tristate "SND_SOC_WCD_SPI"
config SND_SOC_WCD_CPE
	tristate "SND_SOC_WCD_CPE"
config SND_SOC_WCD9335
	tristate "SND_SOC_WCD9335"
config SND_SOC_WCD934X
	tristate "SND_SOC_WCD934X"
config SND_SOC_WCD934X_MBHC
	tristate "SND_SOC_WCD934X_MBHC"
config SND_SOC_WCD934X_DSD
	tristate "SND_SOC_WCD934X_DSD"
config MSM_QDSP6V2_CODECS
	tristate "MSM_QDSP6V2_CODECS"
config MSM_ULTRASOUND
	tristate "MSM_ULTRASOUND"
config MSM_QDSP6_APRV2
	tristate "MSM_QDSP6_APRV2 SMD"
config MSM_QDSP6_APRV2_GLINK
	tristate "MSM_QDSP6_APRV2_GLINK"
config MSM_ADSP_LOADER
	tristate "MSM_ADSP_LOADER"
config REGMAP_SWR
	tristate "REGMAP_SWR"
config MSM_QDSP6_SSR
	tristate "MSM_QDSP6_SSR"
config MSM_QDSP6_PDR
	tristate "MSM_QDSP6_PDR"
config MSM_QDSP6_NOTIFIER
	tristate "MSM_QDSP6_NOTIFIER"
config SND_SOC_MSM_HOSTLESS_PCM
	tristate "SND_SOC_MSM_HOSTLESS_PCM"
config SND_SOC_MSM_QDSP6V2_INTF
	tristate "SND_SOC_MSM_QDSP6V2_INTF"
config SND_SOC_SDM670
	tristate "SND_SOC_SDM670"
config MSM_GLINK_SPI_XPRT
	tristate "MSM_GLINK_SPI_XPRT"
config SOUNDWIRE
	tristate "SOUNDWIRE"
config SOUNDWIRE_WCD_CTRL
	tristate "SOUNDWIRE_WCD_CTRL"
config SND_SOC_QDSP6V2
	tristate "SND_SOC_QDSP6V2"
config SND_SOC_MSM_QDSP6V2_INTF
	tristate "SND_SOC_MSM_QDSP6V2_INTF"
config WCD9XXX_CODEC_CORE
	tristate "WCD9XXX_CODEC_CORE"
config MSM_CDC_PINCTRL
	tristate "MSM_CDC_PINCTRL"
config SND_SOC_WCD_MBHC_ADC
	tristate "SND_SOC_WCD_MBHC_ADC"
config SND_SOC_WCD_MBHC_LEGACY
	tristate "SND_SOC_WCD_MBHC_LEGACY"
config QTI_PP
	tristate "QTI_PP"
config QTI_PP_AUDIOSPHERE
        tristate "QTI_PP_AUDIOSPHERE"
config SND_SOC_CPE
	tristate "CPE"
config SND_HWDEP_ROUTING
	tristate "SND_HWDEP_ROUTING"
config DTS_EAGLE
	tristate "DTS_EAGLE"
config DOLBY_DS2
	tristate "DOLBY_DS2"
config DOLBY_LICENSE
	tristate "DOLBY_LICENSE"
config DTS_SRS_TM
	tristate "DTS_SRS_TM"
config SND_SOC_EXT_CODEC
	tristate "SND_SOC_EXT_CODEC"
config SND_SOC_INT_CODEC
	tristate "SND_SOC_INT_CODEC"
config SND_SOC_MSM_STUB
	tristate "SND_SOC_MSM_STUB"
config WCD_DSP_GLINK
	tristate "WCD_DSP_GLINK"
config MSM_AVTIMER
	tristate "MSM_AVTIMER"
config SND_SOC_SDM660_CDC
	tristate "SND_SOC_SDM660_CDC"
config SND_SOC_ANALOG_CDC
	tristate "SND_SOC_ANALOG_CDC"
config SND_SOC_DIGITAL_CDC
	tristate "SND_SOC_DIGITAL_CDC"
config SND_SOC_MSM_SDW
	tristate "SND_SOC_MSM_SDW"
config SND_SOC_MSM_HDMI_CODEC_RX
	tristate "SND_SOC_MSM_HDMI_CODEC_RX"
config SND_SOC_SDM845
	tristate "SND_SOC_SDM845"
config SND_SOC_SDM670
	tristate "SND_SOC_SDM670"

config SND_SOC_WCD_CPE_SOMC_EXT
	bool "WCD CPE SoMC Extensions"
	depends on SND_SOC_WCD_CPE
config SND_SOC_SDM660
	tristate "SND_SOC_SDM660"
config SND_SOC_MSM8X16
	tristate "SoC Machine driver for MSM8916"
config SND_SOC_MSM8956
	tristate "SND_SOC_MSM8956"
config SND_SOC_MSM8996
	tristate "SND_SOC_MSM8996"
config SND_SOC_MSM8998
	tristate "SND_SOC_MSM8998"
```
