## brcm_modules/Kconfig.priv
```kconfig
menuconfig BRCM_MODULES_PRIV
	tristate "Broadcom Proprietary Kernel Modules"
	depends on BRCM_MODULES
	default N
	help
	  Broadcom Proprietary Kernel Modules

if BRCM_MODULES_PRIV

# source Kconfig for proprietary drivers here
# add "depends on BRCM_MODULES && BRCM_MODULES_PRIV" to Kconfig
source "brcm_modules/drivers/video/hantro/Kconfig"
source "brcm_modules/drivers/video/ge/Kconfig"

source "brcm_modules/drivers/char/brcm/hal_cam/Kconfig"

source "brcm_modules/drivers/char/brcm/fuse_ipc/Kconfig"
source "brcm_modules/drivers/char/brcm/fuse_net/Kconfig"
source "brcm_modules/drivers/char/brcm/fuse_at/Kconfig"
source "brcm_modules/drivers/char/brcm/fuse_ril/Kconfig"
source "brcm_modules/drivers/char/brcm/fuse_rpc/Kconfig"
source "brcm_modules/drivers/char/brcm/fuse_log/Kconfig"
source "brcm_modules/drivers/char/brcm/fuse_sysparm/Kconfig"
source "brcm_modules/drivers/char/brcm/fuse_vsp/Kconfig"
source "brcm_modules/drivers/char/brcm/xscript/Kconfig"
source "brcm_modules/drivers/char/brcm/v3d/Kconfig"

source "brcm_modules/drivers/sound/brcm/alsa/Kconfig"
source "brcm_modules/drivers/sound/brcm/alsa_athena/Kconfig"
# Headset module
source "brcm_modules/drivers/sound/brcm/headset/Kconfig"
source "brcm_modules/drivers/gps/brcm/Kconfig"

# video telephony
config VIDEO_TELEPHONY_ENABLE
	boolean "Video Telephony support"
	depends on BRCM_MODULES && BRCM_MODULES_PRIV
	default N
	help
	  Video Telephony support

endif # BRCM_MODULES_PRIV
```

## brcm_modules/drivers/char/brcm/fuse_at/Kconfig
```kconfig
config BRCM_FUSE_AT
	#tristate "Broadcom FUSE ATC drivers"
	boolean "Broadcom FUSE ATC drivers"
	depends on BRCM_MODULES && BRCM_MODULES_PRIV
	default N
	---help---
	  Broadcom FUSE ATC drivers
```

## brcm_modules/drivers/char/brcm/fuse_ipc/Kconfig
```kconfig
config BRCM_FUSE_IPC_2153SDB
	#tristate "Broadcom FUSE IPC drivers 2153SDB"
	boolean "Broadcom FUSE IPC drivers 2153SDB"
	depends on BRCM_MODULES && BRCM_MODULES_PRIV
	default N
	---help---
	  Broadcom FUSE IPC drivers 2153SDB

config BRCM_FUSE_IPC_2157SDB
	#tristate "Broadcom FUSE IPC drivers 2157SDB"
	boolean "Broadcom FUSE IPC drivers 2157SDB"
	depends on BRCM_MODULES && BRCM_MODULES_PRIV
	default N
	---help---
	  Broadcom FUSE IPC drivers 2157SDB
	  
config BRCM_FUSE_IPC_CIB
	#tristate "Broadcom FUSE IPC drivers CIB"
	boolean "Broadcom FUSE IPC drivers CIB"
	depends on BRCM_MODULES && BRCM_MODULES_PRIV
	default N
	---help---
	  Broadcom FUSE IPC drivers CIB
```

## brcm_modules/drivers/char/brcm/fuse_log/Kconfig
```kconfig
config BRCM_FUSE_LOG
	#tristate "Broadcom FUSE LOG drivers"
	boolean "Broadcom FUSE LOG drivers"
	depends on BRCM_MODULES && BRCM_MODULES_PRIV
	default N
	---help---
	  Broadcom FUSE LOG drivers
```

## brcm_modules/drivers/char/brcm/fuse_net/Kconfig
```kconfig
config BRCM_FUSE_NET
	#tristate "Broadcom FUSE NET drivers"
	boolean "Broadcom FUSE NET drivers"
	depends on BRCM_MODULES && BRCM_MODULES_PRIV
	default N
	---help---
	  Broadcom FUSE NET drivers
```

## brcm_modules/drivers/char/brcm/fuse_ril/Kconfig
```kconfig
config BRCM_FUSE_RIL_2153SDB
	#tristate "Broadcom FUSE RIL drivers 2153SDB"
	boolean "Broadcom FUSE RIL drivers 2153SDB"
	depends on BRCM_MODULES && BRCM_MODULES_PRIV
	default N
	---help---
	  Broadcom FUSE RIL drivers 2153 SDB

config BRCM_FUSE_RIL_2157SDB
	#tristate "Broadcom FUSE RIL drivers 2157SDB"
	boolean "Broadcom FUSE RIL drivers 2157SDB"
	depends on BRCM_MODULES && BRCM_MODULES_PRIV
	default N
	---help---
	  Broadcom FUSE RIL drivers 2157SDB

config BRCM_FUSE_RIL_CIB
	#tristate "Broadcom FUSE RIL drivers CIB"
	boolean "Broadcom FUSE RIL drivers CIB"
	depends on BRCM_MODULES && BRCM_MODULES_PRIV
	default N
	---help---
	  Broadcom FUSE RIL drivers CIB

config BRCM_SIM_SECURE_ENABLE
	boolean "Broadcom SIM Secure Enable"
	depends on BRCM_MODULES && BRCM_MODULES_PRIV
	default N
	---help---
	  Broadcom SIM Secure Enable
```

## brcm_modules/drivers/char/brcm/fuse_rpc/Kconfig
```kconfig
config BRCM_FUSE_RPC_2157SDB
	#tristate "Broadcom FUSE RPC drivers 2157SDB"
	boolean "Broadcom FUSE RPC drivers 2157SDB"
	depends on BRCM_MODULES && BRCM_MODULES_PRIV
	default N
	---help---
	  Broadcom FUSE RPC drivers 2157SDB

config BRCM_FUSE_RPC_CIB
	#tristate "Broadcom FUSE RPC drivers CIB"
	boolean "Broadcom FUSE RPC drivers CIB"
	depends on BRCM_MODULES && BRCM_MODULES_PRIV
	default N
	---help---
	  Broadcom FUSE RPC drivers CIB
```

## brcm_modules/drivers/char/brcm/fuse_sysparm/Kconfig
```kconfig
config BRCM_FUSE_SYSPARM
	#tristate "Broadcom FUSE SYSPARM drivers"
	boolean "Broadcom FUSE SYSPARM drivers"
	depends on BRCM_MODULES && BRCM_MODULES_PRIV
	default N
	---help---
	  Broadcom FUSE SYSPARM drivers
```

## brcm_modules/drivers/char/brcm/fuse_vsp/Kconfig
```kconfig
config BRCM_FUSE_VSP
	#tristate "Broadcom FUSE VSP drivers 2157SDB"
	boolean "Broadcom FUSE VSP drivers"
	depends on BRCM_MODULES && BRCM_MODULES_PRIV
	default N
	---help---
	  Broadcom FUSE VSP drivers
```

## brcm_modules/drivers/char/brcm/hal_cam/Kconfig
```kconfig
config BRCM_HAL_CAM
	bool "Broadcom Camera HAL Driver"
	depends on I2C
	depends on BRCM_MODULES && BRCM_MODULES_PRIV
	default Y
	---help---
	  Broadcom Camera HAL Driver


config BRCM_HAL_CAM_WITH_STILL_YUV
	bool "Broadcom Camera HAL Driver for still YUV sensor "
	depends on I2C
	depends on BRCM_MODULES && BRCM_MODULES_PRIV
	default Y
	---help---
	  Broadcom Camera HAL Driver for still YUV sensor

config BCM_CAM_MT9T111
	bool "Camera MT9T111"
	depends on BRCM_HAL_CAM
	default N
	---help---
	Camera driver for MT9T111

config BCM_CAM_STV0986
	bool "Camera STV0986"
	depends on BRCM_HAL_CAM
	depends on BOARD_EXPLORER || ARCH_BCM2153
	default Y
	---help---
	Camera driver for STV0986

config BCM_CAM_STV0987
        bool "Camera STV0987"
        depends on BRCM_HAL_CAM
        depends on ARCH_BCM21553_B0
        default Y
        ---help---
        Camera driver for STV0987

config BCM_CAM_OV2655
	bool "Camera OV2655"
	depends on BRCM_HAL_CAM_WITH_STILL_YUV
	default Y
	---help---
	Camera driver for OV2655
```

## brcm_modules/drivers/char/brcm/v3d/Kconfig
```kconfig
# V3D
config BRCM_V3D
	tristate "Broadcom OpenGL engine support"
	depends on BRCM_MODULES && BRCM_MODULES_PRIV
	default N
	help
	  Broadcom OpenGL engine support
```
