## backports/drivers/net/wireless/mediatek/Kconfig
```kconfig
config BACKPORT_WLAN_VENDOR_MEDIATEK
	bool "MediaTek devices"
	depends on !WLAN_VENDOR_MEDIATEK
	default y
	---help---
	  If you have a wireless card belonging to this class, say Y.

	  Note that the answer to this question doesn't directly affect the
	  kernel: saying N will just cause the configurator to skip all the
	  questions about these cards. If you say Y, you will be asked for
	  your specific card in the following questions.

if BACKPORT_WLAN_VENDOR_MEDIATEK
source "$BACKPORT_DIR/drivers/net/wireless/mediatek/mt7601u/Kconfig"
source "$BACKPORT_DIR/drivers/net/wireless/mediatek/mt76/Kconfig"
endif # BACKPORT_WLAN_VENDOR_MEDIATEK
```

## backports/drivers/net/wireless/mediatek/mt76/Kconfig
```kconfig
config BACKPORT_MT76_CORE
	tristate
	depends on !MT76_CORE

config BACKPORT_MT76_USB
	tristate
	depends on !MT76_USB
	depends on BACKPORT_MT76_CORE

config BACKPORT_MT76x2_COMMON
	tristate
	depends on !MT76x2_COMMON
	depends on BACKPORT_MT76_CORE

config BACKPORT_MT76x0U
	tristate "MediaTek MT76x0U (USB) support"
	depends on !MT76x0U
	select BACKPORT_MT76_CORE
	depends on BACKPORT_MAC80211
	depends on USB
	help
	  This adds support for MT7610U-based wireless USB dongles.

config BACKPORT_MT76x2E
	tristate "MediaTek MT76x2E (PCIe) support"
	depends on !MT76x2E
	select BACKPORT_MT76_CORE
	select BACKPORT_MT76x2_COMMON
	depends on BACKPORT_MAC80211
	depends on PCI
	---help---
	  This adds support for MT7612/MT7602/MT7662-based wireless PCIe devices.

config BACKPORT_MT76x2U
	tristate "MediaTek MT76x2U (USB) support"
	depends on !MT76x2U
	select BACKPORT_MT76_CORE
	select BACKPORT_MT76_USB
	select BACKPORT_MT76x2_COMMON
	depends on BACKPORT_MAC80211
	depends on USB
	help
	  This adds support for MT7612U-based wireless USB dongles.
```

## backports/drivers/net/wireless/mediatek/mt7601u/Kconfig
```kconfig
config BACKPORT_MT7601U
	tristate "MediaTek MT7601U (USB) support"
	depends on !MT7601U
	depends on BACKPORT_MAC80211
	depends on USB
	---help---
	  This adds support for BACKPORT_MT7601U-based wireless USB dongles.
```

## backports/drivers/net/wireless/quantenna/Kconfig
```kconfig
config BACKPORT_WLAN_VENDOR_QUANTENNA
	bool "Quantenna wireless cards support"
	depends on !WLAN_VENDOR_QUANTENNA
	default y
	---help---
	  If you have a wireless card belonging to this class, say Y.

	  Note that the answer to this question doesn't directly affect the
	  kernel: saying N will just cause the configurator to skip all the
	  questions about these cards. If you say Y, you will be asked for
	  your specific card in the following questions.

if BACKPORT_WLAN_VENDOR_QUANTENNA

source "$BACKPORT_DIR/drivers/net/wireless/quantenna/qtnfmac/Kconfig"

endif # BACKPORT_WLAN_VENDOR_QUANTENNA
```

## backports/drivers/net/wireless/quantenna/qtnfmac/Kconfig
```kconfig
config BACKPORT_QTNFMAC
	tristate
	depends on !QTNFMAC
	depends on BACKPORT_QTNFMAC_PEARL_PCIE
	default m if BACKPORT_QTNFMAC_PEARL_PCIE=m
	default y if BACKPORT_QTNFMAC_PEARL_PCIE=y

config BACKPORT_QTNFMAC_PEARL_PCIE
	tristate "Quantenna QSR10g PCIe support"
	depends on !QTNFMAC_PEARL_PCIE
	default n
	depends on PCI && BACKPORT_CFG80211
	select BACKPORT_QTNFMAC
	depends on FW_LOADER
	depends on CRC32
	---help---
	  This option adds support for wireless adapters based on Quantenna
	  802.11ac QSR10g (aka Pearl) FullMAC chipset running over PCIe.

	  If you choose to build it as a module, two modules will be built:
	  qtnfmac.ko and qtnfmac_pearl_pcie.ko.
```

## backports/drivers/net/wireless/realtek/Kconfig
```kconfig
config BACKPORT_WLAN_VENDOR_REALTEK
	bool "Realtek devices"
	depends on !WLAN_VENDOR_REALTEK
	default y
	---help---
	  If you have a wireless card belonging to this class, say Y.

	  Note that the answer to this question doesn't directly affect the
	  kernel: saying N will just cause the configurator to skip all the
	  questions about these cards. If you say Y, you will be asked for
	  your specific card in the following questions.

if BACKPORT_WLAN_VENDOR_REALTEK

source "$BACKPORT_DIR/drivers/net/wireless/realtek/rtl818x/Kconfig"
source "$BACKPORT_DIR/drivers/net/wireless/realtek/rtlwifi/Kconfig"
source "$BACKPORT_DIR/drivers/net/wireless/realtek/rtl8xxxu/Kconfig"

endif # BACKPORT_WLAN_VENDOR_REALTEK
```

## backports/drivers/net/wireless/rsi/Kconfig
```kconfig
config BACKPORT_WLAN_VENDOR_RSI
	bool "Redpine Signals Inc devices"
	depends on !WLAN_VENDOR_RSI
	default y
	---help---
	  If you have a wireless card belonging to this class, say Y.

	  Note that the answer to this question doesn't directly affect the
	  kernel: saying N will just cause the configurator to skip all the
	  questions about these cards. If you say Y, you will be asked for
	  your specific card in the following questions.

if BACKPORT_WLAN_VENDOR_RSI

config BACKPORT_RSI_91X
	tristate "Redpine Signals Inc 91x WLAN driver support"
	depends on !RSI_91X
	select BT_HCIRSI if BACKPORT_RSI_COEX
	depends on BACKPORT_MAC80211
	---help---
	  This option enabes support for RSI 1x1 devices.
	  Select M (recommended), if you have a RSI 1x1 wireless module.

config BACKPORT_RSI_DEBUGFS
	bool "Redpine Signals Inc debug support"
	depends on !RSI_DEBUGFS
	depends on BACKPORT_RSI_91X
	default y
	---help---
	 Say Y, if you would like to enable debug support. This option
	 creates debugfs entries

config BACKPORT_RSI_SDIO
	tristate "Redpine Signals SDIO bus support"
	depends on !RSI_SDIO
	depends on MMC && BACKPORT_RSI_91X
	default m
	---help---
	  This option enables the SDIO bus support in rsi drivers.
	  Select M (recommended), if you have a RSI 1x1 wireless module.

config BACKPORT_RSI_USB
	tristate "Redpine Signals USB bus support"
	depends on !RSI_USB
	depends on USB && BACKPORT_RSI_91X
	default m
	---help---
	  This option enables the USB bus support in rsi drivers.
	  Select M (recommended), if you have a RSI 1x1 wireless module.

config BACKPORT_RSI_COEX
	bool "Redpine Signals WLAN BT Coexistence support"
	depends on !RSI_COEX
	depends on BT && BACKPORT_RSI_91X
	depends on !(BT=m && BACKPORT_RSI_91X=y)
	default y
	---help---
	  This option enables the BACKPORT_WLAN BT coex support in rsi drivers.
	  Select M (recommended), if you have want to use this feature
	  and you have RS9113 module.

endif # BACKPORT_WLAN_VENDOR_RSI
```

## backports/drivers/net/wireless/st/Kconfig
```kconfig
config BACKPORT_WLAN_VENDOR_ST
	bool "STMicroelectronics devices"
	depends on !WLAN_VENDOR_ST
	default y
	---help---
	  If you have a wireless card belonging to this class, say Y.

	  Note that the answer to this question doesn't directly affect the
	  kernel: saying N will just cause the configurator to skip all the
	  questions about these cards. If you say Y, you will be asked for
	  your specific card in the following questions.

if BACKPORT_WLAN_VENDOR_ST

source "$BACKPORT_DIR/drivers/net/wireless/st/cw1200/Kconfig"

endif # BACKPORT_WLAN_VENDOR_ST
```

## backports/drivers/net/wireless/ti/Kconfig
```kconfig
config BACKPORT_WLAN_VENDOR_TI
	bool "Texas Instrument devices"
	depends on !WLAN_VENDOR_TI
	default y
	---help---
	  If you have a wireless card belonging to this class, say Y.

	  Note that the answer to this question doesn't directly affect the
	  kernel: saying N will just cause the configurator to skip all the
	  questions about these cards. If you say Y, you will be asked for
	  your specific card in the following questions.

if BACKPORT_WLAN_VENDOR_TI
source "$BACKPORT_DIR/drivers/net/wireless/ti/wl1251/Kconfig"
source "$BACKPORT_DIR/drivers/net/wireless/ti/wl12xx/Kconfig"
source "$BACKPORT_DIR/drivers/net/wireless/ti/wl18xx/Kconfig"

# keep last for automatic dependencies
source "$BACKPORT_DIR/drivers/net/wireless/ti/wlcore/Kconfig"

config BACKPORT_WILINK_PLATFORM_DATA
	bool "TI WiLink platform data"
	depends on !WILINK_PLATFORM_DATA
	depends on WLCORE_SDIO || BACKPORT_WL1251_SDIO
	default y
	---help---
	Small platform data bit needed to pass data to the sdio modules.


endif # BACKPORT_WLAN_VENDOR_TI
```

## backports/drivers/ssb/Kconfig
```kconfig
config BACKPORT_SSB_POSSIBLE
	bool
	depends on !SSB_POSSIBLE
	depends on HAS_IOMEM && HAS_DMA
	default y

menuconfig BACKPORT_SSB
	tristate "Sonics Silicon Backplane support"
	depends on !SSB
	depends on BACKPORT_SSB_POSSIBLE
	help
	  Support for the Sonics Silicon Backplane bus.
	  You only need to enable this option, if you are
	  configuring a kernel for an embedded system with
	  this bus.
	  It will be auto-selected if needed in other
	  environments.

	  The module will be called ssb.

	  If unsure, say N.

if BACKPORT_SSB

# Common SPROM support routines
config BACKPORT_SSB_SPROM
	bool
	depends on !SSB_SPROM

# Support for Block-I/O. SELECT this from the driver that needs it.
config BACKPORT_SSB_BLOCKIO
	bool
	depends on !SSB_BLOCKIO
	depends on BACKPORT_SSB

config BACKPORT_SSB_PCIHOST_POSSIBLE
	bool
	depends on !SSB_PCIHOST_POSSIBLE
	depends on BACKPORT_SSB && (PCI = y || PCI = BACKPORT_SSB) && (PCI_DRIVERS_LEGACY || !MIPS)
	default y

config BACKPORT_SSB_PCIHOST
	bool "Support for SSB on PCI-bus host"
	depends on !SSB_PCIHOST
	depends on BACKPORT_SSB_PCIHOST_POSSIBLE
	select BACKPORT_SSB_SPROM
	default y
	help
	  Support for a Sonics Silicon Backplane on top
	  of a PCI device.

	  If unsure, say Y

config BACKPORT_SSB_B43_PCI_BRIDGE
	bool
	depends on !SSB_B43_PCI_BRIDGE
	depends on BACKPORT_SSB_PCIHOST
	default n

config BACKPORT_SSB_PCMCIAHOST_POSSIBLE
	bool
	depends on !SSB_PCMCIAHOST_POSSIBLE
	depends on BACKPORT_SSB && (PCMCIA = y || PCMCIA = BACKPORT_SSB)
	default y

config BACKPORT_SSB_PCMCIAHOST
	bool "Support for SSB on PCMCIA-bus host"
	depends on !SSB_PCMCIAHOST
	depends on BACKPORT_SSB_PCMCIAHOST_POSSIBLE
	select BACKPORT_SSB_SPROM
	help
	  Support for a Sonics Silicon Backplane on top
	  of a PCMCIA device.

	  If unsure, say N

config BACKPORT_SSB_SDIOHOST_POSSIBLE
	bool
	depends on !SSB_SDIOHOST_POSSIBLE
	depends on BACKPORT_SSB && (MMC = y || MMC = BACKPORT_SSB)
	default y

config BACKPORT_SSB_SDIOHOST
	bool "Support for SSB on SDIO-bus host"
	depends on !SSB_SDIOHOST
	depends on BACKPORT_SSB_SDIOHOST_POSSIBLE
	help
	  Support for a Sonics Silicon Backplane on top
	  of a SDIO device.

	  If unsure, say N

config BACKPORT_SSB_HOST_SOC
	bool "Support for SSB bus on SoC"
	depends on !SSB_HOST_SOC
	depends on BACKPORT_SSB && BCM47XX_NVRAM
	select BACKPORT_SSB_SPROM
	help
	  Host interface for a BACKPORT_SSB directly mapped into memory. This is
	  for some Broadcom SoCs from the BCM47xx and BCM53xx lines.

	  If unsure, say N

config BACKPORT_SSB_SERIAL
	bool
	depends on !SSB_SERIAL
	depends on BACKPORT_SSB
	# ChipCommon and ExtIf serial support routines.

config BACKPORT_SSB_DRIVER_PCICORE_POSSIBLE
	bool
	depends on !SSB_DRIVER_PCICORE_POSSIBLE
	depends on BACKPORT_SSB_PCIHOST
	default y

config BACKPORT_SSB_DRIVER_PCICORE
	bool "SSB PCI core driver"
	depends on !SSB_DRIVER_PCICORE
	depends on BACKPORT_SSB_DRIVER_PCICORE_POSSIBLE
	help
	  Driver for the Sonics Silicon Backplane attached
	  Broadcom PCI core.

	  If unsure, say Y

config BACKPORT_SSB_PCICORE_HOSTMODE
	bool "Hostmode support for SSB PCI core"
	depends on !SSB_PCICORE_HOSTMODE
	depends on BACKPORT_SSB_DRIVER_PCICORE && BACKPORT_SSB_DRIVER_MIPS && BACKPORT_SSB = y
	help
	  PCIcore hostmode operation (external PCI bus).

config BACKPORT_SSB_DRIVER_MIPS
	bool "SSB Broadcom MIPS core driver"
	depends on !SSB_DRIVER_MIPS
	depends on BACKPORT_SSB && MIPS
	select BACKPORT_SSB_SERIAL
	select BACKPORT_SSB_SFLASH
	help
	  Driver for the Sonics Silicon Backplane attached
	  Broadcom MIPS core.

	  If unsure, say N

config BACKPORT_SSB_SFLASH
	bool "SSB serial flash support"
	depends on !SSB_SFLASH
	depends on BACKPORT_SSB_DRIVER_MIPS
	default y

# Assumption: We are on embedded, if we compile the MIPS core.
config BACKPORT_SSB_EMBEDDED
	bool
	depends on !SSB_EMBEDDED
	depends on BACKPORT_SSB_DRIVER_MIPS && BACKPORT_SSB_PCICORE_HOSTMODE
	default y

config BACKPORT_SSB_DRIVER_EXTIF
	bool "SSB Broadcom EXTIF core driver"
	depends on !SSB_DRIVER_EXTIF
	depends on BACKPORT_SSB_DRIVER_MIPS
	help
	  Driver for the Sonics Silicon Backplane attached
	  Broadcom EXTIF core.

	  If unsure, say N

config BACKPORT_SSB_DRIVER_GIGE
	bool "SSB Broadcom Gigabit Ethernet driver"
	depends on !SSB_DRIVER_GIGE
	depends on BACKPORT_SSB_PCIHOST_POSSIBLE && BACKPORT_SSB_EMBEDDED && MIPS
	help
	  Driver for the Sonics Silicon Backplane attached
	  Broadcom Gigabit Ethernet.

	  If unsure, say N

config BACKPORT_SSB_DRIVER_GPIO
	bool "SSB GPIO driver"
	depends on !SSB_DRIVER_GPIO
	depends on BACKPORT_SSB && GPIOLIB
	select IRQ_DOMAIN if BACKPORT_SSB_EMBEDDED
	help
	  Driver to provide access to the GPIO pins on the bus.

	  If unsure, say N

endif # BACKPORT_SSB
```

## backports/drivers/staging/rtl8188eu/Kconfig
```kconfig
config BACKPORT_R8188EU
	tristate "Realtek RTL8188EU Wireless LAN NIC driver"
	depends on !R8188EU
	depends on WLAN && USB && BACKPORT_CFG80211
	depends on m
	depends on WIRELESS_EXT
	depends on WEXT_PRIV
	select BACKPORT_LIB80211
	select BACKPORT_LIB80211_CRYPT_WEP
	select BACKPORT_LIB80211_CRYPT_CCMP
	---help---
	This option adds the Realtek RTL8188EU USB device such as TP-Link TL-WN725N.
	If built as a module, it will be called r8188eu.

if BACKPORT_R8188EU

config BACKPORT_88EU_AP_MODE
	bool "Realtek RTL8188EU AP mode"
	depends on !88EU_AP_MODE
	default y
	---help---
	This option enables Access Point mode. Unless you know that your system
	will never be used as an AP, or the target system has limited memory,
	"Y" should be selected.

endif
```

## backports/drivers/staging/rtl8723bs/Kconfig
```kconfig
config BACKPORT_RTL8723BS
	tristate "Realtek RTL8723BS SDIO Wireless LAN NIC driver"
	depends on !RTL8723BS
	depends on WLAN && MMC && BACKPORT_CFG80211
	depends on m
	depends on WIRELESS_EXT
	depends on WEXT_PRIV
	---help---
	This option enables support for BACKPORT_RTL8723BS SDIO drivers, such as
	the wifi found on the 1st gen Intel Compute Stick, the CHIP
	and many other Intel Atom and ARM based devices.
	If built as a module, it will be called r8723bs.
```

## backports/drivers/staging/rtlwifi/Kconfig
```kconfig
config BACKPORT_R8822BE
	tristate "Realtek RTL8822BE Wireless Network Adapter"
	depends on !R8822BE
	depends on PCI && BACKPORT_MAC80211 && m
	depends on FW_LOADER
	---help---
	This is the staging driver for Realtek RTL8822BE 802.11ac PCIe
	wireless network adapters.

config BACKPORT_RTLWIFI_DEBUG_ST
	bool
	depends on !RTLWIFI_DEBUG_ST
	depends on BACKPORT_R8822BE
	default y
```

## brcm_modules/Kconfig
```kconfig
menuconfig BRCM_MODULES
	tristate "Broadcom Kernel Modules"
	default N
	help
	  Broadcom Kernel Modules

if BRCM_MODULES

# source Kconfig for opensource drivers here
# add "depends on BRCM_MODULES" to Kconfig




# source Kconfig for proprietary drivers in "Kconfig.priv"
# add "depends on BRCM_MODULES && BRCM_MODULES_PRIV" to Kconfig
source "brcm_modules/Kconfig.priv"
endif # BRCM_MODULES
```
