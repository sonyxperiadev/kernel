## Documentation/devicetree/bindings/regulator/willsemi,wl2868c.yaml
```yaml
# SPDX-License-Identifier: GPL-2.0-only OR BSD-2-Clause
%YAML 1.2
---
$id: http://devicetree.org/schemas/regulator/willsemi,wl2868c.yaml#
$schema: http://devicetree.org/meta-schemas/core.yaml#

title: Will Semiconductor WL2868C regulator

maintainers:
  - Sebastian Raase <sebastian.raase@sony.com>

description: |
  The WL2868C is a 7-channel LDO PMIC for Camera Applications
  controlled through an I2C interface.

  LDO1 and LDO2 have an input range of 0.6V to 3V, an output
  range of 0.496V to 1.512V and an output current of up to 1.2A
  LDO3 to LDO7 have an input range of 2.1V to 5.5V, an output
  range of 1.504V to 3.544V and an output current of up to 0.4A.

  The regulators are sub-nodes of the "willsemi,wl2868c" device,
  which is a sub-node of the I2C bus it is connected to.

properties:
  compatible:
    enum:
      - willsemi,wl2868c

  reg:
    maxItems: 1

  rstn-gpio:
    description: |
      GPIO for controlling the RSTN line.
      If this property is missing, RSTN is
      assumed to be permanently high.

  vin12-supply:
    description: |
      Supply for LDO1 and LDO2.

  vin34-supply:
    description: |
      Supply for LDO3 and LDO4.

  vin5-supply:
    description: |
      Supply for LDO5.

  vin6-supply:
    description: |
      Supply for LDO6.

  vin7-supply:
    description: |
      Supply for LDO7.

  regulators:
    type: object
    $ref: regulator.yaml#

    description: |
      List of regulators provided by this driver.
      Must be named ldo[1-7].

    patternProperties:
      "^ldo[1-7]$":
        type: object
        $ref: regulator.yaml#
        unevaluatedProperties: false

  additionalProperties: false

additionalProperties: false

required:
  - compatible
  - reg
  - regulators

examples:
  - |
    i2c {
        wl2868c@2F {
            compatible = "willsemi,wl2868c";
            reg = <0x2F>;

            rstn-gpio = <&tlmm 58 0>;

            vin12-supply = <&cam_vdig>;
            vin34-supply = <&cam_vana>;
            vin5-supply  = <&cam_vaf1>;
            vin6-supply  = <&cam_vaf2>;
            vin7-supply  = <&cam_vio>;

            #address-cells = <0>;
            #size-cells = <0>;
            regulators {
                wl2868c_ldo1: ldo1 {
                    regulator-name = "cam-dvdd1";
                    regulator-min-microvolt = <496000>;
                    regulator-max-microvolt = <1512000>;
                };

                wl2868c_ldo2: ldo2 {
                    regulator-name = "cam-dvdd2";
                    regulator-min-microvolt = <496000>;
                    regulator-max-microvolt = <1512000>;
                };

                wl2868c_ldo3: ldo3 {
                    regulator-name = "cam-avdd1";
                    regulator-min-microvolt = <1504000>;
                    regulator-max-microvolt = <3544000>;
                };

                wl2868c_ldo4: ldo4 {
                    regulator-name = "cam-avdd2";
                    regulator-min-microvolt = <1504000>;
                    regulator-max-microvolt = <3544000>;
                };

                wl2868c_ldo5: ldo5 {
                    regulator-name = "cam-vddaf";
                    regulator-min-microvolt = <1504000>;
                    regulator-max-microvolt = <3544000>;
                };

                wl2868c_ldo6: ldo6 {
                    regulator-name = "cam-vddois";
                    regulator-min-microvolt = <1504000>;
                    regulator-max-microvolt = <3544000>;
                };

                wl2868c_ldo7: ldo7 {
                    regulator-name = "cam-vddio";
                    regulator-min-microvolt = <1504000>;
                    regulator-max-microvolt = <3544000>;
                };
            };
        };
    };
...
```

## arch/arm/configs/bcm23550_java_sony_kivu_020_defconfig
```kconfig
# CONFIG_ARM_PATCH_PHYS_VIRT is not set
CONFIG_PHYS_OFFSET=0x81E00000
# CONFIG_LOCALVERSION_AUTO is not set
# CONFIG_SWAP is not set
CONFIG_SYSVIPC=y
CONFIG_NO_HZ=y
CONFIG_HIGH_RES_TIMERS=y
CONFIG_IKCONFIG=y
CONFIG_LOG_BUF_SHIFT=19
CONFIG_LOGBUF_NONCACHE=y
CONFIG_CGROUPS=y
CONFIG_CGROUP_DEVICE=y
CONFIG_CPUSETS=y
CONFIG_CGROUP_CPUACCT=y
CONFIG_RESOURCE_COUNTERS=y
CONFIG_CGROUP_SCHED=y
CONFIG_RT_GROUP_SCHED=y
CONFIG_BLK_CGROUP=y
CONFIG_BLK_DEV_INITRD=y
CONFIG_CC_OPTIMIZE_FOR_SIZE=y
CONFIG_PANIC_TIMEOUT=3
CONFIG_SYSCTL_SYSCALL=y
CONFIG_EMBEDDED=y
CONFIG_SLAB=y
CONFIG_PROFILING=y
CONFIG_OPROFILE=y
CONFIG_MODULES=y
CONFIG_MODULE_FORCE_LOAD=y
CONFIG_MODULE_UNLOAD=y
CONFIG_MODVERSIONS=y
CONFIG_MODULE_SRCVERSION_ALL=y
# CONFIG_LBDAF is not set
# CONFIG_BLK_DEV_BSG is not set
CONFIG_PARTITION_ADVANCED=y
# CONFIG_IOSCHED_DEADLINE is not set
CONFIG_ARCH_KONA=y
CONFIG_DELAYED_PM_INIT=y
CONFIG_PWRMGR_1P2GHZ_OPS_SET_SELECT=y
CONFIG_PI_MGR_MM_STURBO_ENABLE=y
CONFIG_MM_312M_SOURCE_CLK=y
CONFIG_HAWAII_PTM=y
CONFIG_MACH_JAVA_SONY=y
CONFIG_MACH_JAVA_KIVU=y
CONFIG_DORMANT_MODE=y
CONFIG_USE_JAVA_SPINLOCK=y
CONFIG_ARCH_JAVA=y
CONFIG_DMAC_PL330=y
CONFIG_BCM_ZRELADDR=0x81E08000
CONFIG_BCM_PARAMS_PHYS=0x81E00100
CONFIG_BCM_RAM_BASE=0x80000000
CONFIG_BCM_RAM_START_RESERVED_SIZE=0x01E00000
CONFIG_KONA_CPU_PM_HANDLER=y
CONFIG_KONA_CPU_FREQ_DRV=y
CONFIG_KONA_CPU_FREQ_LIMITS=y
CONFIG_KONA_POWER_MGR=y
CONFIG_KONA_PI_DFS_STATS=y
CONFIG_KONA_PWRMGR_REV2=y
CONFIG_KONA_I2C_SEQUENCER_LOG=y
CONFIG_KONA_MEMC=y
CONFIG_MEMC_DFS=y
CONFIG_MEMC_FORCE_156M_IN_SUSPEND=y
CONFIG_BRCM_CDC=y
CONFIG_KONA_ATAG_DT=y
CONFIG_KONA_ATAG_DT_DTS_FILE="Java"
CONFIG_PROC_PINMUX_DUMP=y
CONFIG_KONA_PROFILER=y
CONFIG_KONA_AXITRACE=y
# CONFIG_SWP_EMULATE is not set
# CONFIG_CACHE_L2X0 is not set
CONFIG_ARM_ERRATA_743622=y
CONFIG_ARM_ERRATA_751472=y
CONFIG_ARM_ERRATA_754322=y
CONFIG_ARM_ERRATA_764369=y
CONFIG_ARM_ERRATA_782773=y
CONFIG_SMP=y
# CONFIG_SMP_ON_UP is not set
CONFIG_PREEMPT=y
CONFIG_AEABI=y
# CONFIG_OABI_COMPAT is not set
CONFIG_HIGHMEM=y
# CONFIG_BOUNCE is not set
CONFIG_ZBOOT_ROM_TEXT=0x0
CONFIG_ZBOOT_ROM_BSS=0x0
CONFIG_CMDLINE="console=ttyS0,115200n8 mem=456M gpt v3d_mem=67108864 pmem=24M@0x9E800000"
CONFIG_CPU_FREQ=y
CONFIG_CPU_FREQ_GOV_POWERSAVE=y
CONFIG_CPU_FREQ_GOV_ONDEMAND=y
CONFIG_CPU_FREQ_GOV_INTERACTIVE=y
CONFIG_CPU_FREQ_GOV_CONSERVATIVE=y
CONFIG_CPU_IDLE=y
CONFIG_VFP=y
CONFIG_NEON=y
# CONFIG_CORE_DUMP_DEFAULT_ELF_HEADERS is not set
CONFIG_PM_AUTOSLEEP=y
CONFIG_PM_WAKELOCKS=y
CONFIG_PM_RUNTIME=y
CONFIG_PM_DEBUG=y
CONFIG_PM_TEST_SUSPEND=y
CONFIG_NET=y
CONFIG_PACKET=y
CONFIG_UNIX=y
CONFIG_XFRM_USER=y
CONFIG_NET_KEY=y
CONFIG_INET=y
CONFIG_IP_MULTICAST=y
CONFIG_IP_ADVANCED_ROUTER=y
CONFIG_IP_MULTIPLE_TABLES=y
CONFIG_IP_ROUTE_MULTIPATH=y
CONFIG_IP_ROUTE_VERBOSE=y
CONFIG_IP_PNP=y
CONFIG_IP_PNP_DHCP=y
CONFIG_NET_IPIP=y
CONFIG_IP_MROUTE=y
CONFIG_IP_PIMSM_V1=y
CONFIG_IP_PIMSM_V2=y
CONFIG_SYN_COOKIES=y
CONFIG_INET_AH=y
CONFIG_INET_ESP=y
CONFIG_INET_IPCOMP=y
CONFIG_IPV6=y
CONFIG_IPV6_PRIVACY=y
CONFIG_IPV6_ROUTER_PREF=y
CONFIG_IPV6_OPTIMISTIC_DAD=y
CONFIG_INET6_AH=y
CONFIG_INET6_ESP=y
CONFIG_INET6_IPCOMP=y
CONFIG_IPV6_MIP6=y
CONFIG_IPV6_TUNNEL=y
CONFIG_IPV6_MULTIPLE_TABLES=y
CONFIG_NETFILTER=y
CONFIG_NF_CONNTRACK=y
CONFIG_NF_CONNTRACK_EVENTS=y
CONFIG_NF_CT_PROTO_DCCP=y
CONFIG_NF_CT_PROTO_SCTP=y
CONFIG_NF_CT_PROTO_UDPLITE=y
CONFIG_NF_CONNTRACK_AMANDA=y
CONFIG_NF_CONNTRACK_FTP=y
CONFIG_NF_CONNTRACK_H323=y
CONFIG_NF_CONNTRACK_IRC=y
CONFIG_NF_CONNTRACK_NETBIOS_NS=y
CONFIG_NF_CONNTRACK_PPTP=y
CONFIG_NF_CONNTRACK_SANE=y
CONFIG_NF_CONNTRACK_TFTP=y
CONFIG_NF_CT_NETLINK=y
CONFIG_NETFILTER_TPROXY=y
CONFIG_NETFILTER_XT_TARGET_CLASSIFY=y
CONFIG_NETFILTER_XT_TARGET_CONNMARK=y
CONFIG_NETFILTER_XT_TARGET_MARK=y
CONFIG_NETFILTER_XT_TARGET_NFLOG=y
CONFIG_NETFILTER_XT_TARGET_NFQUEUE=y
CONFIG_NETFILTER_XT_TARGET_TPROXY=y
CONFIG_NETFILTER_XT_TARGET_TRACE=y
CONFIG_NETFILTER_XT_TARGET_TCPMSS=y
CONFIG_NETFILTER_XT_MATCH_COMMENT=y
CONFIG_NETFILTER_XT_MATCH_CONNBYTES=y
CONFIG_NETFILTER_XT_MATCH_CONNLIMIT=y
CONFIG_NETFILTER_XT_MATCH_CONNMARK=y
CONFIG_NETFILTER_XT_MATCH_CONNTRACK=y
CONFIG_NETFILTER_XT_MATCH_HASHLIMIT=y
CONFIG_NETFILTER_XT_MATCH_HELPER=y
CONFIG_NETFILTER_XT_MATCH_IPRANGE=y
CONFIG_NETFILTER_XT_MATCH_IPVS=y
CONFIG_NETFILTER_XT_MATCH_LENGTH=y
CONFIG_NETFILTER_XT_MATCH_LIMIT=y
CONFIG_NETFILTER_XT_MATCH_MAC=y
CONFIG_NETFILTER_XT_MATCH_MARK=y
CONFIG_NETFILTER_XT_MATCH_MULTIPORT=y
CONFIG_NETFILTER_XT_MATCH_POLICY=y
CONFIG_NETFILTER_XT_MATCH_PKTTYPE=y
CONFIG_NETFILTER_XT_MATCH_QTAGUID=y
CONFIG_NETFILTER_XT_MATCH_QUOTA=y
CONFIG_NETFILTER_XT_MATCH_QUOTA2=y
CONFIG_NETFILTER_XT_MATCH_QUOTA2_LOG=y
CONFIG_NETFILTER_XT_MATCH_SOCKET=y
CONFIG_NETFILTER_XT_MATCH_STATE=y
CONFIG_NETFILTER_XT_MATCH_STATISTIC=y
CONFIG_NETFILTER_XT_MATCH_STRING=y
CONFIG_NETFILTER_XT_MATCH_TIME=y
CONFIG_NETFILTER_XT_MATCH_U32=y
CONFIG_IP_VS=y
CONFIG_NF_CONNTRACK_IPV4=y
CONFIG_IP_NF_IPTABLES=y
CONFIG_IP_NF_MATCH_AH=y
CONFIG_IP_NF_MATCH_ECN=y
CONFIG_IP_NF_MATCH_TTL=y
CONFIG_IP_NF_FILTER=y
CONFIG_IP_NF_TARGET_REJECT=y
CONFIG_IP_NF_TARGET_REJECT_SKERR=y
CONFIG_IP_NF_MANGLE=y
CONFIG_IP_NF_RAW=y
CONFIG_IP_NF_ARPTABLES=y
CONFIG_IP_NF_ARPFILTER=y
CONFIG_IP_NF_ARP_MANGLE=y
CONFIG_NF_CONNTRACK_IPV6=y
CONFIG_IP6_NF_IPTABLES=y
CONFIG_IP6_NF_FILTER=y
CONFIG_IP6_NF_TARGET_REJECT=y
CONFIG_IP6_NF_TARGET_REJECT_SKERR=y
CONFIG_IP6_NF_MANGLE=y
CONFIG_IP6_NF_RAW=y
CONFIG_L2TP=y
CONFIG_BRIDGE=y
CONFIG_PHONET=y
CONFIG_NET_SCHED=y
CONFIG_NET_SCH_HTB=y
CONFIG_NET_SCH_INGRESS=y
CONFIG_NET_CLS_U32=y
CONFIG_NET_EMATCH=y
CONFIG_NET_EMATCH_U32=y
CONFIG_NET_CLS_ACT=y
CONFIG_NET_ACT_POLICE=y
CONFIG_NET_ACT_GACT=y
CONFIG_NET_ACT_MIRRED=y
CONFIG_CFG80211=y
CONFIG_NL80211_TESTMODE=y
CONFIG_CFG80211_DEVELOPER_WARNINGS=y
CONFIG_CFG80211_REG_DEBUG=y
CONFIG_CFG80211_DEBUGFS=y
CONFIG_CFG80211_INTERNAL_REGDB=y
CONFIG_CFG80211_WEXT=y
CONFIG_MAC80211=y
CONFIG_RFKILL=y
CONFIG_NFC=y
CONFIG_BCMI2CNFC=y
CONFIG_UEVENT_HELPER_PATH="/sbin/hotplug"
CONFIG_CMA=y
CONFIG_CMA_DEBUG_FS=y
CONFIG_CMA_ALIGNMENT=4
CONFIG_BLK_DEV_LOOP=y
CONFIG_BLK_DEV_CRYPTOLOOP=y
CONFIG_SENSORS_TMD2771=y
CONFIG_SENSORS_BH1721FVC=y
CONFIG_SENSORS_BMP18X=y
CONFIG_SENSORS_BMP18X_I2C=y
CONFIG_SENSORS_KXTIK1004=y
CONFIG_UID_STAT=y
CONFIG_BCMPMU_AUDIO=y
CONFIG_RECOVERY=y
CONFIG_BCM_BT_RFKILL=y
CONFIG_BCM_BT_LPM=y
# CONFIG_BCM_GPS_KERNEL is not set
CONFIG_BCM_USERFAULT_HANDLER=y
CONFIG_STM_TRACE=y
CONFIG_STM_PRINTK=y
CONFIG_BRCM_EMMC_RPMB=y
CONFIG_BRCM_EMMC_RPMB_SUPPORT=y
CONFIG_BRCM_EMMC_RPMB_KEYBOX=y
CONFIG_SCSI=y
CONFIG_BLK_DEV_SD=y
CONFIG_CHR_DEV_ST=y
CONFIG_CHR_DEV_SG=y
CONFIG_MD=y
CONFIG_BLK_DEV_DM=y
CONFIG_DM_CRYPT=y
CONFIG_DM_UEVENT=y
CONFIG_NETDEVICES=y
CONFIG_MII=y
CONFIG_TUN=y
CONFIG_PHYLIB=y
CONFIG_PPP=y
CONFIG_PPP_BSDCOMP=y
CONFIG_PPP_DEFLATE=y
CONFIG_PPP_FILTER=y
CONFIG_PPP_MPPE=y
CONFIG_PPP_MULTILINK=y
CONFIG_PPPOE=y
CONFIG_PPPOL2TP=y
CONFIG_PPPOLAC=y
CONFIG_PPPOPNS=y
CONFIG_PPP_ASYNC=y
CONFIG_PPP_SYNC_TTY=y
CONFIG_WIFI_CONTROL_FUNC=y
CONFIG_BRCM_UNIFIED_DHD_SUPPORT=y
CONFIG_BROADCOM_WIFI_RESERVED_MEM=y
CONFIG_TARGET_LOCALE_CHN=y
CONFIG_BCMDHD=y
CONFIG_BCMDHD_GENERIC_CHIP_SUPPORT=y
# CONFIG_BCM4330 is not set
# CONFIG_BCM4334 is not set
# CONFIG_BCM4335 is not set
# CONFIG_BCM4339 is not set
# CONFIG_BCM43241 is not set
# CONFIG_BCM43341 is not set
CONFIG_BCMDHD_FW_PATH="/system/vendor/firmware/fw_wifi_43341.bin"
CONFIG_BCMDHD_NVRAM_PATH="/system/vendor/firmware/fw_wifi_nvram_43341.txt"
# CONFIG_DHD_USE_STATIC_BUF is not set
# CONFIG_DHD_USE_SCHED_SCAN is not set
CONFIG_BRCM_NETCONSOLE=y
CONFIG_BRCM_NETCONSOLE_DYNAMIC=y
CONFIG_INPUT_EVDEV=y
# CONFIG_KEYBOARD_ATKBD is not set
CONFIG_INPUT_TOUCHSCREEN=y
CONFIG_TOUCHSCREEN_CYTTSP_CORE=y
CONFIG_TOUCHSCREEN_CYTTSP_I2C=y
CONFIG_INPUT_MISC=y
CONFIG_INPUT_LSM303DLH_MAGNETOMETER=y
CONFIG_INPUT_LSM303DLHC_ACCELEROMETER=y
CONFIG_INPUT_L3G4200D=y
CONFIG_INPUT_KEYCHORD=y
CONFIG_INPUT_UINPUT=y
CONFIG_INPUT_APDS9702=y
CONFIG_INPUT_PONKEY_BCMPMU=y
CONFIG_KONA_HEADSET_MULTI_BUTTON=y
# CONFIG_VT is not set
# CONFIG_LEGACY_PTYS is not set
CONFIG_SERIAL_8250=y
CONFIG_SERIAL_8250_CONSOLE=y
CONFIG_SERIAL_8250_DW=y
# CONFIG_HW_RANDOM is not set
CONFIG_BRCM_CHAR_DRIVERS=y
CONFIG_VCE=y
CONFIG_ISP=y
CONFIG_ISP2=y
CONFIG_JPEGENC=y
CONFIG_H264=y
CONFIG_MMDMA=y
CONFIG_BCMPMU_RPC=y
# CONFIG_BCM_AP_PANIC_ON_CPCRASH is not set
CONFIG_HAWAII_MM=y
CONFIG_HAWAII_MM_H264=y
CONFIG_BCM_MODEM=y
CONFIG_BRCM_FUSE_VSP=y
CONFIG_GPS_IRQ=y
CONFIG_BCM_LOGRAM_HELPER=y
CONFIG_I2C=y
CONFIG_I2C_CHARDEV=y
CONFIG_I2C_BSC=y
CONFIG_SPI=y
CONFIG_SPI_GPIO=y
CONFIG_SPI_SSPI_HAWAII=y
CONFIG_SPI_SPIDEV=y
CONFIG_GPIO_SYSFS=y
CONFIG_PWM=y
CONFIG_KONA_PWMC=y
CONFIG_POWER_SUPPLY=y
CONFIG_POWER_SUPPLY_DEBUG=y
CONFIG_BCMPMU_THERMAL_THROTTLE=y
CONFIG_SENSORS_BCMPMU=y
CONFIG_KONA_TMON=y
CONFIG_WATCHDOG=y
CONFIG_WD_TAPPER=y
CONFIG_MFD_BCM_PMU59xxx=y
CONFIG_MFD_BCMPMU_DBG=y
CONFIG_MFD_BCM_PWRMGR_SW_SEQUENCER=y
CONFIG_REGULATOR=y
CONFIG_REGULATOR_DEBUG=y
CONFIG_REGULATOR_VIRTUAL_CONSUMER=y
CONFIG_REGULATOR_USERSPACE_CONSUMER=y
CONFIG_REGULATOR_BCMPMU=y
CONFIG_MEDIA_SUPPORT=y
CONFIG_MEDIA_CAMERA_SUPPORT=y
CONFIG_MEDIA_CONTROLLER=y
CONFIG_VIDEO_V4L2_SUBDEV_API=y
CONFIG_V4L_PLATFORM_DRIVERS=y
CONFIG_ION=y
CONFIG_ION_BCM=y
CONFIG_ION_OOM_KILLER=y
CONFIG_FB=y
CONFIG_BACKLIGHT_LCD_SUPPORT=y
# CONFIG_LCD_CLASS_DEVICE is not set
CONFIG_BACKLIGHT_CLASS_DEVICE=y
CONFIG_LOGO=y
CONFIG_FB_BRCM_KONA=y
# CONFIG_FB_NEED_PAGE_ALIGNMENT is not set
CONFIG_SOUND=y
CONFIG_SND=y
CONFIG_SND_SOC=y
CONFIG_HIDRAW=y
CONFIG_UHID=y
CONFIG_USB=y
CONFIG_USB_ANNOUNCE_NEW_DEVICES=y
CONFIG_USB_DYNAMIC_MINORS=y
CONFIG_USB_STORAGE=y
CONFIG_USB_PHY=y
CONFIG_BCMPMU_OTG_XCEIV=y
CONFIG_USB_GADGET=y
CONFIG_USB_GADGET_VBUS_DRAW=500
CONFIG_USB_GADGET_DWC_OTG=y
CONFIG_USB_G_ANDROID=y
CONFIG_USE_WORKQ_PUSH=y
CONFIG_USB_ETH_SKB_ALLOC_OPTIMIZATION=y
CONFIG_USB_PCD_SETTINGS=y
CONFIG_MMC=y
CONFIG_MMC_UNSAFE_RESUME=y
CONFIG_MMC_BLOCK_MINORS=32
# CONFIG_MMC_BLOCK_BOUNCE is not set
CONFIG_MMC_SDHCI=y
CONFIG_MMC_SDHCI_PLTFM_KONA=y
CONFIG_MMC_BCM_SD=y
CONFIG_BCM_SDIOWL=y
CONFIG_MMCPOLL=y
CONFIG_MMCPOLL_TEST=y
CONFIG_NEW_LEDS=y
CONFIG_LEDS_CLASS=y
CONFIG_LEDS_LM3530=y
CONFIG_LEDS_GPIO=y
# CONFIG_LEDS_GPIO_PLATFORM is not set
CONFIG_SWITCH=y
CONFIG_SWITCH_GPIO=y
CONFIG_RTC_CLASS=y
CONFIG_RTC_DRV_BCMPMU=y
CONFIG_STAGING=y
CONFIG_ANDROID=y
CONFIG_ANDROID_BINDER_IPC=y
CONFIG_ASHMEM=y
CONFIG_ANDROID_LOGGER=y
CONFIG_ANDROID_LOW_MEMORY_KILLER=y
CONFIG_ANDROID_INTF_ALARM_DEV=y
CONFIG_BCM_IOMMU_M4U=y
CONFIG_BCM_IOVMM=y
CONFIG_BCM_IOMMU_BROKEN_EXTRA_RW=y
CONFIG_IIO=y
CONFIG_IIO_BUFFER=y
CONFIG_IIO_KFIFO_BUF=y
CONFIG_EXT4_FS=y
CONFIG_FUSE_FS=y
CONFIG_MSDOS_FS=y
CONFIG_VFAT_FS=y
CONFIG_FAT_DEFAULT_IOCHARSET="ascii"
CONFIG_TMPFS=y
# CONFIG_MISC_FILESYSTEMS is not set
CONFIG_NFS_FS=y
CONFIG_NFS_V3_ACL=y
CONFIG_NFS_V4=y
CONFIG_NFS_V4_1=y
CONFIG_ROOT_NFS=y
CONFIG_NLS_DEFAULT="utf8"
CONFIG_NLS_CODEPAGE_437=y
CONFIG_NLS_ASCII=y
CONFIG_PRINTK_TIME=y
CONFIG_PRINTK_CPU_ID=y
CONFIG_PRINTK_PID=y
CONFIG_MAGIC_SYSRQ=y
CONFIG_DETECT_HUNG_TASK=y
CONFIG_SCHEDSTATS=y
CONFIG_DEBUG_SLAB=y
CONFIG_DEBUG_SLAB_LEAK=y
CONFIG_DEBUG_STACK_USAGE=y
CONFIG_DEBUG_INFO=y
CONFIG_DEBUG_MEMORY_INIT=y
CONFIG_DEBUG_LIST=y
CONFIG_RCU_CPU_STALL_TIMEOUT=60
CONFIG_IRQSOFF_TRACER=y
CONFIG_BLK_DEV_IO_TRACE=y
CONFIG_DYNAMIC_DEBUG=y
CONFIG_SDHCI_THROUGHPUT=y
CONFIG_BRCM_DEBUG_RWSEM=y
CONFIG_DEBUG_USER=y
CONFIG_CRYPTO_NULL=y
CONFIG_CRYPTO_SHA256=y
CONFIG_CRYPTO_TWOFISH=y
CONFIG_CRYPTO_ZLIB=y
CONFIG_CRYPTO_DEV_BRCM_SPUM_AES=y
CONFIG_LIBCRC32C=y
```
