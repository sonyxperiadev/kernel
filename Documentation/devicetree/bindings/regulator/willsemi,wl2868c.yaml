## arch/arm/plat-kona/Kconfig
```kconfig
menu	"Broadcom KONA architecture based implementations"
	depends on ARCH_KONA

choice
	prompt "Broadcom KONA SoC Type"
	default ARCH_ISLAND

config ARCH_ISLAND
	bool "BROADCOM Island SoC"
	select HAVE_PWM
	help
	  Support for the Broadcom Island SoC platform.

config ARCH_RHEA
	bool "BROADCOM Rhea SoC"
	select HAVE_PWM
	help
	  Support for the Broadcom Rhea SoC platform.

config ARCH_HAWAII
	bool "Broadcom Hawaii Soc"
	select HAVE_SMP
	select HAVE_PWM
    select ARM_ERRATA_751472 if SMP
    select ARM_ERRATA_754322
    select ARM_ERRATA_764369 if SMP
	select ARM_ERRATA_782773
	select MIGHT_HAVE_CACHE_L2X0
	help
	  Support for the Broadcom Hawaii Soc platform.

config ARCH_JAVA
	bool "Broadcom Java Soc"
	select HAVE_SMP
	select HAVE_PWM
	select MIGHT_HAVE_CACHE_L2X0
	help
	  Support for the Broadcom Java Soc platform.
endchoice

source "arch/arm/plat-kona/Kconfig.common"

config GP_TIMER_CLOCK_OFF_FIX
	bool "Enable the fix for general purpose timer clock off issue."
	depends on ARCH_RHEA
	help
	  Say Y if you want to enable the general purpose timer clock off fix

config GP_TIMER_COMPARATOR_LOAD_DELAY
        bool "Enable the delay after loading general purpose timer compare register"
        depends on ARCH_RHEA || ARCH_ISLAND || ARCH_HAWAII || ARCH_JAVA
        default y

config 1MHZ_SLV_SYSTEM_TIMER
	bool "Use 1MHz slave timer as per CPU local timer"
	depends on ARCH_HAWAII && LOCAL_TIMERS
	default y
	help
	  Say Y if you want to use the 1 MHz slave timer as the per CPU local timer
	  The 1 MHz slave timer will produce a better performance compared to the
	  32 KHz AON timer
	  The 1 MHz slave timer helps to reduce timer scheduling overhead

config KONA_DCACHE_INVALIDATION
	bool "Have Linux invalidate D-Cache"
        default y
	help
	  Say Y if you want Linux to invalidate primary core D-Cache during Linux
	  decompression and boot.

config KONA_TIMER_UNIT_TESTS
	bool "Include Kona Timer unit test code"
	help
	  Say Y if you want to test the AON,Peripheral Timer modules using the sysfs interface

config BRCM_PROP_MODULES
	bool "Include Broadcom proprietary modules"
	default n
	help
	  Say Y if you want to include the Broadcom proprietary modules.

config BCM_STM
	bool "Enable System Trace Module"
	depends on STM_TRACE
	default n
	help
	  Say Y if you want to enable the Broadcom System Trace Module

config DMAC_PL330
	bool "PL330 DMAC driver support for Kona architecture"
	depends on ARCH_RHEA || ARCH_HAWAII || ARCH_JAVA
	select PL330
	select ARM_PL330_FIX_ERRATA_716336
	help
	 Support for PL330 DMA Controller driver for Rhea SOC/KONA architecture

config ARM_PL330_FIX_ERRATA_716336
	bool "PL330: BRCM fix for ARM ERRATA 716336"
	depends on DMAC_PL330
	help
		Enable BRCM fixes for PL330 ARM ERRATA 716336

config DMAC_KONA_PL330_SECURE_MODE
	bool "PL330 DMAC Secure Mode Support"
	depends on DMAC_PL330
	help
	 	PL330 DMA driver operates in open mode by default.
		 Enable this option to operate PL330 in secure mode.

config BCM_ZRELADDR
	hex "Compressed ZREL address"

config BCM_PARAMS_PHYS
	hex "Address where tagged parameters are to be found"

config BCM_RAM_BASE
	hex "RAM base address"
	help
	 Set the physical base address of RAM

config BCM_RAM_START_RESERVED_SIZE
	hex "RAM start reserved memory size in bytes"
	default 0
	help
	 Reserve memory at the start of RAM. This memory
	 may be used for LCD frame buffer, DSP, modem, etc.

config KONA_CPU_PM_HANDLER
	bool "Enable Kona platform PM (idle/suspend) handler."
	depends on KONA_POWER_MGR && (CPU_IDLE || SUSPEND)
	help
	  Say Y if you want to Enable Kona platform PM (idle/suspend) default handlers.

config KONA_PM_DISABLE_WFI
	bool "Enable debug flag to disable ARM WFI by default"
	depends on KONA_CPU_PM_HANDLER
	default n
	help
		Say Y to disable ARM WFI by default.

config KONA_PM_DISABLE_SUSPEND
	bool "Enable debug flag to disable platform suspend by default"
	depends on KONA_CPU_PM_HANDLER
	default n
	help
		Say Y to disable platform suspend by default.

config KONA_PM_NO_CLK_DISABLE
	bool "Enable debug flag to disable clk disable"
	default n
	help
		Say Y to disable clk disable.


config KONA_CPU_FREQ_DRV
       bool "Enable CPU frequency scaling for kona chips"
       depends on KONA_POWER_MGR && CPU_FREQ
       help
	Say Y if you want to enable generic Kona cpu-freq driver for Kona platforms

config KONA_CPU_FREQ_LIMITS
       bool "Enable sysfs interface to control CPU freq limits"
       depends on KONA_CPU_FREQ_DRV
       help
	Say Y to add sysfs interfaces to control CPU freq limits
	under /sys/power folder. CPU-freq max & min limits can be set/read
	using these interfaces. Interace to read freq table and active freq
	also get added if this config is enabled.

config KONA_POWER_MGR
       bool "Enable Kona power manager driver"
       select KONA_PI_MGR
       help
	Say Y if you want to enable Kona power manager driver

config KONA_PI_MGR
       bool "Enable Kona PI manager driver"
       depends on KONA_POWER_MGR
       help
	Say Y if you want to enable Kona PI manager driver

config KONA_PI_DFS_STATS
       bool "Enable Kona PI DFS statistics support"
       depends on KONA_PI_MGR
       help
	Say Y if you want to enable Kona PI DFS statistics (OPP transitions).
	This will support OPP transitions statistics and also the time spent
	by each PI in a given OPP.


config KONA_PWRMGR_ENABLE_HW_SEM_WORKAROUND
       bool "Enable Kona PWRMGR HW sempaphore workaround"
       depends on KONA_POWER_MGR
       help
       	Say Y if you want to enable Kona PWRMGR HW sempaphore workaround

config KONA_PWRMGR_SWSEQ_FAKE_TRG_ERRATUM
	bool "Enable workaround for Kona SW seqeuncer fake trigger erratum"
	depends on KONA_POWER_MGR
	default y
	help
	 Say Y if you want to enable workaround for Kona SW sequencer
	 fake trigger erratum. Refer Jira DB (HWRHEA-2747) for more
	 info.

config KONA_PWRMGR_SWSEQ_FAKE_INTR_ERRATUM
	bool "Enable workaround for Kona SW seqeuncer fake interrupt erratum"
	depends on KONA_POWER_MGR
	default y
	help
	 Say Y if you want to enable workaround for Kona SW sequencer
	 fake interrupt erratum. Refer Jira DB (HWRHEA-2706) for more
	 info.

config KONA_PWRMGR_SWSEQ_RETRY_WORKAROUND
	bool "Enable workaround for sw sequencer retry mechanism"
	depends on KONA_POWER_MGR
	default y
	help
	 Say y if want to enable workaround for kona sw sequencer
	 retry meachanism erratum. Refer JIRA DB (HWHAWAII-1054)
	 for more info

config KONA_PWRMGR_REV2
       bool "Enable Kona PWRMGR Revision-2 support"
       depends on KONA_POWER_MGR && ARCH_RHEA=n
       help
       	Say Y if you want to enable Kona PWRMGR Revision-2 support

config KONA_PMU_BSC_USE_PMGR_HW_SEM
	bool "use HW sem to sync i2c between sw & sequencer"
	depends on (ARCH_RHEA || ARCH_HAWAII || ARCH_JAVA) && KONA_POWER_MGR
	default y
	help
	  The HW sequencer can generate i2c transcations on the PMU i2c
	  bus while SW driver can still generate the same. To sync
	  between the two use HW semaphore.

config KONA_I2C_SEQUENCER_LOG
	bool "enable pwrmgr i2c sequencer logging"
	depends on (ARCH_HAWAII || ARCH_JAVA) && KONA_POWER_MGR
	default n
	help
	 Say Y to enable sequencer logging. All the pwrmgr i2c
	 sequencer state machine and data will be logged to an
	 buffer which can be useful in debugging sequencer related
	 issues

config PM_LOG_TO_UNCACHED_MEM
       bool "Enable power manager event logging to uncached memory"
       default y
       help
        Say Y if you want to enable logging of power events to uncached memory.
        Logging will happen in a 32K circular buffer in the RAM. Useful to
        retrieve information from RAM-dumps in case of errors or failures.

config KONA_MEMC
	bool "Enable Kona MEMC driver"
	help
	 Say Y to enable MEMC driver fot BROADCOM
	 mobile platform.
	 MEMC config params (self refresh, DDRLDO state etc)
	 can be set through driver platform data.

config MEMC_DFS
	bool "Enable DFS for Kona MEMC"
	depends on KONA_MEMC
	help
	 Say Y to enable Kona MEMC DFS. MEMC max frequency is
	 set based on request if MEMC DFS is enabled.

config MEMC_FORCE_156M_IN_SUSPEND
	bool "Force MEMC to 156MHz (economy) in suspend"
	depends on MEMC_DFS
	help
	 Say Y to force MEMC to economy mode (156MHz) while
	 AP is in suspend state. MEMC max power state will be
	 set to 2 to force MEMC frequency to 156MHz while AP is
	 in suspend state

config BRCM_CDC
	bool "Enable Broadcom CDC driver"
	help
	 Say Y to enable Broadcom CDC driver
	 Cluster Dormant Controller handles state
	 CPU state machine for CPU dormant and need
	 to be enabled to enable dormant support

config KONA_SECURE_MEMC
       bool "Enable Kona secure MEMC driver"
       help
         Say Y to enable secure MEMC driver for BRCM
         mobile platform. this drivers enable user to have
	 static configuration and dynamic confoguration
	 on the fly as well.
	 it addresses htc requirement of static configuration.
	 and, user could configure memc on the fly for debugging.

config KONA_ATAG_DT
       bool "Enable ATAG-based DT support"
       select USE_OF
       select OF
       select OF_FLATTREE
       select OF_EARLY_FLATTREE
       select DTC
       default n
       help
         Say Y if you want to enable ATAG-based DeviceTree

config KONA_ATAG_DT_DTS_FILE
       string "DTS file name"
       depends on KONA_ATAG_DT
       help
         DeviceTree source file name

config PROC_PINMUX_DUMP
       bool "Enable Pin-mux Dump"
       help
         Say Y if you want to enable pin-mix dump

config KONA_DT_BCMPMU
	bool "Support DT for bcmpmu drivers"
	depends on KONA_ATAG_DT
	depends on MFD_BCMPMU || MFD_BCM_PMU59056
	default 0
	help
	  Say Y if you support BCMPMU nodes in DeviceTree

config KONA_PROFILER
	bool "Support Kona profiling framework"
	default 0
	help
	  Say Y if you want to enable Kona profiling

config KONA_CLK_TRACE
	bool "Enable clk usage tracing to non-cached buffer"
	default y
	help
	  Say Y if you want to enable clk usage counter tracing

config KONA_USB_CONTROL
       bool "Support BCM USB wrapper framework"
       default n
       help
         Say Y if you want to enable BCM USB wrapper framework

config KONA_CSL_CAMERA
	tristate

config KONA_CHAL_CAMERA
	tristate

config KONA_DSI
	tristate

config KONA_SMI
	tristate

config KONA_VC4LITE
	tristate

config KONA_KEYPAD
	tristate
config BRCM_UART_CHANGES
	bool "Enable the Uart 8250.c changes"
	depends on ARCH_RHEA || ARCH_HAWAII || ARCH_JAVA
	default y
	help
	  Say Y if you want to enable BRCM UART changes in 8250.c file

config BRCM_UART_WAKELOCK_TIMEOUT
	int "UART SUSPEND wakelock timeout value in milliseconds"
	depends on BRCM_UART_CHANGES
	default 2000
	help
	  Set this to number of milliseconds to hold the Suspend Wakelock

config DW_UART_WA_JIRA_1744
	bool "DesignWare UART Jira-1744 Software workaround"
	depends on BRCM_UART_CHANGES
	default y
	help
	  UART RX interrupt happened but in LSR Data Ready is not set.
	  This fix modifies the serial driver to take decission to
	  call receive_chars based on iir and not based on LSR

config DW_BT_UART_CHANGES
	bool "BT related changes for Designware Uart"
	depends on BRCM_UART_CHANGES
	default y
	help
	  Handling BT UART ISR changes.

config KONA_AXITRACE
        bool "Enable axitrace sources"
        depends on ARM_AMBA
        help
          Say Y here to enable axitrace sources on hawaii.

config LPDDR_DEV_TEMP
	bool "enable LPDDR device temperature mgmt"
	depends on KONA_MEMC
	default n
	help
	 Say Y to enable LPDDR device temperature.
	 device will be shutdowm after LPDDR device
	 temperature status reaches 0x7.

endmenu
```
