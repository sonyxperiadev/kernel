## drivers/char/broadcom/csx/Kconfig
```kconfig
#
# Broadcom csx driver config
#
menuconfig BCM_CSX
    tristate "CSX Audio Debug Framework"
    default n
    ---help---
    CSX codec streaming extentions to inject/capture media packets, PCM data, etc.

config BCM_CSX_GIST
    tristate "CSX to GIST utility interface"
    depends on BCM_GIST && BCM_CSX
    default n
    ---help---
    CSX codec streaming extentions interface to GIST debugging tool.

config BCM_CSX_HALAUDIO
    tristate "CSX to HAL Audio module interface"
    depends on BCM_HALAUDIO && BCM_CSX
    default n
    ---help---
    CSX codec streaming extentions interface to HAL Audio module.

config BCM_CSX_SIGMORPH
    tristate "CSX to SIGMORPH utility interface"
    depends on BCM_SIGMORPH && BCM_CSX
    default n
    ---help---
    Codec Streaming eXtensions interface to SIGMORPH debugging tool.
```

## drivers/char/broadcom/modem/rpc/Kconfig
```kconfig
config BRCM_FUSE_RPC_CIB
	#tristate "Broadcom FUSE RPC drivers CIB"
	boolean "Broadcom FUSE RPC drivers CIB"
	depends on BRCM_MODULES && BRCM_MODULES_PRIV
	default N
	---help---
	  Broadcom FUSE RPC drivers CIB
```

## drivers/cpuquiet/Kconfig
```kconfig
menu "CPUQuiet Framework"

config CPU_QUIET
	bool "CPUQuiet Framework"
	help
	 Cpuquiet implements pluggable policies for forcing cpu cores into a
	 quiescent state. Appropriate policies will save power without hurting
	 performance.

if CPU_QUIET

config CPU_QUIET_GOVERNOR_USERSPACE
	bool "'userspace' governor"
	default y
	help
	 Manual control of the number of CPUs online.
	 This governor allows userspace to control the number of online CPUs.
	 That means this governor allow user to implement the real governor
	 in user space.

	 If in doubt say Y.

config CPU_QUIET_GOVERNOR_RUNNABLE
	bool "'runnable threads' governor"
	default y
	help
	 Scale the number of CPUs online depending on the number of runnable
	 threads.  This governor will scale the number of CPUs online depending
	 on the number of runnable threads.

	 If in doubt say Y.

choice
	prompt "Default CPUQuiet governor"
	default CPU_QUIET_DEFAULT_GOV_USERSPACE
	help
	 This option sets which CPUQuiet governor shall be loaded at
	 startup. If in doubt, select 'userspace'.

config CPU_QUIET_DEFAULT_GOV_USERSPACE
	bool "userspace"
	select CPU_QUIET_GOVERNOR_USERSPACE
	help
	 Use the CPUQuiet governor 'userspace' as default.

config CPU_QUIET_DEFAULT_GOV_RUNNABLE
	bool "runnable threads"
	select CPU_QUIET_GOVERNOR_RUNNABLE
	help
	 Use the CPUQuiet governor 'runnable threads' as default.
endchoice

endif
endmenu
```

## drivers/firmware/qcom/Kconfig
```kconfig
# SPDX-License-Identifier: GPL-2.0-only
config QTI_TZ_LOG
        tristate "QTI Trust Zone (TZ) Log Driver"
        depends on DEBUG_FS
        help
          This option enables a driver with a debugfs interface for messages
          produced by the Secure code (Trust zone). These messages provide
          diagnostic information about TZ operation.

config TZ_LAST_LOGS
        bool "Format and export tz logs for system"
        depends on DEBUG_FS && QTI_TZ_LOG
        default y
        help
          When a fatal error is encountered on system, system reboots and
          saves the logs in to last logs memory. From last_logs area
          TZ related logs are read in this driver.
          These logs are formatted and exported via debugfs.
```

## drivers/gpu/drm/msm/dsi-staging/somc_panel/Kconfig
```kconfig
config DRM_SDE_SPECIFIC_PANEL
	bool

config DRM_MSM_DSI_SOMC_PANEL
	depends on DRM_MSM
	select DRM_SDE_SPECIFIC_PANEL
	bool
	prompt "Sony Xperia Unified Panel Driver"
	default n
	---help---
	Restructured Unified display Panel Driver for Xperia Open Devices.
	Provides support for panels found in various Sony Xperia devices.

config SOMC_PANEL_LABIBB
	depends on DRM_MSM_DSI_SOMC_PANEL && REGULATOR_QPNP_LABIBB_SOMC
	bool
	default y
	---help---
	LAB/IBB regulators handling for MSM8994 and later generation boards.

config DRM_MSM_DP_SOMC_PANEL
	depends on DRM_MSM && EXTCON_SOMC_EXTENSION
	bool "Support for DisplayPort on Sony Xperia"
	default n
	---help---
	Enable additional code for enhancements and support to enable the
	DisplayPort output through the USB Type-C on Sony Xperia devices.

choice
	bool "SoMC Panel variant support"

config SOMC_PANEL_INCELL
	depends on DRM_MSM_DSI_SOMC_PANEL
	bool
	prompt "SoMC Panel for In-Cell"
	---help---
	Handles incell panels and touchscreens.
	You probably want to also enable SOMC_PANEL_LABIBB.
endchoice
```

## drivers/gpu/ion/Kconfig
```kconfig
menuconfig ION
	tristate "Ion Memory Manager"
	depends on ARM
	select GENERIC_ALLOCATOR
	select DMA_SHARED_BUFFER
	help
	  Chose this option to enable the ION Memory Manager.

config ION_TEGRA
	tristate "Ion for Tegra"
	depends on ARCH_TEGRA && ION
	help
	  Choose this option if you wish to use ion on an nVidia Tegra.

config ION_BCM
	tristate "Ion for Broadcom Processor"
	depends on ARCH_KONA && ION
	help
	  Choose this option if you wish to use ion on a Broadcom
	  processor.
	  OOM/LMK killer is optional. Custom features like cache management
	  are present. The debugfs output is modified to print more details.

config ION_OOM_KILLER
	bool "Ion lowmem/oom killer"
	depends on ION_BCM
	help
	  This config enables lowmemkiller options which can be set on per heap
	  basis or for entire heap mask. The parameters can be set in platform
	  file at compile time or via debugfs at runtime.
	  This config also enables oom killer for ION
	  Choose this option if you wish to enable lowmemkiller and oom killer
	  in ion.

config ION_BCM_NO_DT
	bool "Ion heap info without DTB file"
	depends on ION_BCM
	help
	Choose this option if you wish to use ION without DTB file.
	The driver will support platform device registration via DT and
	board, irrespective of this macro. The memory reserve parameters
	are read from platform data defined in board file and device
	registration is done via platform_device_register() if this
	macro is enabled.
```

## drivers/gpu/msm/Kconfig
```kconfig
config QCOM_KGSL
	tristate "Qualcomm Technologies, Inc. 3D Graphics driver"
	default n
	depends on ARCH_QCOM
	select GENERIC_ALLOCATOR
	select FW_LOADER
	select PM_DEVFREQ
	select DEVFREQ_GOV_SIMPLE_ONDEMAND
	select DEVFREQ_GOV_PERFORMANCE
	select DEVFREQ_GOV_QCOM_ADRENO_TZ
	select DEVFREQ_GOV_QCOM_GPUBW_MON
	---help---
	  3D graphics driver for the Adreno family of GPUs from QTI.
	  Required to use hardware accelerated OpenGL, compute and Vulkan
	  on QTI targets. This includes power management, memory management,
	  and scheduling for the Adreno GPUs.

config QCOM_ADRENO_DEFAULT_GOVERNOR
	string "devfreq governor for the adreno core"
	default "msm-adreno-tz" if DEVFREQ_GOV_QCOM_ADRENO_TZ
	default "simple_ondemand"
	depends on QCOM_KGSL && !QCOM_KGSL_LEGACY

config QCOM_KGSL_IOMMU
	bool
	depends on !QCOM_KGSL_LEGACY
	default y if QCOM_KGSL && (MSM_IOMMU || ARM_SMMU)

config QCOM_KGSL_OLD_BINARIES_COMPAT
	bool "Build KGSL for pre-4.14 userspace binaries"
	depends on QCOM_KGSL && !QCOM_KGSL_LEGACY
	---help---
	  The old userspace binaries may get/set some KGSL property
	  which definition is different from the new binaries.
	  For example, KGSL_PROP_SPEED_BIN (from 4.14) is 0x25, but
	  KGSL_PROP_GPU_FORCE_ON (unsupported in 4.14) corresponds
	  to the same number on k4.9 adreno userspace binaries.
	  Say Y here if you want to run old adreno binaries, for a
	  reason or another.

source "drivers/gpu/msm_legacy/Kconfig"
```

## drivers/gud/Kconfig
```kconfig
#
# MobiCore configuration
#
config MOBICORE_DRIVER
	depends on ARM
	tristate "MobiCore support"
	help
	  Enable Linux Kernel MobiCore Support
	  This will create 2 device files used for MobiCore control and
	  communication

config MOBICORE_DEBUG
	bool "MobiCore Module debug mode"
	depends on MOBICORE_DRIVER
	help
	  Enable Debug mode in the MobiCore Driver.
	  It enables printing information about mobicore operations

config MOBICORE_VERBOSE
	bool "MobiCore Module verbose debug mode"
	depends on MOBICORE_DEBUG
	help
	  Enable Verbose Debug mode in the MobiCore Driver.
	  It enables printing extra information about mobicore operations
	  Beware: this is only useful for debuging deep in the driver because
	  it prints too much logs


config MOBICORE_API
	tristate "MobiCore Kernel API"
	depends on MOBICORE_DRIVER
	help
	  Enable Linux Kernel MobiCore API
	  It provides the same client API from user space to kernel
```

## drivers/haptic/Kconfig
```kconfig
menuconfig HAPTIC
	bool "HAPTIC support"
	help
	  Say Y to enalbe haptic support. It enables the haptic and controlled
	  from both userspace and kernel

if HAPTIC

config HAPTIC_CLASS
	tristate "Haptic Class Support"
	help
	  This option enables the haptic sysfs class in /sys/class/haptic.

comment "Haptic drivers"

config HAPTIC_SAMSUNG_PWM
	tristate "Haptic Support for SAMSUNG PWM-controlled motor (ISA1000)"
	depends on HAPTIC_CLASS
	help
	  This options enables support for haptic connected to GPIO lines
	  controlled by a PWM timer.

config BCM_HAPTICS
	tristate "HAPTICS driver"
	default n
	help
	  This options enables support for Broadcom haptic driver, implemented
	  using HALAUDIO interface

config BCM_SS_VIBRA
        bool "Samsung Platform Vibrator support"
	default y
        depends on MACH_RHEA_SS_COMMON
        help
          This option enables support for Vibrator on some Samsung phones.

endif	# HAPTIC
```

## drivers/i2c/clients/Kconfig
```kconfig
config I2C_DAC6571
	tristate "I2C driver for DAC6571"
	default n
	help
	  Say Y here if you want support for a DAC6571 attached to the I2C bus.
```

## drivers/input/misc/bmp280/Kconfig
```kconfig
#
# Please let upper layer's Kconfig contains BMP280 Kconfig.
# For example, you can add the following statement to the end of
# drivers/input/misc/Kconfig when you think BMP280 as input misc device.
#     source "drivers/input/misc/bmp280/Kconfig"
#

config BMP280
	tristate "BMP280 digital pressure sensor"
	depends on (I2C || SPI_MASTER) && SYSFS
	help
	  If you say yes here you get support for Bosch Sensortec
	  digital pressure sensors BMP280.

	  To compile this driver as a module, choose M here: the
	  module will be called bmp280-core.

config BMP280_I2C
	tristate "support I2C bus communication"
	depends on BMP280 && I2C
	help
	  Say Y here if you want to support Bosch Sensortec digital pressure
	  sensor hooked to an I2C bus.

	  To compile this driver as a module, choose M here: the
	  module will be called bmp280-i2c.

config BMP280_SPI
	tristate "support SPI bus communication"
	depends on BMP280 && SPI_MASTER
	help
	  Say Y here if you want to support Bosch Sensortec digital pressure
	  sensor hooked to an SPI bus.

	  To compile this driver as a module, choose M here: the
	  module will be called bmp280-spi.
```

## drivers/input/misc/em7180/Kconfig
```kconfig
#
# Input misc drivers configuration
#
menuconfig INPUT_EMMICRO
	bool "EM Microelectronics Sensor Hubs"
	help
	  Say Y here

	  If unsure, say Y.

if INPUT_EMMICRO

config INPUT_EM7180
	tristate "EM7180 Sensor Hub"
	default m
	help
	  Say Y here if you have a EM Micro 7180 SFP Sensor module, and 
	  your board-specific initialization code includes that in its 
	  table of devices.

	  If unsure, say N (but it's safe to say "Y").

	  To compile this driver as a module, choose M here: the
	  module will be called em7180.


endif
```

## drivers/input/touchscreen/IST3032B/Kconfig
```kconfig
#
# touch driver configuration
#

config TOUCHSCREEN_IST30XX_NEW
        tristate "IST30XX I2C Touchscreen"
        depends on I2C
        help
          Say Y here if you have the Imagis IST30XX I2C touchscreen
          connected to your system.

          If unsure, say N.

          To compile this driver as a module, choose M here: the
          module will be called ist30xx.
```

## drivers/input/touchscreen/MMS144/Kconfig
```kconfig
#
# touch driver configuration
#

config TOUCHSCREEN_MELFAS_MMS144
	tristate "Melfas MMS144 I2C Touchscreen"
	depends on I2C
	help
	  Say Y here if you have Melfas MMS144 I2C touchscreen,
	  such as MMS144, connected to your system.

	  If unsure, say N.

	  To compile this driver as a module, choose M here: the
	  module will be called MMS144.
```

## drivers/input/touchscreen/coreriver_touchkey/Kconfig
```kconfig
#
# touchkey configuration
#

config KEYBOARD_CYPRESS_TOUCH
	tristate "Cypress I2C Touchkey"
	depends on I2C
	help
	Say Y here if you have Cypress I2C Touchkey.
config KEYBOARD_TC360L_TOUCHKEY
	tristate "CoreRiver I2C Touchkey"
	depends on I2C
	help
	Say Y here if you have CoreRiver I2C Touchkey.
```
