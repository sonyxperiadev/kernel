## brcm_modules/drivers/char/brcm/xscript/Kconfig
```kconfig
config BRCM_XSCRIPT
	#tristate "Broadcom XSCRIPT drivers"
	boolean "Broadcom XSCRIPT drivers"
	depends on BRCM_MODULES && BRCM_MODULES_PRIV
	default N
	---help---
	  Broadcom XSCRIPT drivers

config BRCM_XSCRIPT_GPIO
        tristate "Broadcom XSCRIPT GPIO drivers"
        depends on BRCM_MODULES && BRCM_MODULES_PRIV && GPIOLIB
        default m
        ---help---
        Broadcom XSCRIPT GPIO drivers


config BRCM_XSCRIPT_DMA
        tristate "Broadcom XSCRIPT DMA drivers"
        depends on BRCM_MODULES && BRCM_MODULES_PRIV
        default m
        ---help---
        Broadcom XSCRIPT DMA drivers



config BRCM_XSCRIPT_REGULATOR
        tristate "Broadcom XSCRIPT REGULATOR drivers"
        depends on BRCM_MODULES && BRCM_MODULES_PRIV && REGULATOR
        default m
        ---help---
        Broadcom XSCRIPT REGULATOR drivers

config BRCM_XSCRIPT_I2S
        tristate "Broadcom XSCRIPT I2S drivers"
        depends on BRCM_MODULES && BRCM_MODULES_PRIV && BCM_I2SDAI
        default m
        ---help---
        Broadcom XSCRIPT I2S drivers
```

## brcm_modules/drivers/gps/brcm/Kconfig
```kconfig
#BRCM_CNTIN
config BRCM_CNTIN
	boolean "Broadcom cntin drivers"
 	depends on BRCM_MODULES && BRCM_MODULES_PRIV
	default N
```

## brcm_modules/drivers/sound/brcm/alsa/Kconfig
```kconfig
#/*******************************************************************************************
#Copyright 2010 Broadcom Corporation.  All rights reserved.
#
#Unless you and Broadcom execute a separate written software license agreement 
#governing use of this software, this software is licensed to you under the 
#terms of the GNU General Public License version 2, available at 
#http://www.gnu.org/copyleft/gpl.html (the "GPL"). 
#
#Notwithstanding the above, under no circumstances may you combine this software 
#in any way with any other Broadcom software provided under a license other than 
#the GPL, without Broadcom's express prior written consent.
#*******************************************************************************************/

config BRCM_SOUND_ALSA
	#tristate "Broadcom ALSA sound drivers"
	boolean "Broadcom ALSA sound drivers"
	depends on BRCM_MODULES && BRCM_MODULES_PRIV
        select SND_PCM
        help
          Say Y here to activate an ALSA driver frontend to the BRCM endpoint
          To compile this driver as a module, choose M here: the module
          will be called snd-brcm-omx.

config AMP_MAX9877
	boolean "MAX9877 Audio Amplifier driver"
	---help---
	Selet this to enable MAX9877 Audio Amplifier driver for Brava.

config AMP_NCP2704
	boolean "NCP2704 Audio Amplifier driver"
	---help---
	Selet this to enable NCP2704 Audio Amplifier driver for Brava.
```

## brcm_modules/drivers/sound/brcm/alsa_athena/Kconfig
```kconfig
#/*******************************************************************************************
#Copyright 2010 Broadcom Corporation.  All rights reserved.
#
#Unless you and Broadcom execute a separate written software license agreement 
#governing use of this software, this software is licensed to you under the 
#terms of the GNU General Public License version 2, available at 
#http://www.gnu.org/copyleft/gpl.html (the "GPL"). 
#
#Notwithstanding the above, under no circumstances may you combine this software 
#in any way with any other Broadcom software provided under a license other than 
#the GPL, without Broadcom's express prior written consent.
#*******************************************************************************************/

config BRCM_SOUND_ATHENA_ALSA
	#tristate "Broadcom ALSA Athena sound drivers"
	boolean "Broadcom ALSA Athena sound drivers"
	depends on BRCM_MODULES && BRCM_MODULES_PRIV
        select SND_PCM
        help
          Say Y here to activate an ALSA driver frontend to the BRCM endpoint
          To compile this driver as a module, choose M here: the module
          will be called snd-brcm-omx.
```

## brcm_modules/drivers/sound/brcm/headset/Kconfig
```kconfig
#Broadcom headset detection driver
config BRCM_HEADSET
	tristate "Broadcom headset drivers"
	depends on BRCM_MODULES && BRCM_MODULES_PRIV
       default N
        help
          Activate BRCM headset driver
```

## brcm_modules/drivers/video/ge/Kconfig
```kconfig
# GE
config GE
	tristate "GE support"
	depends on BRCM_MODULES && BRCM_MODULES_PRIV && HANTRO_WRAP
	default N
	help
	  GE device driver support
```

## brcm_modules/drivers/video/hantro/Kconfig
```kconfig
# Hantro
config HANTRO
	tristate "Hantro support"
 	depends on BRCM_MODULES && BRCM_MODULES_PRIV && HANTRO_WRAP
	default N
	help
	  Hantro device driver support
```

## drivers/block/zram/Kconfig
```kconfig
config ZRAM
	tristate "Compressed RAM block device support"
	depends on BLOCK && SYSFS && CRYPTO
	select CRYPTO_LZO
	select ZPOOL
	default n
	help
	  Creates virtual block devices called /dev/zramX (X = 0, 1, ...).
	  Pages written to these disks are compressed and stored in memory
	  itself. These disks allow very fast I/O and compression provides
	  good amounts of memory savings.

	  It has several use cases, for example: /tmp storage, use as swap
	  disks and maybe many more.

	  See zram.txt for more information.

if ZRAM

choice
	prompt "Default zRAM compressed memory allocator"
	default ZRAM_DEFAULT_ZSMALLOC
	help
	  Select the compressed memory allocator that will be used by default
	  for all devices.

	config ZRAM_DEFAULT_ZBUD
		bool "zbud"
		select ZBUD

	config ZRAM_DEFAULT_Z3FOLD
		bool "z3fold"
		select Z3FOLD

	config ZRAM_DEFAULT_ZSMALLOC
		bool "zsmalloc"
		select ZSMALLOC

endchoice

config ZRAM_DEFAULT_POOL
	string
	default "zbud" if ZRAM_DEFAULT_ZBUD
	default "z3fold" if ZRAM_DEFAULT_Z3FOLD
	default "zsmalloc" if ZRAM_DEFAULT_ZSMALLOC

endif
```

## drivers/bluetooth/broadcom/Kconfig
```kconfig
menu "BROADCOM V4L2 BT/FM device drivers"
  depends on BT

config BT_PROTOCOL_DRIVER
	tristate "BROADCOM BT Protocol Driver"
	default n

config LINE_DISCIPLINE_DRIVER
	tristate "BROADCOM Line Discipline Driver"
	default n

config V4L2_FM_DRIVER
	tristate "BROADCOM V4L2 FM Driver"
	default n

endmenu
```

## drivers/char/broadcom/Kconfig
```kconfig
#
# Broadcom char driver config
#

menuconfig BRCM_CHAR_DRIVERS
	tristate "Broadcom Char Drivers"
	depends on PROC_FS
	help
	  Broadcom's char drivers

config V3D
	tristate "V3D Driver"
	depends on BRCM_CHAR_DRIVERS && (ARCH_RHEA || ARCH_HAWAII || ARCH_JAVA)
	default n
	help
	 This config enables v3d driver. This driver
	 accelerates graphics composition and hence
	 improves the system performance. It is suggested
	 to keep it enabled.

config VCE
	tristate "VCE Driver"
	depends on BRCM_CHAR_DRIVERS && (ARCH_RHEA || ARCH_HAWAII || ARCH_JAVA)
	default n
	help
	 This config enables the VCE driver. This driver
	 accelerates video codec engine and hence improves
	 the system performance. It is suggested
	 to keep it enabled.

config BCM_MMUTIL
	tristate "BCM MM Util Driver"
	depends on BRCM_CHAR_DRIVERS && (ARCH_RHEA)
	default n

config BRCM_FUSE_LOG
	tristate "Broadcom FUSE LOG drivers"
	depends on BRCM_CHAR_DRIVERS
	default n
	--help---
	  Broadcom FUSE LOG drivers

config STM_DEFAULT
	tristate "STM Driver"
	depends on BRCM_CHAR_DRIVERS
	default n

config ISP
	tristate "ISP Driver"
	depends on BRCM_CHAR_DRIVERS && (ARCH_RHEA || ARCH_HAWAII || ARCH_JAVA)
	default n
	help
	 This config enables the ISP driver. This driver
	 accelerates ISP related operations and hence
	 improves the system performance. It is suggested
	 to keep it enabled.

config ISP2
	tristate "ISP2 Driver"
	depends on BRCM_CHAR_DRIVERS && (ARCH_JAVA)
	default n
	help
	 This config enables the ISP2 driver. This driver
	 accelerates ISP2 related operations and hence
	 improves the system performance. It is suggested
	 to keep it enabled.

config JPEGENC
	tristate "JPEGENC Driver"
	depends on BRCM_CHAR_DRIVERS && (ARCH_JAVA)
	default n
	help
	 This config enables the JPEGENC driver. This driver
	 accelerates JPEG encoding process and hence
	 improves the system performance. It is suggested
	 to keep it enabled.

config H264
	tristate "H264 Driver"
	depends on BRCM_CHAR_DRIVERS && (ARCH_HAWAII || ARCH_JAVA)
	default n

config UNICAM
	tristate "UNICAM Driver"
	depends on BRCM_CHAR_DRIVERS && (ARCH_RHEA)
	default n

config MMDMA
	tristate "MMDMA Driver"
	depends on BRCM_CHAR_DRIVERS && (ARCH_RHEA || ARCH_HAWAII || ARCH_JAVA)
	select KONA_VC4LITE
	default n

config BCMPMU_RPC
	bool "Enable BCMPMU RPC driver"
	depends on BRCM_CHAR_DRIVERS
	depends on MFD_BCM_PMU59xxx
	depends on SENSORS_BCMPMU
	default n
	---help---
	Select to enable PMU RPC driver to send ADC raw data
	to Modem.

config BCM_AP_PANIC_ON_CPCRASH
        bool "Support for crashing AP when CP crashes"
        default y
        help
        If you say Y here, a CP crash will result in AP panic.
        Debug tool can be used to extract CP dump later.

config BCM_MDMGPIO
    tristate "MDMGPIO Driver"
    depends on BRCM_CHAR_DRIVERS && (ARCH_RHEA)
    default n
    ---help---
    Select to build the mdmgpio driver.

config HAWAII_MM
	tristate "Hawaii MM Driver Framework"
	depends on BRCM_CHAR_DRIVERS && (ARCH_RHEA || ARCH_HAWAII || ARCH_JAVA)
	default n

config HAWAII_MM_H264
	tristate "Hawaii MM - H264 Driver"
	depends on HAWAII_MM
	default n

config BCM_AAA
    tristate "Android Amxr Audio ('AAA grade-beef') driver"
    default n
    ---help---
    Select to build the generic AAA driver.

config BCM_BSC
    bool "Board Specific Configuration (BSC) driver support"
    default y
    ---help---
    Say Y to enable the BSC support.

config BCM_GPS_UART
	int "GPS UART"
	depends on BCM_GPS
	--help---
		GPS UART port no e.g. 0,1,2,3 to be used

config BCM_MODEM
        bool "Broadcom Modem Driver"
        depends on BRCM_CHAR_DRIVERS && NET
	select BRCM_FUSE_LOG
        default n
        help
          Broadcom Modem IPC drivers

config BRCM_CP_CRASH_DUMP_EMMC
	bool "cp crash dump to eMMC"
	depends on BCM_MODEM && APANIC_ON_MMC
        default y
        --help---
          Say Y to enable the cp crash dump to eMMC support.

config CP_CRASH
	bool "cp crash without dump"
	depends on BCM_MODEM && MACH_HAWAII_SS_COMMON
        default y
        --help---
          Say Y to enable cp crash from AP panic handler
	  without enabling dump, as this option depends
	  on BCM_MODEM and MACH_HAWAII_SS_COMMON, make sure
	  to set them.

config BCM_MODEM_DEFER_CP_START
        bool "Release CP from reset from main image (deferred)"
        depends on BRCM_CHAR_DRIVERS && NET && BCM_MODEM
        default n
        help
          Causes the main image to release the CP from reset in the case
          where this is not done already from the loader.

config BRCM_FUSE_VSP
	#tristate "Broadcom FUSE VSP drivers"
	boolean "Broadcom FUSE VSP drivers"
	depends on BRCM_CHAR_DRIVERS && BCM_MODEM
	default N
	---help---
	  Broadcom FUSE VSP drivers

config BCM_SIMLOCK
	bool "Broadcom SIM lock driver"
	depends on BCM_MODEM
	default y
	help
	  Say Y here to enable the Broadcom back-end for SIM locking.
	  Otherwise SIM lock will be disabled, unless another mechanism
	  provides it.

	  If unsure, say N here.

config BCM_IDLE_PROFILER
	bool "Broadcom Idle Profiler Support"
	depends on BRCM_CHAR_DRIVERS && ARCH_KONA
	default n
	help
	  Say y to turn on Broadcom idle profiler support

config GPIO_USER_MODE_SUPPORT
	tristate "Broadcom GPIO User Mode Support"
	depends on BRCM_CHAR_DRIVERS
	default n
	help
	  Say y to turn on support for GPIO in user mode

config BCM_HEADSET_SW
   bool "Headset Detection Support"
   depends on BRCM_CHAR_DRIVERS
   default y
   ---help---
   Say Y to enable headset detection.

config BCM_AMXR
   bool "Audio Mixer Driver support"
   depends on BRCM_CHAR_DRIVERS
   default n
   ---help---
   Say Y to enable the Audio Mixer Driver to support interconnecting
   audio samples between kernel objects.

config BCM_AMXR_CORE
   tristate "Audio Mixer Driver support"
   depends on BCM_AMXR
   default n
   ---help---
   Say Y to enable the Audio Mixer Core module.

config BCM_HALAUDIO
    bool "HAL Audio Driver support"
    depends on BRCM_CHAR_DRIVERS
    default n
    help
      Say Y to enable HAL Audio Driver support which is used to control
      audio hardware.

config BCM_HALAUDIO_CORE
    tristate "HAL Audio core framework support"
    depends on BRCM_CHAR_DRIVERS && BCM_HALAUDIO
    default n
    help
      Select m to build HAL Audio core framework module which is used to control
      audio hardware.

config BCM_HALAUDIO_AUDIOH_ISLAND
    tristate "HAL Audio Audio Hub driver for the Island Chip family"
    depends on ARCH_ISLAND
    depends on BRCM_CHAR_DRIVERS
    depends on BCM_HALAUDIO && BCM_AMXR
    depends on MAP_SDMA && MAP_AADMA && MAP_SSASW
    depends on MAP_ISLAND_AUDIOH_CHAL
    default n
    help
      Select m to build the HAL Audio Audio Hub driver.This driver must
      be built as a loadable module otherwise initialization will fail.

config BCM_HALAUDIO_PCM_ISLAND
    tristate "HAL Audio PCM driver for the Island Chip family"
    depends on ARCH_ISLAND
    depends on BRCM_CHAR_DRIVERS
    depends on BCM_HALAUDIO && BCM_AMXR
    depends on MAP_SDMA && MAP_AADMA && MAP_SSASW
    depends on MAP_ISLAND_PCM_CHAL
    default n
    help
      Select m to build the HAL Audio PCM driver.This driver must
      be built as a loadable module otherwise initialization will fail.

config BCM_VCP
    bool "Video Calling driver support"
    depends on BRCM_CHAR_DRIVERS
    default n
    help
      Say Y to enable VCP driver support which is used to support
      video calling framework.

config BCM_VCPTEST
    tristate "Video Calling driver test"
    depends on BCM_VCP
    default n
    help
      Say Y to enable VCP driver test.

config BCM_GIST
    tristate "Generic I/O Streaming (GIST)"
    default n
    ---help---
    This utility provides low latency non-blocking reads from and writes to files.

config BCM_SIGMORPH
    tristate "Audio Packet Processing"
    default n
    ---help---
    Codec Streaming eXtensions interface to attenuate/mix audio

config BCM_HDMI_DET
    tristate "HDMI detection"
    default n
    ---help---
    Select to build the generic HDMI dectection driver.

config BCM_HDMI_DET_SWITCH
    bool "HDMI detection switch class extension"
    depends on BCM_HDMI_DET
    default n
    ---help---
    Say Y to enable the switch class support in the HDMI detection driver,
    needed for Android HDMI integration.

config BCM_FRAME_PROFILER_SUPPORT
    bool "Enable frame profiling"
    depends on ARCH_BCM116X || ARCH_BCMRING
    default y
    ---help---
      Maintain a history of time spent processing frames.

config BCM_WIFI_HDMI
    tristate "WIFI HDMI"
    default n
    ---help---
      Select to build the WIFI HDMI driver.

config VC_TEST_WIFI_HDMI
    tristate "Wifi-Hdmi Videocore Service Tester"
    default n
    ---help---
      Select to build the Wifi-Hdmi Videocore Service test driver.

config GPS_IRQ
	bool "GPS I2C HOSTWAKE"
	default n
	--help---
		If GPS I2C-HOSTWAKE is used

config BCM_RTC_CAL
	tristate "RTC CAL"
	depends on BCM_MODEM && (ARCH_RHEA)
	default n
	---help---
	Select to build the RTC CAL driver.

config BRCM_SIM_SECURE_ENABLE
    boolean "Broadcom SIM Secure Enable"
    depends on BCM_SIMLOCK
    default n
    ---help---
    Broadcom SIM Secure Enable

config BCM_LOGRAM_HELPER
    boolean "Broadcom logram helper"
    default n
    ---help---
    Reserves a page of bootmem and stores ramdump address

config NEW_GPSCHIP_I2C
	bool "GPS I2C NEW COMMUNICATION PROTOCOL"
	default n
	--help---
		If GPS I2C using new comm protocol

config BCM_GPS_CNTIN
	boolean "Broadcom gps cntin driver"
	default y
	---help---
	Say Y to enable the GPS CNTIN support.

config BCM_SET_CP_LOCK_STATE_SUPPORT
    boolean "Set CP lock state support"
    depends on BRCM_CHAR_DRIVERS && BCM_MODEM && !BRCM_SIM_SECURE_ENABLE
    default n
    ---help---
    Set CP lock status directly
```
