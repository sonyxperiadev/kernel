&battery_charger {
	qcom,thermal-mitigation = <3000000 2000000 2000000 1600000 1600000 1000000 1000000
				1000000 400000 400000 100000 100000 0 2000000
				1000000 600000 400000 200000 100000 100000 0 0>;
	qcom,thermal-mitigation-sleep = <4000000 4000000 3500000 3300000 3000000 2800000 2400000
				2200000 1600000 400000 100000 100000 0 2000000
				1000000 600000 400000 200000 100000 100000 0 0>;
};
