/* Copyright (c) 2017, The Linux Foundation. All rights reserved.
 *
 * This program is free software; you can redistribute it and/or modify
 * it under the terms of the GNU General Public License version 2 and
 * only version 2 as published by the Free Software Foundation.
 *
 * This program is distributed in the hope that it will be useful,
 * but WITHOUT ANY WARRANTY; without even the implied warranty of
 * MERCHANTABILITY or FITNESS FOR A PARTICULAR PURPOSE.  See the
 * GNU General Public License for more details.
 */

qcom,kirin_send_4380mv {
	qcom, = <24>;
	/* #3527878_Compal_BY36_2850mAh_averaged_MasterSlave_Jul6th2018*/
	somc,initial-capacity-uah = <2870000>;
	qcom,max-voltage-uv = <4380000>;
	qcom,nom-batt-capacity-mah = <2850>;
	qcom,batt-id-kohm = <330>;
	qcom,battery-beta = <4050>;
	qcom,fastchg-current-ma = <2484>;
	qcom,fg-cc-cv-threshold-mv = <4370>;
	qcom,battery-type = "1315-0324-0";
	qcom,checksum = <0x7146>;
	qcom,gui-version = "PM660GUI - 0.0.0.45";
	qcom,fg-profile-data = [
		 AD 1F 8D 05
		 67 0A E1 FC
		 8A 1C 5E 02
		 79 0D 96 0A
		 46 18 C6 22
		 D4 45 5D 52
		 7D 00 00 00
		 13 00 00 00
		 00 00 D8 BB
		 8F CC 55 C2
		 2B 00 08 00
		 ED DC 8C DD
		 57 FC 42 F3
		 00 06 6E 03
		 C7 FD EE 2B
		 19 06 09 20
		 27 00 14 00
		 FC 1F 50 05
		 9F 0A 2C 06
		 80 1C 2E 03
		 08 0C 03 12
		 85 18 EE 22
		 7A 45 0D 53
		 72 00 00 00
		 11 00 00 00
		 00 00 4A C4
		 BA CA D0 CD
		 25 00 00 00
		 FE E3 8C DD
		 35 06 CC 00
		 CE 05 41 02
		 0A E4 95 12
		 99 33 CC FF
		 07 10 00 00
		 25 0B 14 46
		 25 00 40 00
		 96 01 0A FA
		 FF 00 00 00
		 00 00 00 00
		 00 00 00 00
		 00 00 00 00
		 00 00 00 00
		 00 00 00 00
		 00 00 00 00
		 00 00 00 00
		 00 00 00 00
		 00 00 00 00
		 00 00 00 00
		 00 00 00 00
		 00 00 00 00
		 00 00 00 00
		 00 00 00 00
		 00 00 00 00
		 00 00 00 00
		 00 00 00 00
		 00 00 00 00
	];

	somc,step-cfg = <
		(-2550) 50    0 4500    0 4200 1
		   50  120    0 4500  552 4200 2
		  120  250    0 4100 1932 4380 3
		  120  250 4100 4200 1380 4380 3
		  120  250 4200 4300 1104 4380 3
		  120  250 4300 4500  828 4380 3
		  250  450    0 4150 2484 4380 3
		  250  450 4150 4200 2070 4380 3
		  250  450 4200 4300 1380 4380 3
		  250  450 4300 4500  828 4380 3
		  450  550    0 4500  552 4200 4
		  550 2550    0 4500    0 4200 5
	>;
	somc,step-cell-impedance-mohm = <25>;
};
