/dts-v1/;
/plugin/;

#include "trustedvm-waipio-sde.dtsi"
#include "trustedvm-waipio-sde-display-cdp.dtsi"

/ {
	model = "Qualcomm Technologies, Inc. Waipio CDP";
	compatible = "qcom,waipio-cdp", "qcom,waipio", "qcom,cdp";
	qcom,msm-id = <457 0x10000>;
	qcom,board-id = <0x10001 0>;
};
