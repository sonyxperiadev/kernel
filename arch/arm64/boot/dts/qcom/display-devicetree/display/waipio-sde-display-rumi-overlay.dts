/dts-v1/;
/plugin/;

#include "waipio-sde-display-rumi.dtsi"

/ {
	model = "Qualcomm Technologies, Inc. Waipio Rumi";
	compatible = "qcom,waipio-rumi", "qcom,waipio";
	qcom,msm-id = <457 0x10000>;
	qcom,board-id = <0x1000F 0>;
};