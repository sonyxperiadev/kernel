/dts-v1/;

#include "waipio-v2.dtsi"
#include "waipio-qrd.dtsi"
#include "waipio-pm8010-spmi.dtsi"
#include "waipio-nagara-pdx224_generic.dtsi"

/ {
	model = "Sony Corporation. PDX-224(WAIPIO v2 QRD with PM8010)";
	compatible = "somc,pdx224-generic", "qcom,waipio", "qcom,qrd";
	qcom,board-id = <0x1000b 0>;
};
