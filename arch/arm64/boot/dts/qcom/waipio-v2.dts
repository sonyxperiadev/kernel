/dts-v1/;

#include "waipio-v2.dtsi"

#include "audio-devicetree/waipio-audio.dts"
#include "camera-devicetree/waipio-camera.dts"
#include "display-devicetree/display/waipio-sde.dts"
#include "mmrm-devicetree/waipio-mmrm.dts"
#include "video-devicetree/waipio-vidc.dts"

/ {
	model = "Qualcomm Technologies, Inc. Waipio v2 SoC";
	compatible = "qcom,waipio";
	qcom,board-id = <0 0>;
};
