/dts-v1/;

#include "sa2150p-ccard.dtsi"

/ {
	model = "Qualcomm Technologies, Inc. SA2150P CCARD EMMC";
	compatible = "qcom,sa2150p-ccard", "qcom,qcs405", "qcom,sa2150p",
				"qcom,ccard";
	qcom,board-id = <25 0>, <25 0x100>;
};
