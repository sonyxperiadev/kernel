/dts-v1/;
/plugin/;

#include "kalama-qrd.dtsi"
#include "kalama-yodo-pdx234_generic.dtsi"

/ {
	model = "Sony Corporation. PDX-234(Kalama QRD)";
	compatible = "somc,pdx234-generic", "qcom,kalama", "qcom,qrd";
	qcom,msm-id = <519 0x10000>, <536 0x10000>, <519 0x20000>, <536 0x20000>, <600 0x20000>, <601 0x20000>;
	qcom,board-id = <0x1000B 0>;
};
