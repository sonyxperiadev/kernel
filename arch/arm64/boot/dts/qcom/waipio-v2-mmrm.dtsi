&soc {
	msm_mmrm: qcom,mmrm {
		compatible = "qcom,msm-mmrm", "qcom,waipio-mmrm";
		status = "okay";

		/* MMRM clock threshold */
		mmrm-peak-threshold = <9000>;

		/* MM Rail info */
		mm-rail-corners = "lowsvs", "svs", "svsl1", "nom", "turbo";
		mm-rail-fact-volt = <36438 41157 44827 49152 54526>;

		/* Scaling factors */
		scaling-fact-dyn = <35389 45876 54395 66192 82575>;
		scaling-fact-leak = <451543 548537 633078 746456 920125>;

		/* Client info */
		mmrm-client-info =
			<0x1 CAM_CC_IFE_0_CLK_SRC 33751040 279839 1>,
			<0x1 CAM_CC_IFE_1_CLK_SRC 33751040 279839 1>,
			<0x1 CAM_CC_IFE_2_CLK_SRC 33751040 279839 1>,
			<0x1 CAM_CC_CSID_CLK_SRC 2160722 0 3>,
			<0x1 CAM_CC_SFE_0_CLK_SRC 19333120 132383 1>,
			<0x1 CAM_CC_SFE_1_CLK_SRC 19333120 132383 1>,
			<0x1 CAM_CC_IPE_NPS_CLK_SRC 67436544 587203 1>,
			<0x1 CAM_CC_BPS_CLK_SRC 70584893 334234 1>,
			<0x1 CAM_CC_IFE_LITE_CLK_SRC 8492155 11796 5>,
			<0x1 CAM_CC_JPEG_CLK_SRC 1097073 595067 2>,
			<0x1 CAM_CC_CAMNOC_AXI_CLK_SRC 7602176 3533701 1>,
			<0x1 CAM_CC_IFE_LITE_CSID_CLK_SRC 262144 0 5>,
			<0x1 CAM_CC_ICP_CLK_SRC 314573 0 1>,
			<0x1 CAM_CC_CPHY_RX_CLK_SRC 222822 0 9>,
			<0x1 CAM_CC_CSI0PHYTIMER_CLK_SRC 6554 0 1>,
			<0x1 CAM_CC_CSI1PHYTIMER_CLK_SRC 6554 0 1>,
			<0x1 CAM_CC_CSI2PHYTIMER_CLK_SRC 6554 0 1>,
			<0x1 CAM_CC_CSI3PHYTIMER_CLK_SRC 6554 0 1>,
			<0x1 CAM_CC_CSI4PHYTIMER_CLK_SRC 6554 0 1>,
			<0x1 CAM_CC_CSI5PHYTIMER_CLK_SRC 6554 0 1>,
			<0x1 CAM_CC_CCI_0_CLK_SRC 655 0 1>,
			<0x1 CAM_CC_CCI_1_CLK_SRC 655 0 1>,
			<0x1 CAM_CC_SLOW_AHB_CLK_SRC 70124 0 1>,
			<0x1 CAM_CC_FAST_AHB_CLK_SRC 35389 0 1>,
			<0x2 VIDEO_CC_MVS1_CLK_SRC 81149297 488243 1>,
			<0x3 DISP_CC_MDSS_MDP_CLK_SRC 21954560 184812 1>,
			<0x3 DISP_CC_MDSS_DPTX0_LINK_CLK_SRC 1004667 5243 1>,
			<0x4 VIDEO_CC_MVS0_CLK_SRC 28970189 582287 1>;
	};
};
