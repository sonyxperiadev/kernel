&soc {
    egistec_fingerprint {
        status = "ok";
        compatible = "egistec,et613";
        interrupt-parent = <&tlmm>;
        interrupts = <17 0x0>;
        egistec,gpio_rst= <&tlmm 18 0>;
        egistec,gpio_irq = <&tlmm 17 0>;
        egistec,gpio_pwr_en = <&tlmm 70 0 >;
        egistec,gpio_ldo1p8_en = <&tlmm 87 0 >;
    };
};