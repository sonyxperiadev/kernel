/dts-v1/;
/plugin/;

#include <dt-bindings/clock/qcom,gcc-kalama.h>
#include <dt-bindings/clock/qcom,camcc-kalama.h>
#include <dt-bindings/interconnect/qcom,kalama.h>
#include <dt-bindings/interrupt-controller/arm-gic.h>
#include <dt-bindings/regulator/qcom,rpmh-regulator-levels.h>

#include "kalama-sg-hhg-camera-sensor.dtsi"
/ {
	model = "Qualcomm Technologies, Inc. Kalama SG HHG";
	compatible = "qcom,kalama-hhg", "qcom,kalama", "qcom,hhg";
	qcom,msm-id = <600 0x20000>, <601 0x20000>;
	qcom,board-id = <0x1001f 0x1>;
};