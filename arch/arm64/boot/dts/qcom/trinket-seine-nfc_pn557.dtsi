/* arch/arm64/boot/dts/somc/trinket-seine-nfc_pn557.dtsi
 *
 * This program is free software; you can redistribute it and/or modify
 * it under the terms of the GNU General Public License version 2 and
 * only version 2 as published by the Free Software Foundation.
 *
 * This program is distributed in the hope that it will be useful,
 * but WITHOUT ANY WARRANTY; without even the implied warranty of
 * MERCHANTABILITY or FITNESS FOR A PARTICULAR PURPOSE.  See the
 * GNU General Public License for more details.
 */

&qupv3_se1_i2c {
    /delete-node/ nq@28;
	nfc@28 {
		compatible = "nxp,pn553";
		reg = <0x28>;
		interrupt-parent = <&tlmm>;
		interrupts = <85 0x1>;
		nxp,irq_gpio = <&tlmm 85 0x00>;
		nxp,dwld_en = <&tlmm 84 0x00>;
		nxp,ven = <&tlmm 83 0x01>;
		nxp,ese-pwr = <&tlmm 24 0x00>;
	};
};

&soc {
	nfc,pm-ops {
		compatible = "sony,pn553-pm-ops";
	};
};
