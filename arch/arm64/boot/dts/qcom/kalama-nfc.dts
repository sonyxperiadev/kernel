/dts-v1/;
/plugin/;

#include "kalama-pinctrl.dtsi"
/ {
	model = "Qualcomm Technologies, Inc. Kalama";
	compatible = "qcom,kalama";
	qcom,msm-id = <519 0x10000>, <536 0x10000>;
	qcom,board-id = <0 0>;
};
