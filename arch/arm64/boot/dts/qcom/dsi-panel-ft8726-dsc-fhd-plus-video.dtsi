&mdss_mdp {
	dsi_ft8726_fhd_plus_120_video: qcom,mdss_dsi_ft8726_fhd_plus_120_video {
		qcom,mdss-dsi-panel-name =
			"ft8726 lcd video mode dsi focaltech panel with DSC";
		qcom,mdss-dsi-panel-type = "dsi_video_mode";
		qcom,dsi-ctrl-num = <0>;
		qcom,dsi-phy-num = <0>;
		qcom,mdss-dsi-virtual-channel-id = <0>;
		qcom,mdss-dsi-stream = <0>;
		qcom,mdss-dsi-bpp = <24>;
		qcom,mdss-dsi-border-color = <0>;
		qcom,mdss-dsi-traffic-mode = "burst_mode";
		qcom,mdss-dsi-bllp-power-mode;
		qcom,mdss-dsi-bllp-eof-power-mode;
		qcom,mdss-dsi-lane-0-state;
		qcom,mdss-dsi-lane-1-state;
		qcom,mdss-dsi-lane-2-state;
		qcom,mdss-dsi-lane-3-state;
		qcom,mdss-dsi-dma-trigger = "trigger_sw";
		qcom,mdss-dsi-mdp-trigger = "none";
		qcom,mdss-dsi-reset-sequence = <1 10>, <0 10>, <1 10>;
		qcom,mdss-dsi-tx-eot-append;
		qcom,adjust-timer-wakeup-ms = <1>;

		qcom,mdss-dsi-display-timings {
			timing@0 {
				qcom,mdss-dsi-panel-width = <1080>;
				qcom,mdss-dsi-panel-height = <2408>;
				qcom,mdss-dsi-h-front-porch = <40>;
				qcom,mdss-dsi-h-back-porch = <36>;
				qcom,mdss-dsi-h-pulse-width = <12>;
				qcom,mdss-dsi-h-sync-skew = <0>;
				qcom,mdss-dsi-v-back-porch = <18>;
				qcom,mdss-dsi-v-front-porch = <56>;
				qcom,mdss-dsi-v-pulse-width = <2>;
				qcom,mdss-dsi-panel-framerate = <120>;
				qcom,mdss-dsi-on-command = [
					15 01 00 00 00 00 02 00 00
					39 01 00 00 00 00 04 FF 87 20 01
					15 01 00 00 00 00 02 00 80
					39 01 00 00 00 00 03 FF 87 20
					15 01 00 00 00 00 02 00 00
					39 01 00 00 00 00 05 2A 00 00 04 37
					15 01 00 00 00 00 02 00 00
					39 01 00 00 00 00 05 2B 00 00 09 67
					15 01 00 00 00 00 02 00 A3
					39 01 00 00 00 00 05 B3 09 68 00 18
					15 01 00 00 00 00 02 00 80
					39 01 00 00 00 00 07 C0 00 4A 00 3B 00 11
					15 01 00 00 00 00 02 00 90
					39 01 00 00 00 00 07 C0 00 4A 00 3B 00 11
					15 01 00 00 00 00 02 00 A0
					39 01 00 00 00 00 07 C0 00 5A 00 3B 00 11
					15 01 00 00 00 00 02 00 B0
					39 01 00 00 00 00 06 C0 00 D3 00 3B 11
					15 01 00 00 00 00 02 00 60
					39 01 00 00 00 00 07 C0 00 B4 00 3B 00 11
					15 01 00 00 00 00 02 00 70
					39 01 00 00 00 00 0D C0 00 C8 00 C8 0D 03 14 00 00 15 01 11
					15 01 00 00 00 00 02 00 A3
					39 01 00 00 00 00 07 C1 00 55 00 27 00 02
					15 01 00 00 00 00 02 00 80
					39 01 00 00 00 00 11 CE 01 81 FF FF 00 C8 00 C8 00 00 00 00 01 90 01 90
					15 01 00 00 00 00 02 00 90
					39 01 00 00 00 00 10 CE 00 BD 12 75 00 BD 80 FF FF 00 06 40 0A 0E 00
					15 01 00 00 00 00 02 00 A0
					39 01 00 00 00 00 04 CE 00 00 00
					15 01 00 00 00 00 02 00 B0
					39 01 00 00 00 00 04 CE 22 00 00
					15 01 00 00 00 00 02 00 D1
					39 01 00 00 00 00 08 CE 00 00 01 00 00 00 00
					15 01 00 00 00 00 02 00 E1
					39 01 00 00 00 00 0C CE 04 03 14 03 14 00 00 00 00 00 00
					15 01 00 00 00 00 02 00 F1
					39 01 00 00 00 00 0A CE 2A 2A 00 01 20 01 0D 00 00
					15 01 00 00 00 00 02 00 B0
					39 01 00 00 00 00 05 CF 00 00 9D A1
					15 01 00 00 00 00 02 00 B5
					39 01 00 00 00 00 05 CF 05 05 00 04
					15 01 00 00 00 00 02 00 C0
					39 01 00 00 00 00 05 CF 09 09 63 67
					15 01 00 00 00 00 02 00 C5
					39 01 00 00 00 00 05 CF 09 09 69 6D
					15 01 00 00 00 00 02 00 D1
					39 01 00 00 00 00 0D C1 0A A6 0E C8 19 67 07 E3 0B 11 13 04
					15 01 00 00 00 00 02 00 E1
					39 01 00 00 00 00 03 C1 0E C8
					15 01 00 00 00 00 02 00 E4
					39 01 00 00 00 00 0D CF 0A 07 0A 06 0A 06 0A 06 0A 06 0A 06
					15 01 00 00 00 00 02 00 80
					39 01 00 00 00 00 03 C1 44 44
					15 01 00 00 00 00 02 00 90
					15 01 00 00 00 00 02 C1 03
					15 01 00 00 00 00 02 00 F5
					15 01 00 00 00 00 02 CF 02
					15 01 00 00 00 00 02 00 F6
					15 01 00 00 00 00 02 CF 78
					15 01 00 00 00 00 02 00 F1
					15 01 00 00 00 00 02 CF 78
					15 01 00 00 00 00 02 00 F0
					15 01 00 00 00 00 02 C1 00
					15 01 00 00 00 00 02 00 CC
					15 01 00 00 00 00 02 C1 18
					15 01 00 00 00 00 02 00 91
					15 01 00 00 00 00 02 C4 88
					15 01 00 00 00 00 02 00 80
					15 01 00 00 00 00 02 C5 88
					15 01 00 00 00 00 02 00 80
					39 01 00 00 00 00 09 C2 82 01 1F 1F 00 00 00 00
					15 01 00 00 00 00 02 00 90
					39 01 00 00 00 00 05 C2 00 00 00 00
					15 01 00 00 00 00 02 00 A0
					39 01 00 00 00 00 10 C2 00 00 00 17 8D 01 00 00 17 8D 02 00 00 17 8D
					15 01 00 00 00 00 02 00 B0
					39 01 00 00 00 00 0B C2 03 00 00 17 8D 80 08 03 02 02
					15 01 00 00 00 00 02 00 CA
					39 01 00 00 00 00 06 C2 84 08 03 01 81
					15 01 00 00 00 00 02 00 E0
					39 01 00 00 00 00 06 C2 33 33 70 00 70
					15 01 00 00 00 00 02 00 E8
					39 01 00 00 00 00 09 C2 00 00 00 00 00 00 00 00
					15 01 00 00 00 00 02 00 D0
					39 01 00 00 00 00 11 C3 00 00 00 00 00 00 00 00 00 00 00 00 00 00 00 00
					15 01 00 00 00 00 02 00 80
					39 01 00 00 00 00 11 CB 00 01 00 03 FD 01 01 00 00 00 FD 01 00 03 00 00
					15 01 00 00 00 00 02 00 90
					39 01 00 00 00 00 11 CB 00 00 00 0F F0 00 00 00 00 00 FF 00 00 00 00 00
					15 01 00 00 00 00 02 00 A0
					39 01 00 00 00 00 05 CB 00 00 00 00
					15 01 00 00 00 00 02 00 A4
					39 01 00 00 00 00 05 CB 03 00 0C 00
					15 01 00 00 00 00 02 00 B0
					39 01 00 00 00 00 05 CB 13 58 05 30
					15 01 00 00 00 00 02 00 C0
					39 01 00 00 00 00 05 CB 13 58 05 30
					15 01 00 00 00 00 02 00 D5
					39 01 00 00 00 00 0C CB 00 00 00 00 00 00 00 00 00 00 00
					15 01 00 00 00 00 02 00 E0
					39 01 00 00 00 00 0E CB 00 00 00 00 00 00 00 00 00 00 00 00 00
					15 01 00 00 00 00 02 00 80
					39 01 00 00 00 00 11 CC 23 12 23 1C 23 0A 23 23 09 08 07 06 23 23 23 23
					15 01 00 00 00 00 02 00 90
					39 01 00 00 00 00 09 CC 23 18 16 17 23 19 1A 1B
					15 01 00 00 00 00 02 00 A0
					39 01 00 00 00 00 11 CC 23 12 23 1D 23 0E 23 23 06 07 08 09 23 23 23 23
					15 01 00 00 00 00 02 00 B0
					39 01 00 00 00 00 09 CC 23 18 16 17 23 19 1A 1B
					15 01 00 00 00 00 02 00 80
					39 01 00 00 00 00 11 CD 23 23 23 02 23 0A 23 23 09 08 07 06 23 23 23 23
					15 01 00 00 00 00 02 00 90
					39 01 00 00 00 00 09 CD 23 18 16 17 23 19 1A 1B
					15 01 00 00 00 00 02 00 A0
					39 01 00 00 00 00 11 CD 23 23 23 02 23 0E 23 23 06 07 08 09 23 23 23 23
					15 01 00 00 00 00 02 00 B0
					39 01 00 00 00 00 09 CD 23 18 16 17 23 19 1A 1B
					15 01 00 00 00 00 02 00 86
					39 01 00 00 00 00 07 C0 00 00 00 01 0F 05
					15 01 00 00 00 00 02 00 96
					39 01 00 00 00 00 07 C0 00 00 00 01 0F 05
					15 01 00 00 00 00 02 00 A6
					39 01 00 00 00 00 07 C0 00 00 00 01 0F 03
					15 01 00 00 00 00 02 00 A3
					39 01 00 00 00 00 07 CE 00 00 00 01 0F 05
					15 01 00 00 00 00 02 00 B3
					39 01 00 00 00 00 07 CE 00 00 00 01 0F 05
					15 01 00 00 00 00 02 00 69
					39 01 00 00 00 00 04 C0 01 14 01
					15 01 00 00 00 00 02 00 82
					39 01 00 00 00 00 03 A7 10 00
					15 01 00 00 00 00 02 00 8D
					15 01 00 00 00 00 02 A7 01
					15 01 00 00 00 00 02 00 8F
					15 01 00 00 00 00 02 A7 01
					15 01 00 00 00 00 02 00 93
					15 01 00 00 00 00 02 C5 37
					15 01 00 00 00 00 02 00 97
					15 01 00 00 00 00 02 C5 37
					15 01 00 00 00 00 02 00 9A
					15 01 00 00 00 00 02 C5 32
					15 01 00 00 00 00 02 00 9C
					15 01 00 00 00 00 02 C5 32
					15 01 00 00 00 00 02 00 B6
					39 01 00 00 00 00 09 C5 10 10 0E 0E 10 10 0E 0E
					15 01 00 00 00 00 02 00 88
					15 01 00 00 00 00 02 C4 08
					15 01 00 00 00 00 02 00 80
					15 01 00 00 00 00 02 A7 03
					15 01 00 00 00 00 02 00 B0
					15 01 00 00 00 00 02 C5 D1
					15 01 00 00 00 00 02 00 B3
					15 01 00 00 00 00 02 C5 D1
					15 01 00 00 00 00 02 00 99
					15 01 00 00 00 00 02 CF 50
					15 01 00 00 00 00 02 00 8C
					15 01 00 00 00 00 02 C3 00
					15 01 00 00 00 00 02 00 A0
					39 01 00 00 00 00 03 C3 35 21
					15 01 00 00 00 00 02 00 A4
					39 01 00 00 00 00 03 C3 01 20
					15 01 00 00 00 00 02 00 AA
					15 01 00 00 00 00 02 C3 21
					15 01 00 00 00 00 02 00 AD
					15 01 00 00 00 00 02 C3 01
					15 01 00 00 00 00 02 00 AE
					15 01 00 00 00 00 02 C3 20
					15 01 00 00 00 00 02 00 B3
					15 01 00 00 00 00 02 C3 21
					15 01 00 00 00 00 02 00 B6
					39 01 00 00 00 00 03 C3 01 20
					15 01 00 00 00 00 02 00 C3
					15 01 00 00 00 00 02 C5 FF
					15 01 00 00 00 00 02 00 A9
					15 01 00 00 00 00 02 F5 8E
					15 01 00 00 00 00 02 00 B0
					15 01 00 00 00 00 02 B3 00
					15 01 00 00 00 00 02 00 83
					15 01 00 00 00 00 02 B0 63
					15 01 00 00 00 00 02 00 93
					15 01 00 00 00 00 02 C4 08
					15 01 00 00 00 00 02 00 80
					15 01 00 00 00 00 02 B3 22
					15 01 00 00 00 00 02 00 90
					15 01 00 00 00 00 02 C3 08
					15 01 00 00 00 00 02 00 FA
					15 01 00 00 00 00 02 C2 14
					15 01 00 00 00 00 02 00 CA
					15 01 00 00 00 00 02 C0 80
					15 01 00 00 00 00 02 00 82
					15 01 00 00 00 00 02 F5 01
					15 01 00 00 00 00 02 00 93
					15 01 00 00 00 00 02 F5 01
					15 01 00 00 00 00 02 00 9B
					15 01 00 00 00 00 02 F5 49
					15 01 00 00 00 00 02 00 9D
					15 01 00 00 00 00 02 F5 49
					15 01 00 00 00 00 02 00 BE
					39 01 00 00 00 00 03 C5 F0 F0
					15 01 00 00 00 00 02 00 85
					15 01 00 00 00 00 02 A7 01
					15 01 00 00 00 00 02 00 DC
					15 01 00 00 00 00 02 C3 37
					15 01 00 00 00 00 02 00 8A
					15 01 00 00 00 00 02 F5 C7
					15 01 00 00 00 00 02 00 99
					15 01 00 00 00 00 02 CF 50
					15 01 00 00 00 00 02 00 9C
					15 01 00 00 00 00 02 F5 00
					15 01 00 00 00 00 02 00 9E
					15 01 00 00 00 00 02 F5 00
					15 01 00 00 00 00 02 00 B0
					39 01 00 00 00 00 07 C5 D0 4A 39 D0 4A 0F
					15 01 00 00 00 00 02 00 C2
					15 01 00 00 00 00 02 F5 42
					15 01 00 00 00 00 02 00 00
					39 01 00 00 00 00 29 E1 00 05 0A 12 1A 1D 25 2C 37 B4 3F 46 4C 52 A8 56 5F 66 6D C9 73 7A 81 89 ED 91 96 9B A2 EC A8 B0 B9 BF 9D C5 CB D0 D3 38
					15 01 00 00 00 00 02 00 30
					39 01 00 00 00 00 29 E1 00 05 0A 12 1A 1D 25 2C 37 B4 3F 46 4C 52 A8 56 5F 66 6D C9 73 7A 81 89 ED 91 96 9B A2 EC A8 B0 B9 BF 9D C5 CB D0 D3 38
					15 01 00 00 00 00 02 00 60
					39 01 00 00 00 00 29 E1 00 05 0A 13 2C 1E 26 2D 37 13 40 47 4D 53 68 57 60 67 6F EC 75 7C 84 8C A0 95 9B A1 A7 83 AF B9 C5 CD E9 D5 E1 E9 ED FA
					15 01 00 00 00 00 02 00 90
					39 01 00 00 00 00 29 E1 00 05 0A 13 2C 1E 26 2D 37 13 40 47 4D 53 68 57 60 67 6F EC 75 7C 84 8C A0 95 9B A1 A7 83 AF B9 C5 CD E9 D5 E1 E9 ED FA
					15 01 00 00 00 00 02 00 C0
					39 01 00 00 00 00 29 E1 00 05 0A 12 1B 1D 26 2C 37 CF 40 47 4D 53 6D 58 60 68 6F 36 76 7D 85 8D 10 96 9C A2 A9 86 B1 BC C9 D2 D9 DD EC F7 FF FC
					15 01 00 00 00 00 02 00 F0
					39 01 00 00 00 00 11 E1 00 05 0A 12 1B 1D 26 2C 37 CF 40 47 4D 53 6D 58
					15 01 00 00 00 00 02 00 00
					39 01 00 00 00 00 19 E2 60 68 6F 36 76 7D 85 8D 10 96 9C A2 A9 86 B1 BC C9 D2 D9 DD EC F7 FF FC
					15 01 00 00 00 00 02 00 D4
					15 01 00 00 00 00 02 CB 03
					15 01 00 00 00 00 02 00 B0
					39 01 00 00 00 00 0F B4 00 08 02 00 00 BB 00 07 0D B7 0C B7 10 F0
					15 01 00 00 00 00 02 00 E8
					15 01 00 00 00 00 02 C0 40
					15 01 00 00 00 00 02 00 00
					39 01 00 00 00 00 04 FF FF FF FF
					15 01 00 00 00 00 02 51 F0
					15 01 00 00 00 00 02 53 2C
					15 01 00 00 00 00 02 55 00
					05 01 00 00 32 00 01 11
					05 01 00 00 14 00 01 29
				];
				qcom,mdss-dsi-on-command-state = "dsi_lp_mode";
				qcom,mdss-dsi-off-command = [
					05 01 00 00 10 00 01 28
					05 01 00 00 32 00 01 10
				];
				qcom,mdss-dsi-off-command-state = "dsi_lp_mode";
				qcom,compression-mode = "dsc";
				qcom,mdss-dsc-slice-height = <8>;
				qcom,mdss-dsc-slice-width = <540>;
				qcom,mdss-dsc-slice-per-pkt = <1>;
				qcom,mdss-dsc-bit-per-component = <8>;
				qcom,mdss-dsc-bit-per-pixel = <8>;
				qcom,mdss-dsc-block-prediction-enable;
			};
		};
	};
};
