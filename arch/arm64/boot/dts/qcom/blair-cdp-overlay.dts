/dts-v1/;
/plugin/;

#include "blair-cdp.dtsi"

/ {
	model = "Qualcomm Technologies, Inc. Blair CDP";
	compatible = "qcom,blair-cdp", "qcom,blair", "qcom,cdp";
	qcom,msm-id = <507 0x10000>, <578 0x10000>;
	qcom,board-id = <1 0>;
};

&wsa881x_analog_reset_gpio {
	pinctrl-0 = <&spkr_1_sd_n_active>;
	pinctrl-1 = <&spkr_1_sd_n_sleep>;
};
