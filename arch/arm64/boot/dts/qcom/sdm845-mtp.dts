// SPDX-License-Identifier: GPL-2.0-only
/*
 * Copyright (c) 2016-2017, The Linux Foundation. All rights reserved.
 */

/dts-v1/;

#include "sdm845.dtsi"
#include "sdm845-sde-display.dtsi"
#include "sdm845-mtp.dtsi"

/ {
	model = "Qualcomm Technologies, Inc. MSM sdm845 v1 MTP";
	compatible = "qcom,sdm845-mtp", "qcom,sdm845", "qcom,mtp";
	qcom,board-id = <8 0>;
};
