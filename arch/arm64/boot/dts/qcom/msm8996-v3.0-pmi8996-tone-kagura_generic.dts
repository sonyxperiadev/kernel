/* Copyright (c) 2015, The Linux Foundation. All rights reserved.
 *
 * This program is free software; you can redistribute it and/or modify
 * it under the terms of the GNU General Public License version 2 and
 * only version 2 as published by the Free Software Foundation.
 *
 * This program is distributed in the hope that it will be useful,
 * but WITHOUT ANY WARRANTY; without even the implied warranty of
 * MERCHANTABILITY or FITNESS FOR A PARTICULAR PURPOSE.  See the
 * GNU General Public License for more details.
 */
/*
 * Copyright (C) 2016 Sony Mobile Communications Inc.
 *
 * This program is free software; you can redistribute it and/or modify
 * it under the terms of the GNU General Public License version 2, as
 * published by the Free Software Foundation.
 */


/dts-v1/;

#include "msm8996-v3.0.dtsi"
#include "msm-pmi8996.dtsi"
#include "msm8996-mtp.dtsi"
#include "msm8996-tone-common.dtsi"
#include "msm8996-tone-kagura-camera.dtsi"
#include "msm8996-tone-kagura-common.dtsi"
#include "msm8996-tone-kagura_generic.dtsi"
#include "dsi-panel-somc-kagura.dtsi"

/ {
	model = "SoMC Kagura-ROW";
	compatible = "somc,kagura-row", "qcom,msm8996";
	qcom,board-id = <8 0>;
};
