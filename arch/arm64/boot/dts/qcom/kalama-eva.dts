/dts-v1/;
/plugin/;

#include <dt-bindings/interrupt-controller/arm-gic.h>
#include <dt-bindings/soc/qcom,ipcc.h>
#include <dt-bindings/interconnect/qcom,kalama.h>
#include <dt-bindings/clock/qcom,videocc-kalama.h>
#include <dt-bindings/clock/qcom,gcc-kalama.h>
#include "kalama-eva.dtsi"

/ {
	model = "Qualcomm Technologies, Inc. kalama v1 SoC";
	compatible = "qcom,kalama";
	qcom,msm-id = <519 0x10000>, <536 0x10000>;
	qcom,board-id = <0 0>;
};