&sm5038_charger {
	battery,chg-fastchg-current-ma = <3500>;
	battery,thermal-mitigation = <3500000 1500000
			1000000 500000 500000 500000 500000>;
	battery,thermal-mitigation-sleep = <3500000 2500000
			2000000 1500000 1000000 500000 500000>;
	battery,chg-float-voltage-uv = <4480000>;
	battery,jeita-fcc-ranges = <50  120  1000000
				    121 150  2000000
				    151 200  2500000
				    201 450  3500000
				    451 550  1450000>;
	battery,jeita-fv-ranges = <50  120  4480000
				    121 150  4480000
				    151 200  4480000
				    201 450  4480000
				    451 550  4200000>;
	battery,step-chg-ranges = <3600000  4150000  3500000
	  			   4150001  4250000  3500000
				   4250001  4300000  2500000
				   4300001  4400000  1500000
				   4400001  4480000  1500000>;

	somc,thermal-fcc-ma = <
		3500 2000 1000 500 100 100 100 0 0
		600 600 600 300 300 300 0 0 0 0>;
	somc,thermal-usb-icl-ma = <
		3500 3500 35000 3500 3500 3500 3500 0 0
		600 600 600 300 300 300 0 0 0 0>;
	somc,thermal-charging-indication = <
		0 0 0 0 0 0 0 0 2 2
		0 0 0 0 0 2 2 2 2>;
	somc,thermal-fcc-sleep-ma = <
		3500 2800 2400 2000 1000 500 100 100 0
		600 600 600 300 300 300 0 0 0 0>;
	somc,thermal-usb-icl-sleep-ma = <
		3500 2800 2400 2000 1000 500 100 100 0
		600 600 600 300 300 300 0 0 0 0>;
	somc,thermal-charging-indication-sleep = <
		0 0 0 0 0 0 0 0 0 2
		0 0 0 0 0 2 2 2 2>;
	somc,thermal-usb-cc-open = <
		0 0 0 0 0 0 0 0 0 0 0 0 0 0 0 0 0 0 1>;

	somc,batt-aging-soc-adjust = <10000 10315 10507 10741 11107 11318>;
	somc,step-cell-impedance-mohm = <0>;
	somc,step-cfg-lv0 = <
			(-2550)  50    0 5000    0 4480 1
			    50  120    0 4400  950 4480 2
			    50  120 4400 5000  700 4480 2
			   120  150    0 4150 2450 4480 3
			   120  150 4150 4250 1950 4480 3
			   120  150 4250 4350 1450 4480 3
			   120  150 4350 5000  950 4480 3
			   150  200    0 4150 2950 4480 3
			   150  200 4150 4250 2450 4480 3
			   150  200 4250 4350 1950 4480 3
			   150  200 4350 5000 1450 4480 3
			   200  350    0 4250 3500 4480 3
			   200  350 4250 4300 3500 4480 3
			   200  350 4300 4400 2450 4480 3
			   200  350 4400 5000 1700 4480 3
			   350  450    0 4250 3500 4480 3
			   350  450 4250 4300 3500 4480 3
			   350  450 4300 4400 2450 4480 3
			   350  450 4400 5000 1700 4480 3
			   450  550    0 5000 1450 4200 4
			   550 2550    0 5000    0 4200 5>;
	somc,step-cfg-lv1 = <
			(-2550)  50    0 5000    0 4450 1
			    50  120    0 4400  950 4450 2
			    50  120 4400 5000  700 4450 2
			   120  150    0 4150 2450 4450 3
			   120  150 4150 4250 1950 4450 3
			   120  150 4250 4350 1450 4450 3
			   120  150 4350 5000  950 4450 3
			   150  200    0 4150 2700 4450 3
			   150  200 4150 4250 2200 4450 3
			   150  200 4250 4350 1950 4450 3
			   150  200 4350 5000 1450 4450 3
			   200  350    0 4200 3500 4450 3
			   200  350 4200 4250 3400 4450 3
			   200  350 4250 4350 2200 4450 3
			   200  350 4350 5000 1450 4450 3
			   350  450    0 4200 3500 4450 3
			   350  450 4200 4250 3400 4450 3
			   350  450 4250 4350 2200 4450 3
			   350  450 4350 5000 1450 4450 3
			   450  550    0 5000 1450 4200 4
			   550 2550    0 5000    0 4200 5>;
	somc,step-cfg-lv2 = <
			(-2550)  50    0 5000    0 4430 1
			    50  120    0 4400  950 4430 2
			    50  120 4400 5000  700 4430 2
			   120  150    0 4150 2200 4430 3
			   120  150 4150 4250 1700 4430 3
			   120  150 4250 4350 1450 4430 3
			   120  150 4350 5000  950 4430 3
			   150  200    0 4150 2700 4430 3
			   150  200 4150 4250 2200 4430 3
			   150  200 4250 4350 1950 4430 3
			   150  200 4350 5000 1200 4430 3
			   200  350    0 4200 3500 4430 3
			   200  350 4200 4250 3400 4430 3
			   200  350 4250 4350 2200 4430 3
			   200  350 4350 5000 1450 4430 3
			   350  450    0 4200 3500 4430 3
			   350  450 4200 4250 3400 4430 3
			   350  450 4250 4350 2200 4430 3
			   350  450 4350 5000 1450 4430 3
			   450  550    0 5000 1450 4200 4
			   550 2550    0 5000    0 4200 5>;
	somc,step-cfg-lv3 = <
			(-2550)  50    0 5000    0 4400 1
			    50  120    0 5000  950 4400 2
			   120  150    0 4150 1950 4400 3
			   120  150 4150 4250 1450 4400 3
			   120  150 4250 5000  950 4400 3
			   150  200    0 4100 2450 4400 3
			   150  200 4100 4200 1950 4400 3
			   150  200 4200 4300 1700 4400 3
			   150  200 4300 5000  950 4400 3
			   200  350    0 4150 3500 4400 3
			   200  350 4150 4200 2950 4400 3
			   200  350 4200 4300 1700 4400 3
			   200  350 4300 5000 1200 4400 3
			   350  450    0 4150 3500 4400 3
			   350  450 4150 4200 2950 4400 3
			   350  450 4200 4300 1700 4400 3
			   350  450 4300 5000 1200 4400 3
			   450  550    0 5000 1450 4200 4
			   550 2550    0 5000    0 4200 5>;
	somc,step-cfg-lv4 = <
			(-2550)  50    0 5000    0 4370 1
			    50  120    0 5000  950 4370 2
			   120  150    0 4150 1950 4370 3
			   120  150 4150 4250 1450 4370 3
			   120  150 4250 5000  950 4370 3
			   150  200    0 4100 2450 4370 3
			   150  200 4100 4200 1950 4370 3
			   150  200 4200 4300 1700 4370 3
			   150  200 4300 5000  950 4370 3
			   200  350    0 4150 3500 4370 3
			   200  350 4150 4200 2950 4370 3
			   200  350 4200 4300 1700 4370 3
			   200  350 4300 5000 1200 4370 3
			   350  450    0 4150 3500 4370 3
			   350  450 4150 4200 2950 4370 3
			   350  450 4200 4300 1700 4370 3
			   350  450 4300 5000 1200 4370 3
			   450  550    0 5000 1450 4200 4
			   550 2550    0 5000    0 4200 5>;
	somc,step-cfg-lv5 = <
			(-2550)  50    0 5000    0 4350 1
			    50  120    0 5000  950 4350 2
			   120  150    0 4150 1950 4350 3
			   120  150 4150 4250 1450 4350 3
			   120  150 4250 5000  950 4350 3
			   150  200    0 4100 2450 4350 3
			   150  200 4100 4200 1950 4350 3
			   150  200 4200 4300 1700 4350 3
			   150  200 4300 5000  950 4350 3
			   200  350    0 4150 3500 4350 3
			   200  350 4150 4200 2950 4350 3
			   200  350 4200 4300 1700 4350 3
			   200  350 4300 5000 1200 4350 3
			   350  450    0 4150 3500 4350 3
			   350  450 4150 4200 2950 4350 3
			   350  450 4200 4300 1700 4350 3
			   350  450 4300 5000 1200 4350 3
			   450  550    0 5000 1450 4200 4
			   550 2550    0 5000    0 4200 5>;
	panel = <&dsi_samsung_amoled_cmd>;
};

&sm5038_fuelgauge {

};
