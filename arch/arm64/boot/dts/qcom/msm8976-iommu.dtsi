/* Copyright (c) 2014-2015, The Linux Foundation. All rights reserved.
 * Copyright (c) 2017, AngeloGioacchino Del Regno <kholk11@gmail.com>
 *
 * This program is free software; you can redistribute it and/or modify
 * it under the terms of the GNU General Public License version 2 and
 * only version 2 as published by the Free Software Foundation.
 *
 * This program is distributed in the hope that it will be useful,
 * but WITHOUT ANY WARRANTY; without even the implied warranty of
 * MERCHANTABILITY or FITNESS FOR A PARTICULAR PURPOSE.  See the
 * GNU General Public License for more details.
 */

&soc {
	/*
	 * kgsl_smmu range: 0x1f00000 - 0x1f10000
	 *
	 *  === context mapping ===
	 * 0x1f00000 - 0x1f08000: General purpose KGSL range
	 * 0x1f08000 - 0x1f09000: User (not secure) context
	 * 0x1f09000 - 0x1f0a000: Secure KGSL context
	 * 0x1f0a000 - 0x1f0b000: Private KGSL context (deprecated)
	 * 0x1f0b000 - 0x1f10000: Unused range?
	 *
	 *  === config irqs ===
	 * global_cfg_S_irq:  <0 42 0>
	 * global_cfg_NS_irq: <0 43 0>
	 *
	 *  === other irqs ===
	 * User context:    240
	 * Secure context:  241
	 * Private context: 242
	 */
	kgsl_smmu: arm,smmu-kgsl@1f00000 {
		compatible = "qcom,smmu-v2"; //, "arm,mmu-500";
		reg = <0x1f00000 0x10000>;

		/* GPU Secure ID is 18 */
		qcom,tz-device-id = "GPU";

		#iommu-cells = <1>;
		#clock-cells = <1>;
		#global-interrupts = <1>;

		qcom,dynamic;
		qcom,register-save;
		qcom,skip-init;

		qcom,enable-smmu-halt;
		qcom,enable-static-cb;
		qcom,no-smr-check;

		vdd-supply = <&gdsc_oxili_cx>;

		interrupts = <GIC_SPI 240 IRQ_TYPE_LEVEL_HIGH>,
			     <GIC_SPI 241 IRQ_TYPE_LEVEL_HIGH>,
			     <GIC_SPI 242 IRQ_TYPE_LEVEL_HIGH>;
		clocks = <&clock_gcc clk_gcc_smmu_cfg_clk>,
			 <&clock_gcc_gfx clk_gcc_oxili_ahb_clk>, /* is this needed? */
			 <&clock_gcc_gfx clk_gcc_gfx_tcu_clk>;
		clock-names = "gcc_smmu_cfg_clk",
			      "gcc_gpu_ahb_clk",
			      "gcc_gfx_tcu_clk";
	};

	/*
	 * apps_iommu range: 0x1e00000 - 0x1e40000
	 *
	 *  === context mapping ===
	 * 0x1e00000 - 0x1e20000: General purpose APPS range
	 * 0x1e20000 - 0x1e21000: ADSP ELF Secure context
	 * 0x1e21000 - 0x1e22000: ADSP secure pixel context
	 * 0x1e22000 - 0x1e23000: ADSP secure bit stream context
	 * 0x1e23000 - 0x1e24000: Venus firmware secure context
	 * 0x1e24000 - 0x1e25000: Venus non pixel secure context
	 * 0x1e25000 - 0x1e26000: Venus secure bit stream context
	 * 0x1e26000 - 0x1e27000: Venus secure pixel context
	 * 0x1e27000 - 0x1e28000: Venus encoder secure context
	 * 0x1e28000 - 0x1e29000: MDP 1 secure context
         *
	 * 0x1e29000 - 0x1e2a000: RPM peripheral non-secure context
	 * 0x1e2a000 - 0x1e2b000: LPASS non-secure context
	 * 0x1e2b000 - 0x1e2c000: PRONTO PIL non-secure context
	 * 0x1e2c000 - 0x1e2d000: Q6 non-secure context
	 * 0x1e2d000 - 0x1e2e000: UNUSED / UNKNOWN non-secure? CONTEXT
	 * 0x1e2e000 - 0x1e2f000: UNUSED / UNKNOWN non-secure? CONTEXT
	 * 0x1e2f000 - 0x1e30000: ADSP I/O non-secure context
	 * 0x1e30000 - 0x1e31000: ADSP OpenDSP non-secure context
	 * 0x1e31000 - 0x1e32000: ADSP Shared non-secure context
	 * 0x1e32000 - 0x1e33000: LPASS stream non-secure context
	 * 0x1e33000 - 0x1e34000: CPP non-secure context
	 * 0x1e34000 - 0x1e35000: JPEG Encoder 0 non-secure context
	 * 0x1e35000 - 0x1e36000: VFE non-secure context
	 * 0x1e36000 - 0x1e37000: Venus non-secure context
	 * 0x1e37000 - 0x1e38000: MDP 0 non-secure context
	 * 0x1e38000 - 0x1e39000: PRONTO buffer non-secure context
	 * 0x1e39000 - 0x1e3a000: MSS NAV(?) non-secure context
	 * 0x1e3a000 - 0x1e3b000: IPA shared non-secure context
	 * 0x1e3b000 - 0x1e3c000: IPA WLAN non-secure context
	 * 0x1e3c000 - 0x1e3d000: IPA uC non-secure context
	 *
	 *  === config irqs ===
	 * global_cfg_S_irq:  <0 41 0>
	 * global_cfg_NS_irq: <0 38 0>
	 *
	 *  === Secure contexts IRQs ===
	 * ADSP ELF: 		254		ADSP sec pixel:		255
	 * ADSP sec bitstream:	53
	 * 
	 * Venus sec firmware:	54		Venus sec non-pixel:	58
	 * Venus sec bitstream:	60		Venus sec pixel:	61
	 * Venus encoder:	76
	 *
	 * MDP 1:		77
	 *
	 *  === Non-secure contexts IRQs ===
	 * RPM Peripheral:	80		LPASS:			94
	 * PRONTO PIL:		101		Q6:			102
	 * ADSP I/O:		105		ADSP OpenDSP:		106
	 * ADSP Shared:		109		LPASS Stream:		110
	 * CPP:			111		JPEG Encoder 0:		112
	 * VFE:			113		Venus non-secure:	114
	 * MDP 0:		115		PRONTO Buffer:		116
	 * 
	 * MSS NAV:		117
	 * 
	 * IPA Shared:		118		IPA WLAN:		119
	 * IPA uC:		120
	 */

	apps_smmu: arm,smmu-apps@1e00000 {
		compatible = "qcom,smmu-v2";
		reg = <0x1e00000 0x40000>;

		/* GPU Secure ID is 18 */
		qcom,tz-device-id = "APPS";

		#iommu-cells = <1>;
		#clock-cells = <1>;
		#global-interrupts = <1>;

		qcom,dynamic;
		qcom,register-save;
		qcom,skip-init;

		qcom,enable-smmu-halt;
		qcom,enable-static-cb;
		qcom,no-smr-check;

		//vdd-supply = <&gdsc_oxili_cx>;

		interrupts = <GIC_SPI 254 IRQ_TYPE_LEVEL_HIGH>, /* SEC ctxs */
			     <GIC_SPI 255 IRQ_TYPE_LEVEL_HIGH>,
			     <GIC_SPI 53  IRQ_TYPE_LEVEL_HIGH>,
			     <GIC_SPI 54  IRQ_TYPE_LEVEL_HIGH>,
			     <GIC_SPI 58  IRQ_TYPE_LEVEL_HIGH>,
			     <GIC_SPI 60  IRQ_TYPE_LEVEL_HIGH>,
			     <GIC_SPI 61  IRQ_TYPE_LEVEL_HIGH>,
			     <GIC_SPI 76  IRQ_TYPE_LEVEL_HIGH>,
			     <GIC_SPI 77  IRQ_TYPE_LEVEL_HIGH>,
			     <GIC_SPI 80  IRQ_TYPE_LEVEL_HIGH>, /* NS ctxs */
			     <GIC_SPI 94  IRQ_TYPE_LEVEL_HIGH>,
			     <GIC_SPI 101 IRQ_TYPE_LEVEL_HIGH>,
			     <GIC_SPI 102 IRQ_TYPE_LEVEL_HIGH>,
			     <GIC_SPI 105 IRQ_TYPE_LEVEL_HIGH>,
			     <GIC_SPI 106 IRQ_TYPE_LEVEL_HIGH>,
			     <GIC_SPI 109 IRQ_TYPE_LEVEL_HIGH>,
			     <GIC_SPI 110 IRQ_TYPE_LEVEL_HIGH>,
			     <GIC_SPI 111 IRQ_TYPE_LEVEL_HIGH>,
			     <GIC_SPI 112 IRQ_TYPE_LEVEL_HIGH>,
			     <GIC_SPI 113 IRQ_TYPE_LEVEL_HIGH>,
			     <GIC_SPI 114 IRQ_TYPE_LEVEL_HIGH>,
			     <GIC_SPI 115 IRQ_TYPE_LEVEL_HIGH>,
			     <GIC_SPI 116 IRQ_TYPE_LEVEL_HIGH>,
			     <GIC_SPI 117 IRQ_TYPE_LEVEL_HIGH>,
			     <GIC_SPI 118 IRQ_TYPE_LEVEL_HIGH>,
			     <GIC_SPI 119 IRQ_TYPE_LEVEL_HIGH>,
			     <GIC_SPI 120 IRQ_TYPE_LEVEL_HIGH>;

		/* Clocks. Do we manage clocks here or in specific device nodes?
		 * Have we got any common IOMMU clock for the apps iommu?
		 * And then, which GDSC should we manage for this IOMMU?
		 */
		clocks = <&clock_gcc clk_gcc_smmu_cfg_clk>,
			 <&clock_gcc clk_gcc_apss_tcu_clk>;
		clock-names = "gcc_smmu_cfg_clk",
			      "gcc_apss_tcu_clk";
	};
};
