&mdss_mdp {
	dsi_nt36672e_fhd_plus_144hz_video_cphy: qcom,mdss_dsi_nt36672e_fhd_plus_cphy_144hz_video {
		qcom,mdss-dsi-panel-name =
			"nt36672e lcd video mode dsi novatek panel with DSC";
		qcom,mdss-dsi-panel-type = "dsi_video_mode";
		qcom,dsi-ctrl-num = <0>;
		qcom,dsi-phy-num = <0>;
		qcom,mdss-dsi-virtual-channel-id = <0>;
		qcom,mdss-dsi-stream = <0>;
		qcom,mdss-dsi-bpp = <24>;
		qcom,mdss-dsi-border-color = <0>;
		qcom,mdss-dsi-traffic-mode = "burst_mode";
		qcom,mdss-dsi-bllp-power-mode;
		qcom,mdss-dsi-bllp-eof-power-mode;
		qcom,mdss-dsi-lane-0-state;
		qcom,mdss-dsi-lane-1-state;
		qcom,mdss-dsi-lane-2-state;
		qcom,mdss-dsi-dma-trigger = "trigger_sw";
		qcom,mdss-dsi-mdp-trigger = "none";
		qcom,mdss-dsi-reset-sequence = <1 10>, <0 10>, <1 10>;
		qcom,mdss-dsi-tx-eot-append;
		qcom,adjust-timer-wakeup-ms = <1>;
		qcom,panel-cphy-mode;
		qcom,mdss-dsi-panel-hdr-enabled;
		qcom,mdss-dsi-panel-hdr-color-primaries = <39000 16000 33750
						 39800 13250 34450 7500 3000>;
		qcom,mdss-dsi-panel-peak-brightness = <6450000>;
		qcom,mdss-dsi-panel-blackness-level = <4961>;

		qcom,mdss-dsi-display-timings {
			timing@0 {
				cell-index = <0>;
				qcom,mdss-dsi-panel-width = <1080>;
				qcom,mdss-dsi-panel-height = <2400>;
				qcom,mdss-dsi-h-front-porch = <76>;
				qcom,mdss-dsi-h-back-porch = <80>;
				qcom,mdss-dsi-h-pulse-width = <20>;
				qcom,mdss-dsi-h-sync-skew = <0>;
				qcom,mdss-dsi-v-back-porch = <10>;
				qcom,mdss-dsi-v-front-porch = <54>;
				qcom,mdss-dsi-v-pulse-width = <10>;
				qcom,mdss-dsi-panel-framerate = <144>;
				qcom,mdss-dsi-on-command = [
					39 01 00 00 00 00 02 FF 10
					39 01 00 00 00 00 02 FB 01
					39 01 00 00 00 00 02 B0 00
					39 01 00 00 00 00 02 C0 03
					39 01 00 00 00 00 11 C1 89 28 00 08 00 AA 02 0E 00 2B 00 07 0D B7 0C B7
					39 01 00 00 00 00 03 C2 1B A0
					39 01 00 00 00 00 02 E9 01

					39 01 00 00 00 00 02 FF 20
					39 01 00 00 00 00 02 FB 01
					39 01 00 00 00 00 02 01 66
					39 01 00 00 00 00 02 06 40
					39 01 00 00 00 00 02 07 38
					39 01 00 00 00 00 02 18 77
					39 01 00 00 00 00 02 69 91
					39 01 00 00 00 00 02 95 D1
					39 01 00 00 00 00 02 96 D1
					39 01 00 00 00 00 02 F2 65
					39 01 00 00 00 00 02 F3 74
					39 01 00 00 00 00 02 F4 65
					39 01 00 00 00 00 02 F5 74
					39 01 00 00 00 00 02 F6 65
					39 01 00 00 00 00 02 F7 74
					39 01 00 00 00 00 02 F8 65
					39 01 00 00 00 00 02 F9 74

					39 01 00 00 00 00 02 89 15
					39 01 00 00 00 00 02 8A 15
					39 01 00 00 00 00 02 8D 15
					39 01 00 00 00 00 02 8E 15
					39 01 00 00 00 00 02 8F 15
					39 01 00 00 00 00 02 91 15

					39 01 00 00 00 00 02 FF 24
					39 01 00 00 00 00 02 FB 01
					39 01 00 00 00 00 02 01 0F
					39 01 00 00 00 00 02 03 0C
					39 01 00 00 00 00 02 05 1D
					39 01 00 00 00 00 02 08 2F
					39 01 00 00 00 00 02 09 2E
					39 01 00 00 00 00 02 0A 2D
					39 01 00 00 00 00 02 0B 2C
					39 01 00 00 00 00 02 11 17
					39 01 00 00 00 00 02 12 13
					39 01 00 00 00 00 02 13 15
					39 01 00 00 00 00 02 15 14
					39 01 00 00 00 00 02 16 16
					39 01 00 00 00 00 02 17 18
					39 01 00 00 00 00 02 1B 01
					39 01 00 00 00 00 02 1D 1D
					39 01 00 00 00 00 02 20 2F
					39 01 00 00 00 00 02 21 2E
					39 01 00 00 00 00 02 22 2D
					39 01 00 00 00 00 02 23 2C
					39 01 00 00 00 00 02 29 17
					39 01 00 00 00 00 02 2A 13
					39 01 00 00 00 00 02 2B 15
					39 01 00 00 00 00 02 2F 14
					39 01 00 00 00 00 02 30 16
					39 01 00 00 00 00 02 31 18
					39 01 00 00 00 00 02 32 04
					39 01 00 00 00 00 02 34 10
					39 01 00 00 00 00 02 35 1F
					39 01 00 00 00 00 02 36 1F
					39 01 00 00 00 00 02 4D 1B
					39 01 00 00 00 00 02 4E 4B
					39 01 00 00 00 00 02 4F 4B
					39 01 00 00 00 00 02 53 4B
					39 01 00 00 00 00 02 71 30
					39 01 00 00 00 00 02 79 11
					39 01 00 00 00 00 02 7A 82
					39 01 00 00 00 00 02 7B 96
					39 01 00 00 00 00 02 7D 04
					39 01 00 00 00 00 02 80 04
					39 01 00 00 00 00 02 81 04
					39 01 00 00 00 00 02 82 13
					39 01 00 00 00 00 02 84 31
					39 01 00 00 00 00 02 85 00
					39 01 00 00 00 00 02 86 00
					39 01 00 00 00 00 02 87 00
					39 01 00 00 00 00 02 90 13
					39 01 00 00 00 00 02 92 31
					39 01 00 00 00 00 02 93 00
					39 01 00 00 00 00 02 94 00
					39 01 00 00 00 00 02 95 00
					39 01 00 00 00 00 02 9C F4
					39 01 00 00 00 00 02 9D 01
					39 01 00 00 00 00 02 A0 16
					39 01 00 00 00 00 02 A2 16
					39 01 00 00 00 00 02 A3 02
					39 01 00 00 00 00 02 A4 04
					39 01 00 00 00 00 02 A5 04
					39 01 00 00 00 00 02 C6 C0
					39 01 00 00 00 00 02 C9 00
					39 01 00 00 00 00 02 D9 80
					39 01 00 00 00 00 02 E9 02

					39 01 00 00 00 00 02 FF 25
					39 01 00 00 00 00 02 FB 01
					39 01 00 00 00 00 02 18 22
					39 01 00 00 00 00 02 19 E4
					39 01 00 00 00 00 02 21 40
					39 01 00 00 00 00 02 66 D8
					39 01 00 00 00 00 02 68 50
					39 01 00 00 00 00 02 69 10
					39 01 00 00 00 00 02 6B 00
					39 01 00 00 00 00 02 6D 0D
					39 01 00 00 00 00 02 6E 48
					39 01 00 00 00 00 02 72 41
					39 01 00 00 00 00 02 73 4A
					39 01 00 00 00 00 02 74 D0
					39 01 00 00 00 00 02 77 62
					39 01 00 00 00 00 02 79 81
					39 01 00 00 00 00 02 7D 40
					39 01 00 00 00 00 02 7E 1D
					39 01 00 00 00 00 02 7F 00
					39 01 00 00 00 00 02 80 04
					39 01 00 00 00 00 02 84 0D
					39 01 00 00 00 00 02 CF 80
					39 01 00 00 00 00 02 D6 80
					39 01 00 00 00 00 02 D7 80
					39 01 00 00 00 00 02 EF 20
					39 01 00 00 00 00 02 F0 84

					39 01 00 00 00 00 02 FF 26
					39 01 00 00 00 00 02 FB 01
					39 01 00 00 00 00 02 15 04
					39 01 00 00 00 00 02 81 16
					39 01 00 00 00 00 02 83 03
					39 01 00 00 00 00 02 84 03
					39 01 00 00 00 00 02 85 01
					39 01 00 00 00 00 02 86 03
					39 01 00 00 00 00 02 87 01
					39 01 00 00 00 00 02 8A 1A
					39 01 00 00 00 00 02 8B 11
					39 01 00 00 00 00 02 8C 24
					39 01 00 00 00 00 02 8E 42
					39 01 00 00 00 00 02 8F 11
					39 01 00 00 00 00 02 90 11
					39 01 00 00 00 00 02 91 11
					39 01 00 00 00 00 02 9A 81
					39 01 00 00 00 00 02 9B 03
					39 01 00 00 00 00 02 9C 00
					39 01 00 00 00 00 02 9D 00
					39 01 00 00 00 00 02 9E 00

					39 01 00 00 00 00 02 FF 27
					39 01 00 00 00 00 02 FB 01
					39 01 00 00 00 00 02 01 60
					39 01 00 00 00 00 02 20 81
					39 01 00 00 00 00 02 21 EA
					39 01 00 00 00 00 02 25 82
					39 01 00 00 00 00 02 26 3F
					39 01 00 00 00 00 02 6E 00
					39 01 00 00 00 00 02 6F 00
					39 01 00 00 00 00 02 70 00
					39 01 00 00 00 00 02 71 00
					39 01 00 00 00 00 02 72 00
					39 01 00 00 00 00 02 75 00
					39 01 00 00 00 00 02 76 00
					39 01 00 00 00 00 02 77 00
					39 01 00 00 00 00 02 7D 09
					39 01 00 00 00 00 02 7E 5F
					39 01 00 00 00 00 02 80 23
					39 01 00 00 00 00 02 82 09
					39 01 00 00 00 00 02 83 5F
					39 01 00 00 00 00 02 88 01
					39 01 00 00 00 00 02 89 10
					39 01 00 00 00 00 02 A5 10
					39 01 00 00 00 00 02 A6 23
					39 01 00 00 00 00 02 A7 01
					39 01 00 00 00 00 02 B6 40
					39 01 00 00 00 00 02 E3 02
					39 01 00 00 00 00 02 E4 E0
					39 01 00 00 00 00 02 E5 01
					39 01 00 00 00 00 02 E6 33
					39 01 00 00 00 00 02 E9 03
					39 01 00 00 00 00 02 EA 5E
					39 01 00 00 00 00 02 EB 01
					39 01 00 00 00 00 02 EC 67

					39 01 00 00 00 00 02 FF 2A
					39 01 00 00 00 00 02 FB 01
					39 01 00 00 00 00 02 00 91
					39 01 00 00 00 00 02 03 20
					39 01 00 00 00 00 02 04 73
					39 01 00 00 00 00 02 07 64
					39 01 00 00 00 00 02 0A 60
					39 01 00 00 00 00 02 0C 06
					39 01 00 00 00 00 02 0D 40
					39 01 00 00 00 00 02 0E 02
					39 01 00 00 00 00 02 0F 01
					39 01 00 00 00 00 02 11 58
					39 01 00 00 00 00 02 15 0E
					39 01 00 00 00 00 02 16 79
					39 01 00 00 00 00 02 19 0D
					39 01 00 00 00 00 02 1A F2
					39 01 00 00 00 00 02 1B 14
					39 01 00 00 00 00 02 1D 36
					39 01 00 00 00 00 02 1E 55
					39 01 00 00 00 00 02 1F 55
					39 01 00 00 00 00 02 20 55
					39 01 00 00 00 00 02 28 0A
					39 01 00 00 00 00 02 29 0B
					39 01 00 00 00 00 02 2A 4B
					39 01 00 00 00 00 02 2B 05
					39 01 00 00 00 00 02 2D 08
					39 01 00 00 00 00 02 2F 01
					39 01 00 00 00 00 02 30 47
					39 01 00 00 00 00 02 31 23
					39 01 00 00 00 00 02 33 25
					39 01 00 00 00 00 02 34 FF
					39 01 00 00 00 00 02 35 2C
					39 01 00 00 00 00 02 36 75
					39 01 00 00 00 00 02 37 FB
					39 01 00 00 00 00 02 38 2E
					39 01 00 00 00 00 02 39 73
					39 01 00 00 00 00 02 3A 47
					39 01 00 00 00 00 02 46 40
					39 01 00 00 00 00 02 47 02
					39 01 00 00 00 00 02 4A F0
					39 01 00 00 00 00 02 4E 0E
					39 01 00 00 00 00 02 4F 8B
					39 01 00 00 00 00 02 52 0E
					39 01 00 00 00 00 02 53 04
					39 01 00 00 00 00 02 54 14
					39 01 00 00 00 00 02 56 36
					39 01 00 00 00 00 02 57 80
					39 01 00 00 00 00 02 58 80
					39 01 00 00 00 00 02 59 80
					39 01 00 00 00 00 02 60 80
					39 01 00 00 00 00 02 61 0A
					39 01 00 00 00 00 02 62 03
					39 01 00 00 00 00 02 63 ED
					39 01 00 00 00 00 02 65 05
					39 01 00 00 00 00 02 66 01
					39 01 00 00 00 00 02 67 04
					39 01 00 00 00 00 02 68 4D
					39 01 00 00 00 00 02 6A 0A
					39 01 00 00 00 00 02 6B C9
					39 01 00 00 00 00 02 6C 1F
					39 01 00 00 00 00 02 6D E3
					39 01 00 00 00 00 02 6E C6
					39 01 00 00 00 00 02 6F 20
					39 01 00 00 00 00 02 70 E2
					39 01 00 00 00 00 02 71 04
					39 01 00 00 00 00 02 7A 04
					39 01 00 00 00 00 02 7B 40
					39 01 00 00 00 00 02 7C 01
					39 01 00 00 00 00 02 7D 01
					39 01 00 00 00 00 02 7F E0
					39 01 00 00 00 00 02 83 0F
					39 01 00 00 00 00 02 84 C5
					39 01 00 00 00 00 02 87 0F
					39 01 00 00 00 00 02 88 42
					39 01 00 00 00 00 02 89 14
					39 01 00 00 00 00 02 8B 36
					39 01 00 00 00 00 02 8C 33
					39 01 00 00 00 00 02 8D 33
					39 01 00 00 00 00 02 8E 33
					39 01 00 00 00 00 02 95 80
					39 01 00 00 00 00 02 96 FD
					39 01 00 00 00 00 02 97 19
					39 01 00 00 00 00 02 98 4A
					39 01 00 00 00 00 02 99 07
					39 01 00 00 00 00 02 9A 0B
					39 01 00 00 00 00 02 9B 03
					39 01 00 00 00 00 02 9C 8B
					39 01 00 00 00 00 02 9D FF
					39 01 00 00 00 00 02 9F 8B
					39 01 00 00 00 00 02 A0 FF
					39 01 00 00 00 00 02 A2 4E
					39 01 00 00 00 00 02 A3 01
					39 01 00 00 00 00 02 A4 F8
					39 01 00 00 00 00 02 A5 52
					39 01 00 00 00 00 02 A6 FD
					39 01 00 00 00 00 02 A7 4B

					39 01 00 00 00 00 02 FF 2C
					39 01 00 00 00 00 02 FB 01
					39 01 00 00 00 00 02 00 02
					39 01 00 00 00 00 02 01 02
					39 01 00 00 00 00 02 02 02
					39 01 00 00 00 00 02 03 16
					39 01 00 00 00 00 02 04 16
					39 01 00 00 00 00 02 05 16
					39 01 00 00 00 00 02 0D 1F
					39 01 00 00 00 00 02 0E 1F
					39 01 00 00 00 00 02 16 1B
					39 01 00 00 00 00 02 17 4B
					39 01 00 00 00 00 02 18 4B
					39 01 00 00 00 00 02 19 4B
					39 01 00 00 00 00 02 2A 03
					39 01 00 00 00 00 02 4D 16
					39 01 00 00 00 00 02 4E 03
					39 01 00 00 00 00 02 53 02
					39 01 00 00 00 00 02 54 02
					39 01 00 00 00 00 02 55 02
					39 01 00 00 00 00 02 56 0B
					39 01 00 00 00 00 02 58 0B
					39 01 00 00 00 00 02 59 0B
					39 01 00 00 00 00 02 61 19
					39 01 00 00 00 00 02 62 19
					39 01 00 00 00 00 02 6A 10
					39 01 00 00 00 00 02 6B 2A
					39 01 00 00 00 00 02 6C 2A
					39 01 00 00 00 00 02 6D 2A
					39 01 00 00 00 00 02 7E 03
					39 01 00 00 00 00 02 9D 0B
					39 01 00 00 00 00 02 9E 04

					39 01 00 00 00 00 02 FF 20
					39 01 00 00 00 00 02 FB 01
					39 01 00 00 00 00 11 B0 00 E2 00 E9 00 F6 01 01 01 0C 01 15 01 20 01 28
					39 01 00 00 00 00 11 B1 01 33 01 51 01 6E 01 9A 01 C0 01 FD 02 34 02 35
					39 01 00 00 00 00 11 B2 02 6B 02 A9 02 D1 03 04 03 25 03 51 03 5F 03 6D
					39 01 00 00 00 00 0F B3 03 7D 03 90 03 A7 03 BB 03 D4 03 D8 00 00
					39 01 00 00 00 00 11 B4 00 AA 00 B3 00 C4 00 D4 00 E2 00 F0 00 FC 01 08
					39 01 00 00 00 00 11 B5 01 12 01 39 01 58 01 8C 01 B5 01 F7 02 30 02 31
					39 01 00 00 00 00 11 B6 02 68 02 A6 02 CE 03 01 03 23 03 4E 03 5C 03 6A
					39 01 00 00 00 00 0F B7 03 7B 03 8E 03 A5 03 BB 03 D4 03 D8 00 00
					39 01 00 00 00 00 11 B8 00 00 00 20 00 47 00 65 00 85 00 99 00 AD 00 C0
					39 01 00 00 00 00 11 B9 00 D2 01 06 01 30 01 70 01 9F 01 E8 02 25 02 26
					39 01 00 00 00 00 11 BA 02 5F 02 9F 02 C7 02 FD 03 20 03 52 03 63 03 67
					39 01 00 00 00 00 0F BB 03 78 03 8B 03 A3 03 B9 03 D4 03 D8 00 00

					39 01 00 00 00 00 02 FF 21
					39 01 00 00 00 00 02 FB 01
					39 01 00 00 00 00 11 B0 00 E2 00 E9 00 F6 01 01 01 0C 01 15 01 20 01 28
					39 01 00 00 00 00 11 B1 01 33 01 51 01 6E 01 9A 01 C0 01 FD 02 34 02 35
					39 01 00 00 00 00 11 B2 02 6B 02 A9 02 D1 03 04 03 25 03 51 03 5F 03 6D
					39 01 00 00 00 00 0F B3 03 7D 03 90 03 A7 03 BB 03 D4 03 D8 00 00
					39 01 00 00 00 00 11 B4 00 AA 00 B3 00 C4 00 D4 00 E2 00 F0 00 FC 01 08
					39 01 00 00 00 00 11 B5 01 12 01 39 01 58 01 8C 01 B5 01 F7 02 30 02 31
					39 01 00 00 00 00 11 B6 02 68 02 A6 02 CE 03 01 03 23 03 4E 03 5C 03 6A
					39 01 00 00 00 00 0F B7 03 7B 03 8E 03 A5 03 BB 03 D4 03 D8 00 00
					39 01 00 00 00 00 11 B8 00 00 00 20 00 47 00 65 00 85 00 99 00 AD 00 C0
					39 01 00 00 00 00 11 B9 00 D2 01 06 01 30 01 70 01 9F 01 E8 02 25 02 26
					39 01 00 00 00 00 11 BA 02 5F 02 9F 02 C7 02 FD 03 20 03 52 03 63 03 67
					39 01 00 00 00 00 0F BB 03 78 03 8B 03 A3 03 B9 03 D4 03 D8 00 00

					39 01 00 00 00 00 02 FF E0
					39 01 00 00 00 00 02 FB 01
					39 01 00 00 00 00 02 35 82

					39 01 00 00 00 00 02 FF F0
					39 01 00 00 00 00 02 FB 01
					39 01 00 00 00 00 02 5A 00
					39 01 00 00 00 00 02 D2 52
					39 01 00 00 00 00 02 9F 12

					39 01 00 00 00 00 02 FF D0
					39 01 00 00 00 00 02 FB 01
					39 01 00 00 00 00 02 53 22
					39 01 00 00 00 00 02 54 02

					39 01 00 00 00 00 02 FF C0
					39 01 00 00 00 00 02 FB 01
					39 01 00 00 00 00 02 9C 11
					39 01 00 00 00 00 02 9D 11

					39 01 00 00 00 00 02 FF 10
					39 01 00 00 00 00 02 FB 01

					39 01 00 00 00 00 02 35 01
					39 01 00 00 00 00 02 51 FF
					39 01 00 00 00 00 02 53 0C
					39 01 00 00 00 00 02 55 00
					05 01 00 00 78 00 01 11
					05 01 00 00 32 00 01 29
				];
				qcom,mdss-dsi-on-command-state = "dsi_lp_mode";
				qcom,mdss-dsi-off-command = [
					05 01 00 00 10 00 01 28
					05 01 00 00 32 00 01 10
				];
				qcom,mdss-dsi-off-command-state = "dsi_lp_mode";
				qcom,compression-mode = "dsc";
				qcom,mdss-dsc-slice-height = <8>;
				qcom,mdss-dsc-slice-width = <540>;
				qcom,mdss-dsc-slice-per-pkt = <1>;
				qcom,mdss-dsc-bit-per-component = <8>;
				qcom,mdss-dsc-bit-per-pixel = <8>;
				qcom,mdss-dsc-block-prediction-enable;
			};
		};
	};
};
