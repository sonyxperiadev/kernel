/* Copyright (c) 2015-2018, The Linux Foundation. All rights reserved.
 *
 * This program is free software; you can redistribute it and/or modify
 * it under the terms of the GNU General Public License version 2 and
 * only version 2 as published by the Free Software Foundation.
 *
 * This program is distributed in the hope that it will be useful,
 * but WITHOUT ANY WARRANTY; without even the implied warranty of
 * MERCHANTABILITY or FITNESS FOR A PARTICULAR PURPOSE.  See the
 * GNU General Public License for more details.
 */

&pmi632_charger {
	qcom,fv-max-uv = <4400000>;
	qcom,chg-term-src = <1>;
	qcom,chg-term-current-ma = <(-173)>;
	somc,product-max-icl-ua = <2800000>;
};

&soc {
	seine_batterydata: qcom,battery-data {
		qcom,batt-id-range-pct = <17>;
		#include "batterydata-pdx201-tdk-4400mv.dtsi"
		#include "batterydata-pdx201-tdk-4370mv.dtsi"
		#include "batterydata-pdx201-tdk-4340mv.dtsi"
		#include "batterydata-pdx201-tdk-4300mv.dtsi"
		#include "batterydata-pdx201-tdk-4250mv.dtsi"
		#include "batterydata-pdx201-tdk-4200mv.dtsi"
	};
};

&pmi632_qg {
	qcom,battery-data = <&seine_batterydata>;
	qcom,multi-profile-load;
	somc,jeita-step-use-real-temp;
	somc,jeita-batt-temp-correction = <0>;
	qcom,qg-iterm-ma = <400>;
};
