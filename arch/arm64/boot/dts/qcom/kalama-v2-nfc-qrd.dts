/dts-v1/;
/plugin/;

#include "kalama-v2-nfc-common.dtsi"
/ {
	model = "Qualcomm Technologies, Inc. Kalama QRD";
	compatible = "qcom,kalama-qrd", "qcom,kalama", "qcom,qrd";
	qcom,msm-id = <519 0x20000>, <536 0x20000>;
	qcom,board-id = <0x1000B 0>;
};
