&soc {
	msm_mmrm: qcom,mmrm {
		compatible = "qcom,msm-mmrm", "qcom,kalama-mmrm";
		status = "okay";

		/* MMRM clock threshold */
		mmrm-peak-threshold = <10000>;

		/* MM Rail info */
		mm-rail-corners = "lowsvs", "svs", "svsl1", "nom", "turbo";
		mm-rail-fact-volt = <37484 41157 44827 47710 52429>;

		/* Scaling factors */
		scaling-fact-dyn = <39951 48654 58347 66676 81756>;
		scaling-fact-leak = <39951 671796 784171 884467 1082937>;

		/* Client info */
		mmrm-client-info =
			<0x1 CAM_CC_IFE_0_CLK_SRC 31201472 238551 1>,
			<0x1 CAM_CC_IFE_1_CLK_SRC 31201427 238551 1>,
			<0x1 CAM_CC_IFE_2_CLK_SRC 31201427 238551 1>,
			<0x1 CAM_CC_CSID_CLK_SRC 1858221 0 3>,
			<0x1 CAM_CC_SFE_0_CLK_SRC 15273820 257556 1>,
			<0x1 CAM_CC_SFE_1_CLK_SRC 15273820 257556 1>,
			<0x1 CAM_CC_IPE_NPS_CLK_SRC 88824873 986972 1>,
			<0x1 CAM_CC_BPS_CLK_SRC 30096753 84541 1>,
			<0x1 CAM_CC_IFE_LITE_CLK_SRC 1460651 20054 2>,
			<0x1 CAM_CC_JPEG_CLK_SRC 661914 18350 4>,
			<0x1 CAM_CC_CAMNOC_AXI_CLK_SRC 2930770 388628 1>,
			<0x1 CAM_CC_IFE_LITE_CSID_CLK_SRC 225444 0 2>,
			<0x1 CAM_CC_ICP_CLK_SRC 270533 0 1>,

			<0x1 CAM_CC_CPHY_RX_CLK_SRC 19661 0 10>,
			<0x1 CAM_CC_CSI0PHYTIMER_CLK_SRC 5636 0 1>,
			<0x1 CAM_CC_CSI1PHYTIMER_CLK_SRC 5636 0 1>,
			<0x1 CAM_CC_CSI2PHYTIMER_CLK_SRC 5636 0 1>,
			<0x1 CAM_CC_CSI3PHYTIMER_CLK_SRC 5636 0 1>,
			<0x1 CAM_CC_CSI4PHYTIMER_CLK_SRC 5636 0 1>,
			<0x1 CAM_CC_CSI5PHYTIMER_CLK_SRC 5636 0 1>,
			<0x1 CAM_CC_CSI6PHYTIMER_CLK_SRC 5636 0 1>,
			<0x1 CAM_CC_CSI7PHYTIMER_CLK_SRC 5636 0 1>,
			<0x1 CAM_CC_CCI_0_CLK_SRC 0 0 1>,
			<0x1 CAM_CC_CCI_1_CLK_SRC 0 0 1>,
			<0x1 CAM_CC_CCI_2_CLK_SRC 0 0 1>,
			<0x1 CAM_CC_SLOW_AHB_CLK_SRC 60306 0 1>,
			<0x1 CAM_CC_FAST_AHB_CLK_SRC 30435 0 1>,
			<0x1 CAM_CC_CRE_CLK_SRC 327680 0 1>,

			<0x2 VIDEO_CC_MVS1_CLK_SRC 66109440 476447 1>,
			<0x3 DISP_CC_MDSS_MDP_CLK_SRC 22714778 196608 1>,
			<0x3 DISP_CC_MDSS_DPTX0_LINK_CLK_SRC 897843 3277 1>,
			<0x4 VIDEO_CC_MVS0_CLK_SRC 13745521 486277 1>;
	};
};
