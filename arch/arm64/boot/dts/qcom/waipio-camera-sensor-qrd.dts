/dts-v1/;
/plugin/;

#include <dt-bindings/clock/qcom,gcc-waipio.h>
#include <dt-bindings/clock/qcom,camcc-waipio.h>
#include <dt-bindings/interconnect/qcom,waipio.h>
#include <dt-bindings/interrupt-controller/arm-gic.h>
#include <dt-bindings/regulator/qcom,rpmh-regulator-levels.h>

#include "waipio-camera-sensor-mtp.dtsi"
/ {
	model = "Qualcomm Technologies, Inc. Waipio QRD";
	compatible = "qcom,waipio", "qcom,waipiop";
	qcom,msm-id = <457 0x10000>, <482 0x10000>, <457 0x20000>, <482 0x20000>;
	qcom,board-id = <0x1000b 0>, <0x2000b 0>, <0x1001f 0>;
};
