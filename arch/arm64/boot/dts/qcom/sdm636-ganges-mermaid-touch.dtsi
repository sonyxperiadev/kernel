/* arch/arm64/boot/dts/somc/somc-ganges-touch.dtsi
 *
 * This program is free software; you can redistribute it and/or modify
 * it under the terms of the GNU General Public License version 2 and
 * only version 2 as published by the Free Software Foundation.
 *
 * This program is distributed in the hope that it will be useful,
 * but WITHOUT ANY WARRANTY; without even the implied warranty of
 * MERCHANTABILITY or FITNESS FOR A PARTICULAR PURPOSE.  See the
 * GNU General Public License for more details.
 */

&i2c_1 {
	status = "okay";

	novatek@62 {
		compatible = "novatek,NVT-ts";
		reg = <0x62>;
		status = "ok";

		/* vdd-supply = <&pm8994_lvs2>;    //VDDIO */
		/* avdd-supply = <&pm8994_l22>;    //VDD */

		/* novatek,reset-gpio = <&tlmm 53 0x00>; */
		novatek,irq-gpio = <&tlmm 45 0x2002>;

		/* MP */
		novatek,mp-support-dt;

		novatek-mp-criteria-default@0 {
			#address-cells = <1>;
			#size-cells = <0>;
			compatible = "novatek-mp-criteria-default";

			/* MP Config */
			IC_X_CFG_SIZE = <16>;
			IC_Y_CFG_SIZE = <36>;
			IC_KEY_CFG_SIZE = <4>;
			X_Channel = <16>;
			Y_Channel = <36>;
			AIN_X = <0 1 2 3 4 5 6 7 8 9 10 11 12 13 14 15>;
			AIN_Y = <0 1 2 3 4 5 6 7 8 9 10 11 12 13 14 15 16 17 18
				 19 20 21 22 23 24 25 26 27 28 29 30 31 32 33 34 35>;
			AIN_KEY = <0 1 2 0xFF>;

			/* MP Criteria */
			PS_Config_Lmt_Short_Rawdata_P = <
				14000 14000 14000 14000 14000 14000 14000 14000 14000 14000 14000 14000 14000 14000 14000 14000
				14000 14000 14000 14000 14000 14000 14000 14000 14000 14000 14000 14000 14000 14000 14000 14000
				14000 14000 14000 14000 14000 14000 14000 14000 14000 14000 14000 14000 14000 14000 14000 14000
				14000 14000 14000 14000 14000 14000 14000 14000 14000 14000 14000 14000 14000 14000 14000 14000
				14000 14000 14000 14000 14000 14000 14000 14000 14000 14000 14000 14000 14000 14000 14000 14000
				14000 14000 14000 14000 14000 14000 14000 14000 14000 14000 14000 14000 14000 14000 14000 14000
				14000 14000 14000 14000 14000 14000 14000 14000 14000 14000 14000 14000 14000 14000 14000 14000
				14000 14000 14000 14000 14000 14000 14000 14000 14000 14000 14000 14000 14000 14000 14000 14000
				14000 14000 14000 14000 14000 14000 14000 14000 14000 14000 14000 14000 14000 14000 14000 14000
				14000 14000 14000 14000 14000 14000 14000 14000 14000 14000 14000 14000 14000 14000 14000 14000
				14000 14000 14000 14000 14000 14000 14000 14000 14000 14000 14000 14000 14000 14000 14000 14000
				14000 14000 14000 14000 14000 14000 14000 14000 14000 14000 14000 14000 14000 14000 14000 14000
				14000 14000 14000 14000 14000 14000 14000 14000 14000 14000 14000 14000 14000 14000 14000 14000
				14000 14000 14000 14000 14000 14000 14000 14000 14000 14000 14000 14000 14000 14000 14000 14000
				14000 14000 14000 14000 14000 14000 14000 14000 14000 14000 14000 14000 14000 14000 14000 14000
				14000 14000 14000 14000 14000 14000 14000 14000 14000 14000 14000 14000 14000 14000 14000 14000
				14000 14000 14000 14000 14000 14000 14000 14000 14000 14000 14000 14000 14000 14000 14000 14000
				14000 14000 14000 14000 14000 14000 14000 14000 14000 14000 14000 14000 14000 14000 14000 14000
				14000 14000 14000 14000 14000 14000 14000 14000 14000 14000 14000 14000 14000 14000 14000 14000
				14000 14000 14000 14000 14000 14000 14000 14000 14000 14000 14000 14000 14000 14000 14000 14000
				14000 14000 14000 14000 14000 14000 14000 14000 14000 14000 14000 14000 14000 14000 14000 14000
				14000 14000 14000 14000 14000 14000 14000 14000 14000 14000 14000 14000 14000 14000 14000 14000
				14000 14000 14000 14000 14000 14000 14000 14000 14000 14000 14000 14000 14000 14000 14000 14000
				14000 14000 14000 14000 14000 14000 14000 14000 14000 14000 14000 14000 14000 14000 14000 14000
				14000 14000 14000 14000 14000 14000 14000 14000 14000 14000 14000 14000 14000 14000 14000 14000
				14000 14000 14000 14000 14000 14000 14000 14000 14000 14000 14000 14000 14000 14000 14000 14000
				14000 14000 14000 14000 14000 14000 14000 14000 14000 14000 14000 14000 14000 14000 14000 14000
				14000 14000 14000 14000 14000 14000 14000 14000 14000 14000 14000 14000 14000 14000 14000 14000
				14000 14000 14000 14000 14000 14000 14000 14000 14000 14000 14000 14000 14000 14000 14000 14000
				14000 14000 14000 14000 14000 14000 14000 14000 14000 14000 14000 14000 14000 14000 14000 14000
				14000 14000 14000 14000 14000 14000 14000 14000 14000 14000 14000 14000 14000 14000 14000 14000
				14000 14000 14000 14000 14000 14000 14000 14000 14000 14000 14000 14000 14000 14000 14000 14000
				14000 14000 14000 14000 14000 14000 14000 14000 14000 14000 14000 14000 14000 14000 14000 14000
				14000 14000 14000 14000 14000 14000 14000 14000 14000 14000 14000 14000 14000 14000 14000 14000
				14000 14000 14000 14000 14000 14000 14000 14000 14000 14000 14000 14000 14000 14000 14000 14000
				14000 14000 14000 14000 14000 14000 14000 14000 14000 14000 14000 14000 14000 14000 14000 14000
				>;

			PS_Config_Lmt_Short_Rawdata_N = <
				11000 11000 11000 11000 11000 11000 11000 11000 11000 11000 11000 11000 11000 11000 11000 11000
				11000 11000 11000 11000 11000 11000 11000 11000 11000 11000 11000 11000 11000 11000 11000 11000
				11000 11000 11000 11000 11000 11000 11000 11000 11000 11000 11000 11000 11000 11000 11000 11000
				11000 11000 11000 11000 11000 11000 11000 11000 11000 11000 11000 11000 11000 11000 11000 11000
				11000 11000 11000 11000 11000 11000 11000 11000 11000 11000 11000 11000 11000 11000 11000 11000
				11000 11000 11000 11000 11000 11000 11000 11000 11000 11000 11000 11000 11000 11000 11000 11000
				11000 11000 11000 11000 11000 11000 11000 11000 11000 11000 11000 11000 11000 11000 11000 11000
				11000 11000 11000 11000 11000 11000 11000 11000 11000 11000 11000 11000 11000 11000 11000 11000
				11000 11000 11000 11000 11000 11000 11000 11000 11000 11000 11000 11000 11000 11000 11000 11000
				11000 11000 11000 11000 11000 11000 11000 11000 11000 11000 11000 11000 11000 11000 11000 11000
				11000 11000 11000 11000 11000 11000 11000 11000 11000 11000 11000 11000 11000 11000 11000 11000
				11000 11000 11000 11000 11000 11000 11000 11000 11000 11000 11000 11000 11000 11000 11000 11000
				11000 11000 11000 11000 11000 11000 11000 11000 11000 11000 11000 11000 11000 11000 11000 11000
				11000 11000 11000 11000 11000 11000 11000 11000 11000 11000 11000 11000 11000 11000 11000 11000
				11000 11000 11000 11000 11000 11000 11000 11000 11000 11000 11000 11000 11000 11000 11000 11000
				11000 11000 11000 11000 11000 11000 11000 11000 11000 11000 11000 11000 11000 11000 11000 11000
				11000 11000 11000 11000 11000 11000 11000 11000 11000 11000 11000 11000 11000 11000 11000 11000
				11000 11000 11000 11000 11000 11000 11000 11000 11000 11000 11000 11000 11000 11000 11000 11000
				11000 11000 11000 11000 11000 11000 11000 11000 11000 11000 11000 11000 11000 11000 11000 11000
				11000 11000 11000 11000 11000 11000 11000 11000 11000 11000 11000 11000 11000 11000 11000 11000
				11000 11000 11000 11000 11000 11000 11000 11000 11000 11000 11000 11000 11000 11000 11000 11000
				11000 11000 11000 11000 11000 11000 11000 11000 11000 11000 11000 11000 11000 11000 11000 11000
				11000 11000 11000 11000 11000 11000 11000 11000 11000 11000 11000 11000 11000 11000 11000 11000
				11000 11000 11000 11000 11000 11000 11000 11000 11000 11000 11000 11000 11000 11000 11000 11000
				11000 11000 11000 11000 11000 11000 11000 11000 11000 11000 11000 11000 11000 11000 11000 11000
				11000 11000 11000 11000 11000 11000 11000 11000 11000 11000 11000 11000 11000 11000 11000 11000
				11000 11000 11000 11000 11000 11000 11000 11000 11000 11000 11000 11000 11000 11000 11000 11000
				11000 11000 11000 11000 11000 11000 11000 11000 11000 11000 11000 11000 11000 11000 11000 11000
				11000 11000 11000 11000 11000 11000 11000 11000 11000 11000 11000 11000 11000 11000 11000 11000
				11000 11000 11000 11000 11000 11000 11000 11000 11000 11000 11000 11000 11000 11000 11000 11000
				11000 11000 11000 11000 11000 11000 11000 11000 11000 11000 11000 11000 11000 11000 11000 11000
				11000 11000 11000 11000 11000 11000 11000 11000 11000 11000 11000 11000 11000 11000 11000 11000
				11000 11000 11000 11000 11000 11000 11000 11000 11000 11000 11000 11000 11000 11000 11000 11000
				11000 11000 11000 11000 11000 11000 11000 11000 11000 11000 11000 11000 11000 11000 11000 11000
				11000 11000 11000 11000 11000 11000 11000 11000 11000 11000 11000 11000 11000 11000 11000 11000
				11000 11000 11000 11000 11000 11000 11000 11000 11000 11000 11000 11000 11000 11000 11000 11000
				>;

			PS_Config_Lmt_Open_Rawdata_P = <
				3315 3271 3308 3271 3299 3249 3281 3242 3250 3211 3246 3208 3260 3222 3258 3199
				3098 3044 3080 3041 3071 3022 3053 3009 3029 2991 3026 2991 3040 3003 3041 3005
				3118 3061 3098 3057 3090 3040 3071 3024 3041 3001 3038 3002 3052 3014 3052 3017
				3119 3063 3099 3060 3091 3042 3075 3028 3049 3006 3046 3009 3059 3022 3060 3024
				3138 3083 3119 3080 3111 3061 3092 3046 3060 3018 3059 3021 3071 3034 3069 3036
				3389 3080 3362 3080 3354 3060 3339 3044 3318 3028 3314 3033 3322 3045 3326 3045
				3411 3349 3387 3346 3379 3329 3364 3318 3323 3279 3319 3279 3329 3291 3330 3298
				3407 3345 3384 3343 3375 3327 3361 3314 3338 3294 3333 3294 3343 3304 3343 3311
				3420 3356 3395 3354 3385 3338 3372 3327 3342 3294 3338 3296 3345 3308 3348 3315
				3424 3365 3404 3364 3396 3348 3381 3335 3350 3302 3342 3304 3354 3318 3357 3321
				3429 3369 3411 3369 3403 3354 3385 3342 3357 3312 3352 3315 3366 3330 3366 3329
				3427 3366 3410 3368 3400 3352 3383 3341 3358 3311 3353 3316 3369 3331 3368 3329
				3441 3381 3423 3377 3410 3361 3391 3350 3364 3318 3360 3325 3377 3343 3380 3341
				3449 3392 3435 3388 3422 3372 3399 3358 3376 3331 3375 3339 3392 3357 3393 3354
				3456 3395 3443 3396 3429 3379 3406 3368 3379 3337 3380 3348 3399 3365 3400 3356
				3464 3406 3453 3407 3438 3387 3412 3377 3379 3334 3381 3349 3399 3364 3397 3354
				3469 3412 3457 3411 3443 3391 3414 3385 3389 3342 3391 3358 3410 3375 3407 3364
				3470 3420 3465 3419 3449 3396 3418 3387 3387 3342 3392 3361 3411 3377 3411 3366
				3472 3427 3472 3426 3454 3400 3422 3391 3392 3346 3395 3365 3415 3381 3412 3366
				3477 3431 3476 3429 3456 3402 3424 3389 3403 3354 3404 3373 3422 3388 3420 3381
				3474 3431 3472 3424 3450 3397 3422 3392 3388 3353 3400 3369 3418 3385 3415 3379
				3477 3433 3470 3424 3449 3396 3422 3389 3392 3354 3407 3375 3423 3391 3420 3384
				3472 3430 3462 3418 3441 3389 3412 3381 3377 3343 3397 3366 3414 3380 3418 3379
				3473 3430 3461 3415 3438 3385 3411 3379 3369 3341 3395 3364 3411 3375 3412 3373
				3472 3427 3458 3412 3431 3379 3407 3376 3361 3334 3387 3356 3404 3368 3404 3368
				3469 3424 3456 3410 3426 3373 3402 3368 3368 3342 3393 3361 3411 3375 3412 3377
				3469 3422 3447 3403 3422 3368 3395 3364 3368 3343 3395 3364 3410 3372 3412 3380
				3472 3426 3453 3406 3423 3381 3399 3360 3361 3342 3392 3362 3410 3369 3411 3381
				3469 3416 3445 3396 3412 3370 3393 3352 3360 3339 3389 3360 3406 3365 3406 3379
				3481 3424 3453 3403 3419 3380 3402 3357 3362 3341 3388 3360 3407 3362 3404 3377
				3469 3415 3443 3393 3404 3366 3391 3343 3356 3334 3381 3354 3400 3358 3396 3370
				3468 3407 3438 3384 3395 3358 3385 3335 3348 3327 3372 3343 3391 3346 3385 3361
				3470 3408 3435 3380 3393 3353 3383 3333 3350 3330 3373 3346 3389 3345 3387 3362
				3472 3403 3433 3376 3391 3348 3381 3327 3341 3318 3360 3334 3375 3330 3375 3353
				3460 3391 3416 3358 3375 3331 3366 3311 3323 3300 3338 3314 3353 3308 3353 3335
				3450 3404 3429 3369 3387 3343 3379 3323 3343 3321 3358 3333 3370 3329 3375 3327
				>;

			PS_Config_Lmt_Open_Rawdata_N = <
				1596 1574 1593 1574 1588 1564 1580 1561 1565 1546 1563 1545 1569 1551 1569 1540
				1491 1465 1483 1464 1478 1455 1470 1448 1458 1440 1457 1440 1463 1446 1464 1446
				1501 1474 1491 1472 1487 1463 1478 1456 1464 1444 1463 1445 1469 1451 1469 1452
				1502 1474 1492 1473 1488 1465 1480 1457 1468 1447 1467 1448 1472 1455 1473 1456
				1511 1484 1502 1483 1498 1474 1489 1467 1473 1453 1472 1454 1478 1461 1478 1461
				1632 1483 1619 1483 1615 1473 1608 1465 1597 1457 1595 1460 1599 1466 1601 1466
				1642 1612 1630 1611 1626 1602 1619 1597 1600 1578 1598 1578 1602 1584 1603 1587
				1640 1610 1629 1610 1625 1602 1618 1595 1607 1586 1604 1586 1610 1591 1610 1594
				1647 1615 1634 1615 1630 1607 1623 1602 1609 1586 1607 1587 1610 1593 1612 1596
				1649 1620 1639 1619 1635 1612 1628 1606 1613 1589 1609 1591 1615 1597 1616 1599
				1651 1622 1642 1622 1638 1615 1630 1609 1616 1595 1613 1596 1621 1603 1621 1602
				1650 1621 1641 1621 1637 1613 1628 1608 1617 1594 1614 1597 1622 1604 1621 1602
				1656 1628 1648 1626 1641 1618 1632 1613 1619 1597 1617 1600 1626 1610 1627 1608
				1660 1633 1654 1631 1647 1623 1636 1617 1625 1604 1625 1608 1633 1616 1634 1615
				1664 1634 1658 1635 1651 1626 1639 1621 1626 1606 1627 1612 1636 1620 1637 1615
				1667 1639 1662 1640 1655 1630 1643 1626 1626 1605 1628 1612 1636 1619 1636 1615
				1670 1643 1664 1642 1658 1632 1643 1630 1632 1609 1632 1617 1641 1625 1640 1619
				1671 1647 1668 1646 1660 1635 1645 1630 1630 1609 1633 1618 1642 1626 1642 1621
				1671 1650 1671 1649 1663 1637 1647 1632 1633 1611 1634 1620 1644 1628 1643 1621
				1674 1652 1673 1651 1664 1638 1649 1632 1638 1615 1639 1624 1647 1631 1647 1628
				1673 1652 1671 1649 1661 1636 1647 1633 1631 1614 1637 1622 1645 1630 1644 1626
				1674 1652 1671 1649 1660 1635 1647 1632 1633 1615 1640 1625 1648 1632 1647 1629
				1671 1651 1667 1645 1656 1632 1643 1628 1626 1610 1636 1621 1643 1627 1645 1626
				1672 1651 1666 1644 1655 1630 1642 1626 1622 1608 1634 1619 1642 1625 1643 1624
				1671 1650 1665 1643 1652 1626 1640 1625 1618 1605 1630 1615 1639 1621 1639 1621
				1670 1649 1664 1641 1649 1624 1638 1621 1621 1609 1634 1618 1642 1625 1643 1626
				1670 1647 1660 1638 1647 1621 1634 1619 1621 1610 1634 1619 1641 1623 1643 1627
				1671 1649 1662 1639 1648 1628 1636 1617 1618 1609 1633 1619 1641 1622 1642 1628
				1670 1645 1658 1635 1643 1623 1634 1613 1617 1608 1632 1617 1639 1620 1639 1626
				1676 1649 1662 1638 1646 1627 1638 1616 1619 1608 1631 1617 1640 1619 1639 1626
				1670 1644 1658 1634 1639 1621 1632 1610 1615 1605 1628 1615 1637 1617 1635 1623
				1669 1640 1655 1629 1634 1617 1630 1606 1612 1602 1623 1610 1632 1611 1630 1618
				1671 1641 1654 1627 1634 1614 1628 1604 1613 1603 1624 1611 1632 1610 1630 1619
				1671 1638 1652 1625 1632 1612 1628 1602 1608 1597 1617 1605 1625 1603 1625 1614
				1665 1632 1645 1617 1625 1604 1621 1594 1600 1589 1607 1595 1614 1593 1614 1606
				1661 1639 1651 1622 1630 1610 1626 1600 1610 1599 1617 1604 1623 1602 1625 1602
				>;

			PS_Config_Lmt_FW_Rawdata_P = <
				1700 1700 1700 1700 1700 1700 1700 1700 1700 1700 1700 1700 1700 1700 1700 1700
				1700 1700 1700 1700 1700 1700 1700 1700 1700 1700 1700 1700 1700 1700 1700 1700
				1700 1700 1700 1700 1700 1700 1700 1700 1700 1700 1700 1700 1700 1700 1700 1700
				1700 1700 1700 1700 1700 1700 1700 1700 1700 1700 1700 1700 1700 1700 1700 1700
				1700 1700 1700 1700 1700 1700 1700 1700 1700 1700 1700 1700 1700 1700 1700 1700
				1700 1700 1700 1700 1700 1700 1700 1700 1700 1700 1700 1700 1700 1700 1700 1700
				1700 1700 1700 1700 1700 1700 1700 1700 1700 1700 1700 1700 1700 1700 1700 1700
				1700 1700 1700 1700 1700 1700 1700 1700 1700 1700 1700 1700 1700 1700 1700 1700
				1700 1700 1700 1700 1700 1700 1700 1700 1700 1700 1700 1700 1700 1700 1700 1700
				1700 1700 1700 1700 1700 1700 1700 1700 1700 1700 1700 1700 1700 1700 1700 1700
				1700 1700 1700 1700 1700 1700 1700 1700 1700 1700 1700 1700 1700 1700 1700 1700
				1700 1700 1700 1700 1700 1700 1700 1700 1700 1700 1700 1700 1700 1700 1700 1700
				1700 1700 1700 1700 1700 1700 1700 1700 1700 1700 1700 1700 1700 1700 1700 1700
				1700 1700 1700 1700 1700 1700 1700 1700 1700 1700 1700 1700 1700 1700 1700 1700
				1700 1700 1700 1700 1700 1700 1700 1700 1700 1700 1700 1700 1700 1700 1700 1700
				1700 1700 1700 1700 1700 1700 1700 1700 1700 1700 1700 1700 1700 1700 1700 1700
				1700 1700 1700 1700 1700 1700 1700 1700 1700 1700 1700 1700 1700 1700 1700 1700
				1700 1700 1700 1700 1700 1700 1700 1700 1700 1700 1700 1700 1700 1700 1700 1700
				1700 1700 1700 1700 1700 1700 1700 1700 1700 1700 1700 1700 1700 1700 1700 1700
				1700 1700 1700 1700 1700 1700 1700 1700 1700 1700 1700 1700 1700 1700 1700 1700
				1700 1700 1700 1700 1700 1700 1700 1700 1700 1700 1700 1700 1700 1700 1700 1700
				1700 1700 1700 1700 1700 1700 1700 1700 1700 1700 1700 1700 1700 1700 1700 1700
				1700 1700 1700 1700 1700 1700 1700 1700 1700 1700 1700 1700 1700 1700 1700 1700
				1700 1700 1700 1700 1700 1700 1700 1700 1700 1700 1700 1700 1700 1700 1700 1700
				1700 1700 1700 1700 1700 1700 1700 1700 1700 1700 1700 1700 1700 1700 1700 1700
				1700 1700 1700 1700 1700 1700 1700 1700 1700 1700 1700 1700 1700 1700 1700 1700
				1700 1700 1700 1700 1700 1700 1700 1700 1700 1700 1700 1700 1700 1700 1700 1700
				1700 1700 1700 1700 1700 1700 1700 1700 1700 1700 1700 1700 1700 1700 1700 1700
				1700 1700 1700 1700 1700 1700 1700 1700 1700 1700 1700 1700 1700 1700 1700 1700
				1700 1700 1700 1700 1700 1700 1700 1700 1700 1700 1700 1700 1700 1700 1700 1700
				1700 1700 1700 1700 1700 1700 1700 1700 1700 1700 1700 1700 1700 1700 1700 1700
				1700 1700 1700 1700 1700 1700 1700 1700 1700 1700 1700 1700 1700 1700 1700 1700
				1700 1700 1700 1700 1700 1700 1700 1700 1700 1700 1700 1700 1700 1700 1700 1700
				1700 1700 1700 1700 1700 1700 1700 1700 1700 1700 1700 1700 1700 1700 1700 1700
				1700 1700 1700 1700 1700 1700 1700 1700 1700 1700 1700 1700 1700 1700 1700 1700
				1700 1700 1700 1700 1700 1700 1700 1700 1700 1700 1700 1700 1700 1700 1700 1700
				>;

			PS_Config_Lmt_FW_Rawdata_N = <
				700 700 700 700 700 700 700 700 700 700 700 700 700 700 700 700
				700 700 700 700 700 700 700 700 700 700 700 700 700 700 700 700
				700 700 700 700 700 700 700 700 700 700 700 700 700 700 700 700
				700 700 700 700 700 700 700 700 700 700 700 700 700 700 700 700
				700 700 700 700 700 700 700 700 700 700 700 700 700 700 700 700
				700 700 700 700 700 700 700 700 700 700 700 700 700 700 700 700
				700 700 700 700 700 700 700 700 700 700 700 700 700 700 700 700
				700 700 700 700 700 700 700 700 700 700 700 700 700 700 700 700
				700 700 700 700 700 700 700 700 700 700 700 700 700 700 700 700
				700 700 700 700 700 700 700 700 700 700 700 700 700 700 700 700
				700 700 700 700 700 700 700 700 700 700 700 700 700 700 700 700
				700 700 700 700 700 700 700 700 700 700 700 700 700 700 700 700
				700 700 700 700 700 700 700 700 700 700 700 700 700 700 700 700
				700 700 700 700 700 700 700 700 700 700 700 700 700 700 700 700
				700 700 700 700 700 700 700 700 700 700 700 700 700 700 700 700
				700 700 700 700 700 700 700 700 700 700 700 700 700 700 700 700
				700 700 700 700 700 700 700 700 700 700 700 700 700 700 700 700
				700 700 700 700 700 700 700 700 700 700 700 700 700 700 700 700
				700 700 700 700 700 700 700 700 700 700 700 700 700 700 700 700
				700 700 700 700 700 700 700 700 700 700 700 700 700 700 700 700
				700 700 700 700 700 700 700 700 700 700 700 700 700 700 700 700
				700 700 700 700 700 700 700 700 700 700 700 700 700 700 700 700
				700 700 700 700 700 700 700 700 700 700 700 700 700 700 700 700
				700 700 700 700 700 700 700 700 700 700 700 700 700 700 700 700
				700 700 700 700 700 700 700 700 700 700 700 700 700 700 700 700
				700 700 700 700 700 700 700 700 700 700 700 700 700 700 700 700
				700 700 700 700 700 700 700 700 700 700 700 700 700 700 700 700
				700 700 700 700 700 700 700 700 700 700 700 700 700 700 700 700
				700 700 700 700 700 700 700 700 700 700 700 700 700 700 700 700
				700 700 700 700 700 700 700 700 700 700 700 700 700 700 700 700
				700 700 700 700 700 700 700 700 700 700 700 700 700 700 700 700
				700 700 700 700 700 700 700 700 700 700 700 700 700 700 700 700
				700 700 700 700 700 700 700 700 700 700 700 700 700 700 700 700
				700 700 700 700 700 700 700 700 700 700 700 700 700 700 700 700
				700 700 700 700 700 700 700 700 700 700 700 700 700 700 700 700
				700 700 700 700 700 700 700 700 700 700 700 700 700 700 700 700
				>;

			PS_Config_Lmt_FW_CC_P = <
				130 121 119 117 117 116 116 117 120 120 116 115 116 116 117 120
				126 119 117 116 115 115 115 115 117 119 115 115 116 116 116 120
				129 121 120 119 119 117 117 117 121 120 117 117 119 119 119 122
				126 120 119 117 117 116 116 116 119 119 116 116 116 117 119 120
				126 120 119 117 117 116 116 116 119 117 117 116 117 117 117 121
				126 119 119 117 116 115 116 115 117 116 116 115 116 116 117 120
				129 121 120 120 119 117 119 117 121 119 119 117 119 119 120 124
				126 119 119 119 117 116 117 116 119 117 116 116 117 117 117 121
				126 120 119 119 117 116 117 116 121 117 117 116 117 119 119 122
				125 119 117 117 116 115 117 116 119 116 116 115 116 116 117 120
				128 120 120 119 119 117 119 119 120 119 117 117 119 119 119 122
				124 117 117 117 116 115 116 116 117 116 116 115 116 116 117 120
				124 117 117 116 116 115 116 117 117 116 116 115 116 116 117 121
				122 117 117 116 116 115 116 117 115 115 115 113 115 115 116 120
				125 119 119 117 117 117 117 119 117 117 117 116 117 119 119 122
				122 117 117 117 116 116 116 119 115 115 115 115 116 116 117 121
				122 117 117 117 116 116 117 119 117 116 116 116 117 117 117 121
				120 116 116 116 115 115 115 116 115 115 113 113 115 115 116 120
				124 119 119 117 117 117 117 119 117 116 116 116 117 117 119 122
				121 117 117 116 116 116 116 117 117 115 115 115 116 116 117 121
				122 117 117 117 116 116 117 117 117 115 115 115 116 116 116 121
				120 116 116 116 115 115 116 116 116 115 113 113 115 115 116 120
				122 119 117 117 117 117 117 119 117 117 116 117 117 117 119 124
				120 117 116 116 115 115 116 116 115 115 113 115 115 116 116 121
				120 117 116 116 115 115 116 117 113 113 113 113 115 116 116 121
				120 116 116 115 115 115 116 117 113 113 112 113 115 115 116 121
				122 119 119 117 116 117 119 120 115 116 115 116 117 117 119 124
				120 116 116 116 115 116 117 119 113 113 113 115 115 116 117 122
				120 117 116 116 115 116 117 119 113 115 113 115 116 116 117 124
				119 115 115 115 113 115 116 116 112 112 112 113 115 115 116 122
				121 117 117 116 116 116 117 119 115 115 115 116 116 117 119 125
				120 116 116 115 115 115 116 117 113 113 113 113 115 116 117 122
				120 117 116 116 115 115 117 119 113 113 113 115 115 116 117 124
				119 115 115 115 113 113 117 117 112 112 112 113 115 115 117 124
				121 117 117 116 115 116 120 120 113 113 113 115 116 116 119 125
				119 116 116 116 115 115 119 119 112 111 112 112 113 115 117 124
				>;

			PS_Config_Lmt_FW_CC_N = <
				73 68 66 66 66 65 65 66 67 67 65 64 65 65 66 67
				71 66 66 65 64 64 64 64 66 66 64 64 65 65 65 67
				72 68 67 66 66 66 66 66 68 67 66 66 66 66 66 69
				71 67 66 66 66 65 65 65 66 66 65 65 65 66 66 67
				71 67 66 66 66 65 65 65 66 66 66 65 66 66 66 68
				71 66 66 66 65 64 65 64 66 65 65 64 65 65 66 67
				72 68 67 67 66 66 66 66 68 66 66 66 66 66 67 69
				71 66 66 66 66 65 66 65 66 66 65 65 66 66 66 68
				71 67 66 66 66 65 66 65 68 66 66 65 66 66 66 69
				70 66 66 66 65 64 66 65 66 65 65 64 65 65 66 67
				72 67 67 66 66 66 66 66 67 66 66 66 66 66 66 69
				69 66 66 66 65 64 65 65 66 65 65 64 65 65 66 67
				69 66 66 65 65 64 65 66 66 65 65 64 65 65 66 68
				69 66 66 65 65 64 65 66 64 64 64 64 64 64 65 67
				70 66 66 66 66 66 66 66 66 66 66 65 66 66 66 69
				69 66 66 66 65 65 65 66 64 64 64 64 65 65 66 68
				69 66 66 66 65 65 66 66 66 65 65 65 66 66 66 68
				67 65 65 65 64 64 64 65 64 64 64 64 64 64 65 67
				69 66 66 66 66 66 66 66 66 65 65 65 66 66 66 69
				68 66 66 65 65 65 65 66 66 64 64 64 65 65 66 68
				69 66 66 66 65 65 66 66 66 64 64 64 65 65 65 68
				67 65 65 65 64 64 65 65 65 64 64 64 64 64 65 67
				69 66 66 66 66 66 66 66 66 66 65 66 66 66 66 69
				67 66 65 65 64 64 65 65 64 64 64 64 64 65 65 68
				67 66 65 65 64 64 65 66 64 64 64 64 64 65 65 68
				67 65 65 64 64 64 65 66 64 64 63 64 64 64 65 68
				69 66 66 66 65 66 66 67 64 65 64 65 66 66 66 69
				67 65 65 65 64 65 66 66 64 64 64 64 64 65 66 69
				67 66 65 65 64 65 66 66 64 64 64 64 65 65 66 69
				66 64 64 64 64 64 65 65 63 63 63 64 64 64 65 69
				68 66 66 65 65 65 66 66 64 64 64 65 65 66 66 70
				67 65 65 64 64 64 65 66 64 64 64 64 64 65 66 69
				67 66 65 65 64 64 66 66 64 64 64 64 64 65 66 69
				66 64 64 64 64 64 66 66 63 63 63 64 64 64 66 69
				68 66 66 65 64 65 67 67 64 64 64 64 65 65 66 70
				66 65 65 65 64 64 66 66 63 62 63 63 64 64 66 69
				>;

			PS_Config_Lmt_FW_Diff_P = <
				50 50 50 50 50 50 50 50 50 50 50 50 50 50 50 50
				50 50 50 50 50 50 50 50 50 50 50 50 50 50 50 50
				50 50 50 50 50 50 50 50 50 50 50 50 50 50 50 50
				50 50 50 50 50 50 50 50 50 50 50 50 50 50 50 50
				50 50 50 50 50 50 50 50 50 50 50 50 50 50 50 50
				50 50 50 50 50 50 50 50 50 50 50 50 50 50 50 50
				50 50 50 50 50 50 50 50 50 50 50 50 50 50 50 50
				50 50 50 50 50 50 50 50 50 50 50 50 50 50 50 50
				50 50 50 50 50 50 50 50 50 50 50 50 50 50 50 50
				50 50 50 50 50 50 50 50 50 50 50 50 50 50 50 50
				50 50 50 50 50 50 50 50 50 50 50 50 50 50 50 50
				50 50 50 50 50 50 50 50 50 50 50 50 50 50 50 50
				50 50 50 50 50 50 50 50 50 50 50 50 50 50 50 50
				50 50 50 50 50 50 50 50 50 50 50 50 50 50 50 50
				50 50 50 50 50 50 50 50 50 50 50 50 50 50 50 50
				50 50 50 50 50 50 50 50 50 50 50 50 50 50 50 50
				50 50 50 50 50 50 50 50 50 50 50 50 50 50 50 50
				50 50 50 50 50 50 50 50 50 50 50 50 50 50 50 50
				50 50 50 50 50 50 50 50 50 50 50 50 50 50 50 50
				50 50 50 50 50 50 50 50 50 50 50 50 50 50 50 50
				50 50 50 50 50 50 50 50 50 50 50 50 50 50 50 50
				50 50 50 50 50 50 50 50 50 50 50 50 50 50 50 50
				50 50 50 50 50 50 50 50 50 50 50 50 50 50 50 50
				50 50 50 50 50 50 50 50 50 50 50 50 50 50 50 50
				50 50 50 50 50 50 50 50 50 50 50 50 50 50 50 50
				50 50 50 50 50 50 50 50 50 50 50 50 50 50 50 50
				50 50 50 50 50 50 50 50 50 50 50 50 50 50 50 50
				50 50 50 50 50 50 50 50 50 50 50 50 50 50 50 50
				50 50 50 50 50 50 50 50 50 50 50 50 50 50 50 50
				50 50 50 50 50 50 50 50 50 50 50 50 50 50 50 50
				50 50 50 50 50 50 50 50 50 50 50 50 50 50 50 50
				50 50 50 50 50 50 50 50 50 50 50 50 50 50 50 50
				50 50 50 50 50 50 50 50 50 50 50 50 50 50 50 50
				50 50 50 50 50 50 50 50 50 50 50 50 50 50 50 50
				50 50 50 50 50 50 50 50 50 50 50 50 50 50 50 50
				50 50 50 50 50 50 50 50 50 50 50 50 50 50 50 50
				>;

			PS_Config_Lmt_FW_Diff_N = <
				(-50) (-50) (-50) (-50) (-50) (-50) (-50) (-50) (-50) (-50) (-50) (-50) (-50) (-50) (-50) (-50)
				(-50) (-50) (-50) (-50) (-50) (-50) (-50) (-50) (-50) (-50) (-50) (-50) (-50) (-50) (-50) (-50)
				(-50) (-50) (-50) (-50) (-50) (-50) (-50) (-50) (-50) (-50) (-50) (-50) (-50) (-50) (-50) (-50)
				(-50) (-50) (-50) (-50) (-50) (-50) (-50) (-50) (-50) (-50) (-50) (-50) (-50) (-50) (-50) (-50)
				(-50) (-50) (-50) (-50) (-50) (-50) (-50) (-50) (-50) (-50) (-50) (-50) (-50) (-50) (-50) (-50)
				(-50) (-50) (-50) (-50) (-50) (-50) (-50) (-50) (-50) (-50) (-50) (-50) (-50) (-50) (-50) (-50)
				(-50) (-50) (-50) (-50) (-50) (-50) (-50) (-50) (-50) (-50) (-50) (-50) (-50) (-50) (-50) (-50)
				(-50) (-50) (-50) (-50) (-50) (-50) (-50) (-50) (-50) (-50) (-50) (-50) (-50) (-50) (-50) (-50)
				(-50) (-50) (-50) (-50) (-50) (-50) (-50) (-50) (-50) (-50) (-50) (-50) (-50) (-50) (-50) (-50)
				(-50) (-50) (-50) (-50) (-50) (-50) (-50) (-50) (-50) (-50) (-50) (-50) (-50) (-50) (-50) (-50)
				(-50) (-50) (-50) (-50) (-50) (-50) (-50) (-50) (-50) (-50) (-50) (-50) (-50) (-50) (-50) (-50)
				(-50) (-50) (-50) (-50) (-50) (-50) (-50) (-50) (-50) (-50) (-50) (-50) (-50) (-50) (-50) (-50)
				(-50) (-50) (-50) (-50) (-50) (-50) (-50) (-50) (-50) (-50) (-50) (-50) (-50) (-50) (-50) (-50)
				(-50) (-50) (-50) (-50) (-50) (-50) (-50) (-50) (-50) (-50) (-50) (-50) (-50) (-50) (-50) (-50)
				(-50) (-50) (-50) (-50) (-50) (-50) (-50) (-50) (-50) (-50) (-50) (-50) (-50) (-50) (-50) (-50)
				(-50) (-50) (-50) (-50) (-50) (-50) (-50) (-50) (-50) (-50) (-50) (-50) (-50) (-50) (-50) (-50)
				(-50) (-50) (-50) (-50) (-50) (-50) (-50) (-50) (-50) (-50) (-50) (-50) (-50) (-50) (-50) (-50)
				(-50) (-50) (-50) (-50) (-50) (-50) (-50) (-50) (-50) (-50) (-50) (-50) (-50) (-50) (-50) (-50)
				(-50) (-50) (-50) (-50) (-50) (-50) (-50) (-50) (-50) (-50) (-50) (-50) (-50) (-50) (-50) (-50)
				(-50) (-50) (-50) (-50) (-50) (-50) (-50) (-50) (-50) (-50) (-50) (-50) (-50) (-50) (-50) (-50)
				(-50) (-50) (-50) (-50) (-50) (-50) (-50) (-50) (-50) (-50) (-50) (-50) (-50) (-50) (-50) (-50)
				(-50) (-50) (-50) (-50) (-50) (-50) (-50) (-50) (-50) (-50) (-50) (-50) (-50) (-50) (-50) (-50)
				(-50) (-50) (-50) (-50) (-50) (-50) (-50) (-50) (-50) (-50) (-50) (-50) (-50) (-50) (-50) (-50)
				(-50) (-50) (-50) (-50) (-50) (-50) (-50) (-50) (-50) (-50) (-50) (-50) (-50) (-50) (-50) (-50)
				(-50) (-50) (-50) (-50) (-50) (-50) (-50) (-50) (-50) (-50) (-50) (-50) (-50) (-50) (-50) (-50)
				(-50) (-50) (-50) (-50) (-50) (-50) (-50) (-50) (-50) (-50) (-50) (-50) (-50) (-50) (-50) (-50)
				(-50) (-50) (-50) (-50) (-50) (-50) (-50) (-50) (-50) (-50) (-50) (-50) (-50) (-50) (-50) (-50)
				(-50) (-50) (-50) (-50) (-50) (-50) (-50) (-50) (-50) (-50) (-50) (-50) (-50) (-50) (-50) (-50)
				(-50) (-50) (-50) (-50) (-50) (-50) (-50) (-50) (-50) (-50) (-50) (-50) (-50) (-50) (-50) (-50)
				(-50) (-50) (-50) (-50) (-50) (-50) (-50) (-50) (-50) (-50) (-50) (-50) (-50) (-50) (-50) (-50)
				(-50) (-50) (-50) (-50) (-50) (-50) (-50) (-50) (-50) (-50) (-50) (-50) (-50) (-50) (-50) (-50)
				(-50) (-50) (-50) (-50) (-50) (-50) (-50) (-50) (-50) (-50) (-50) (-50) (-50) (-50) (-50) (-50)
				(-50) (-50) (-50) (-50) (-50) (-50) (-50) (-50) (-50) (-50) (-50) (-50) (-50) (-50) (-50) (-50)
				(-50) (-50) (-50) (-50) (-50) (-50) (-50) (-50) (-50) (-50) (-50) (-50) (-50) (-50) (-50) (-50)
				(-50) (-50) (-50) (-50) (-50) (-50) (-50) (-50) (-50) (-50) (-50) (-50) (-50) (-50) (-50) (-50)
				(-50) (-50) (-50) (-50) (-50) (-50) (-50) (-50) (-50) (-50) (-50) (-50) (-50) (-50) (-50) (-50)
				>;

			PS_Config_Diff_Test_Frame = <50>;
		};

		/* SM23 currently */
		novatek-mp-criteria-1114@0 {
			#address-cells = <1>;
			#size-cells = <0>;
			compatible = "novatek-mp-criteria-1114";

			/* MP Config */
			IC_X_CFG_SIZE = <18>;
			IC_Y_CFG_SIZE = <34>;
			IC_KEY_CFG_SIZE = <4>;
			X_Channel = <18>;
			Y_Channel = <34>;
			AIN_X = <0 1 2 3 4 5 6 7 8 9 10 11 12 13 14 15 16 17>;
			AIN_Y = <0 1 2 3 4 5 6 7 8 9 10 11 12 13 14 15
					16 17 18 19 20 21 22 23 24 25 26 27 28 29 30
					31 32 33>;
			AIN_KEY = <0 1 2 0xFF>;

			/* MP Criteria */
			PS_Config_Lmt_Short_Rawdata_P = <
				20000 20000 20000 20000 20000 20000 20000 20000 20000 20000 20000 20000 20000 20000 20000 20000 20000 20000
				20000 20000 20000 20000 20000 20000 20000 20000 20000 20000 20000 20000 20000 20000 20000 20000 20000 20000
				20000 20000 20000 20000 20000 20000 20000 20000 20000 20000 20000 20000 20000 20000 20000 20000 20000 20000
				20000 20000 20000 20000 20000 20000 20000 20000 20000 20000 20000 20000 20000 20000 20000 20000 20000 20000
				20000 20000 20000 20000 20000 20000 20000 20000 20000 20000 20000 20000 20000 20000 20000 20000 20000 20000
				20000 20000 20000 20000 20000 20000 20000 20000 20000 20000 20000 20000 20000 20000 20000 20000 20000 20000
				20000 20000 20000 20000 20000 20000 20000 20000 20000 20000 20000 20000 20000 20000 20000 20000 20000 20000
				20000 20000 20000 20000 20000 20000 20000 20000 20000 20000 20000 20000 20000 20000 20000 20000 20000 20000
				20000 20000 20000 20000 20000 20000 20000 20000 20000 20000 20000 20000 20000 20000 20000 20000 20000 20000
				20000 20000 20000 20000 20000 20000 20000 20000 20000 20000 20000 20000 20000 20000 20000 20000 20000 20000
				20000 20000 20000 20000 20000 20000 20000 20000 20000 20000 20000 20000 20000 20000 20000 20000 20000 20000
				20000 20000 20000 20000 20000 20000 20000 20000 20000 20000 20000 20000 20000 20000 20000 20000 20000 20000
				20000 20000 20000 20000 20000 20000 20000 20000 20000 20000 20000 20000 20000 20000 20000 20000 20000 20000
				20000 20000 20000 20000 20000 20000 20000 20000 20000 20000 20000 20000 20000 20000 20000 20000 20000 20000
				20000 20000 20000 20000 20000 20000 20000 20000 20000 20000 20000 20000 20000 20000 20000 20000 20000 20000
				20000 20000 20000 20000 20000 20000 20000 20000 20000 20000 20000 20000 20000 20000 20000 20000 20000 20000
				20000 20000 20000 20000 20000 20000 20000 20000 20000 20000 20000 20000 20000 20000 20000 20000 20000 20000
				20000 20000 20000 20000 20000 20000 20000 20000 20000 20000 20000 20000 20000 20000 20000 20000 20000 20000
				20000 20000 20000 20000 20000 20000 20000 20000 20000 20000 20000 20000 20000 20000 20000 20000 20000 20000
				20000 20000 20000 20000 20000 20000 20000 20000 20000 20000 20000 20000 20000 20000 20000 20000 20000 20000
				20000 20000 20000 20000 20000 20000 20000 20000 20000 20000 20000 20000 20000 20000 20000 20000 20000 20000
				20000 20000 20000 20000 20000 20000 20000 20000 20000 20000 20000 20000 20000 20000 20000 20000 20000 20000
				20000 20000 20000 20000 20000 20000 20000 20000 20000 20000 20000 20000 20000 20000 20000 20000 20000 20000
				20000 20000 20000 20000 20000 20000 20000 20000 20000 20000 20000 20000 20000 20000 20000 20000 20000 20000
				20000 20000 20000 20000 20000 20000 20000 20000 20000 20000 20000 20000 20000 20000 20000 20000 20000 20000
				20000 20000 20000 20000 20000 20000 20000 20000 20000 20000 20000 20000 20000 20000 20000 20000 20000 20000
				20000 20000 20000 20000 20000 20000 20000 20000 20000 20000 20000 20000 20000 20000 20000 20000 20000 20000
				20000 20000 20000 20000 20000 20000 20000 20000 20000 20000 20000 20000 20000 20000 20000 20000 20000 20000
				20000 20000 20000 20000 20000 20000 20000 20000 20000 20000 20000 20000 20000 20000 20000 20000 20000 20000
				20000 20000 20000 20000 20000 20000 20000 20000 20000 20000 20000 20000 20000 20000 20000 20000 20000 20000
				20000 20000 20000 20000 20000 20000 20000 20000 20000 20000 20000 20000 20000 20000 20000 20000 20000 20000
				20000 20000 20000 20000 20000 20000 20000 20000 20000 20000 20000 20000 20000 20000 20000 20000 20000 20000
				20000 20000 20000 20000 20000 20000 20000 20000 20000 20000 20000 20000 20000 20000 20000 20000 20000 20000
				20000 20000 20000 20000 20000 20000 20000 20000 20000 20000 20000 20000 20000 20000 20000 20000 20000 20000
				>;

			PS_Config_Lmt_Short_Rawdata_N = <
				0 0 0 0 0 0 0 0 0 0 0 0 0 0 0 0 0 0
				0 0 0 0 0 0 0 0 0 0 0 0 0 0 0 0 0 0
				0 0 0 0 0 0 0 0 0 0 0 0 0 0 0 0 0 0
				0 0 0 0 0 0 0 0 0 0 0 0 0 0 0 0 0 0
				0 0 0 0 0 0 0 0 0 0 0 0 0 0 0 0 0 0
				0 0 0 0 0 0 0 0 0 0 0 0 0 0 0 0 0 0
				0 0 0 0 0 0 0 0 0 0 0 0 0 0 0 0 0 0
				0 0 0 0 0 0 0 0 0 0 0 0 0 0 0 0 0 0
				0 0 0 0 0 0 0 0 0 0 0 0 0 0 0 0 0 0
				0 0 0 0 0 0 0 0 0 0 0 0 0 0 0 0 0 0
				0 0 0 0 0 0 0 0 0 0 0 0 0 0 0 0 0 0
				0 0 0 0 0 0 0 0 0 0 0 0 0 0 0 0 0 0
				0 0 0 0 0 0 0 0 0 0 0 0 0 0 0 0 0 0
				0 0 0 0 0 0 0 0 0 0 0 0 0 0 0 0 0 0
				0 0 0 0 0 0 0 0 0 0 0 0 0 0 0 0 0 0
				0 0 0 0 0 0 0 0 0 0 0 0 0 0 0 0 0 0
				0 0 0 0 0 0 0 0 0 0 0 0 0 0 0 0 0 0
				0 0 0 0 0 0 0 0 0 0 0 0 0 0 0 0 0 0
				0 0 0 0 0 0 0 0 0 0 0 0 0 0 0 0 0 0
				0 0 0 0 0 0 0 0 0 0 0 0 0 0 0 0 0 0
				0 0 0 0 0 0 0 0 0 0 0 0 0 0 0 0 0 0
				0 0 0 0 0 0 0 0 0 0 0 0 0 0 0 0 0 0
				0 0 0 0 0 0 0 0 0 0 0 0 0 0 0 0 0 0
				0 0 0 0 0 0 0 0 0 0 0 0 0 0 0 0 0 0
				0 0 0 0 0 0 0 0 0 0 0 0 0 0 0 0 0 0
				0 0 0 0 0 0 0 0 0 0 0 0 0 0 0 0 0 0
				0 0 0 0 0 0 0 0 0 0 0 0 0 0 0 0 0 0
				0 0 0 0 0 0 0 0 0 0 0 0 0 0 0 0 0 0
				0 0 0 0 0 0 0 0 0 0 0 0 0 0 0 0 0 0
				0 0 0 0 0 0 0 0 0 0 0 0 0 0 0 0 0 0
				0 0 0 0 0 0 0 0 0 0 0 0 0 0 0 0 0 0
				0 0 0 0 0 0 0 0 0 0 0 0 0 0 0 0 0 0
				0 0 0 0 0 0 0 0 0 0 0 0 0 0 0 0 0 0
				0 0 0 0 0 0 0 0 0 0 0 0 0 0 0 0 0 0
				>;

			PS_Config_Lmt_Open_Rawdata_P = <
				20000 20000 20000 20000 20000 20000 20000 20000 20000 20000 20000 20000 20000 20000 20000 20000 20000 20000
				20000 20000 20000 20000 20000 20000 20000 20000 20000 20000 20000 20000 20000 20000 20000 20000 20000 20000
				20000 20000 20000 20000 20000 20000 20000 20000 20000 20000 20000 20000 20000 20000 20000 20000 20000 20000
				20000 20000 20000 20000 20000 20000 20000 20000 20000 20000 20000 20000 20000 20000 20000 20000 20000 20000
				20000 20000 20000 20000 20000 20000 20000 20000 20000 20000 20000 20000 20000 20000 20000 20000 20000 20000
				20000 20000 20000 20000 20000 20000 20000 20000 20000 20000 20000 20000 20000 20000 20000 20000 20000 20000
				20000 20000 20000 20000 20000 20000 20000 20000 20000 20000 20000 20000 20000 20000 20000 20000 20000 20000
				20000 20000 20000 20000 20000 20000 20000 20000 20000 20000 20000 20000 20000 20000 20000 20000 20000 20000
				20000 20000 20000 20000 20000 20000 20000 20000 20000 20000 20000 20000 20000 20000 20000 20000 20000 20000
				20000 20000 20000 20000 20000 20000 20000 20000 20000 20000 20000 20000 20000 20000 20000 20000 20000 20000
				20000 20000 20000 20000 20000 20000 20000 20000 20000 20000 20000 20000 20000 20000 20000 20000 20000 20000
				20000 20000 20000 20000 20000 20000 20000 20000 20000 20000 20000 20000 20000 20000 20000 20000 20000 20000
				20000 20000 20000 20000 20000 20000 20000 20000 20000 20000 20000 20000 20000 20000 20000 20000 20000 20000
				20000 20000 20000 20000 20000 20000 20000 20000 20000 20000 20000 20000 20000 20000 20000 20000 20000 20000
				20000 20000 20000 20000 20000 20000 20000 20000 20000 20000 20000 20000 20000 20000 20000 20000 20000 20000
				20000 20000 20000 20000 20000 20000 20000 20000 20000 20000 20000 20000 20000 20000 20000 20000 20000 20000
				20000 20000 20000 20000 20000 20000 20000 20000 20000 20000 20000 20000 20000 20000 20000 20000 20000 20000
				20000 20000 20000 20000 20000 20000 20000 20000 20000 20000 20000 20000 20000 20000 20000 20000 20000 20000
				20000 20000 20000 20000 20000 20000 20000 20000 20000 20000 20000 20000 20000 20000 20000 20000 20000 20000
				20000 20000 20000 20000 20000 20000 20000 20000 20000 20000 20000 20000 20000 20000 20000 20000 20000 20000
				20000 20000 20000 20000 20000 20000 20000 20000 20000 20000 20000 20000 20000 20000 20000 20000 20000 20000
				20000 20000 20000 20000 20000 20000 20000 20000 20000 20000 20000 20000 20000 20000 20000 20000 20000 20000
				20000 20000 20000 20000 20000 20000 20000 20000 20000 20000 20000 20000 20000 20000 20000 20000 20000 20000
				20000 20000 20000 20000 20000 20000 20000 20000 20000 20000 20000 20000 20000 20000 20000 20000 20000 20000
				20000 20000 20000 20000 20000 20000 20000 20000 20000 20000 20000 20000 20000 20000 20000 20000 20000 20000
				20000 20000 20000 20000 20000 20000 20000 20000 20000 20000 20000 20000 20000 20000 20000 20000 20000 20000
				20000 20000 20000 20000 20000 20000 20000 20000 20000 20000 20000 20000 20000 20000 20000 20000 20000 20000
				20000 20000 20000 20000 20000 20000 20000 20000 20000 20000 20000 20000 20000 20000 20000 20000 20000 20000
				20000 20000 20000 20000 20000 20000 20000 20000 20000 20000 20000 20000 20000 20000 20000 20000 20000 20000
				20000 20000 20000 20000 20000 20000 20000 20000 20000 20000 20000 20000 20000 20000 20000 20000 20000 20000
				20000 20000 20000 20000 20000 20000 20000 20000 20000 20000 20000 20000 20000 20000 20000 20000 20000 20000
				20000 20000 20000 20000 20000 20000 20000 20000 20000 20000 20000 20000 20000 20000 20000 20000 20000 20000
				20000 20000 20000 20000 20000 20000 20000 20000 20000 20000 20000 20000 20000 20000 20000 20000 20000 20000
				20000 20000 20000 20000 20000 20000 20000 20000 20000 20000 20000 20000 20000 20000 20000 20000 20000 20000
				>;

			PS_Config_Lmt_Open_Rawdata_N = <
				0 0 0 0 0 0 0 0 0 0 0 0 0 0 0 0 0 0
				0 0 0 0 0 0 0 0 0 0 0 0 0 0 0 0 0 0
				0 0 0 0 0 0 0 0 0 0 0 0 0 0 0 0 0 0
				0 0 0 0 0 0 0 0 0 0 0 0 0 0 0 0 0 0
				0 0 0 0 0 0 0 0 0 0 0 0 0 0 0 0 0 0
				0 0 0 0 0 0 0 0 0 0 0 0 0 0 0 0 0 0
				0 0 0 0 0 0 0 0 0 0 0 0 0 0 0 0 0 0
				0 0 0 0 0 0 0 0 0 0 0 0 0 0 0 0 0 0
				0 0 0 0 0 0 0 0 0 0 0 0 0 0 0 0 0 0
				0 0 0 0 0 0 0 0 0 0 0 0 0 0 0 0 0 0
				0 0 0 0 0 0 0 0 0 0 0 0 0 0 0 0 0 0
				0 0 0 0 0 0 0 0 0 0 0 0 0 0 0 0 0 0
				0 0 0 0 0 0 0 0 0 0 0 0 0 0 0 0 0 0
				0 0 0 0 0 0 0 0 0 0 0 0 0 0 0 0 0 0
				0 0 0 0 0 0 0 0 0 0 0 0 0 0 0 0 0 0
				0 0 0 0 0 0 0 0 0 0 0 0 0 0 0 0 0 0
				0 0 0 0 0 0 0 0 0 0 0 0 0 0 0 0 0 0
				0 0 0 0 0 0 0 0 0 0 0 0 0 0 0 0 0 0
				0 0 0 0 0 0 0 0 0 0 0 0 0 0 0 0 0 0
				0 0 0 0 0 0 0 0 0 0 0 0 0 0 0 0 0 0
				0 0 0 0 0 0 0 0 0 0 0 0 0 0 0 0 0 0
				0 0 0 0 0 0 0 0 0 0 0 0 0 0 0 0 0 0
				0 0 0 0 0 0 0 0 0 0 0 0 0 0 0 0 0 0
				0 0 0 0 0 0 0 0 0 0 0 0 0 0 0 0 0 0
				0 0 0 0 0 0 0 0 0 0 0 0 0 0 0 0 0 0
				0 0 0 0 0 0 0 0 0 0 0 0 0 0 0 0 0 0
				0 0 0 0 0 0 0 0 0 0 0 0 0 0 0 0 0 0
				0 0 0 0 0 0 0 0 0 0 0 0 0 0 0 0 0 0
				0 0 0 0 0 0 0 0 0 0 0 0 0 0 0 0 0 0
				0 0 0 0 0 0 0 0 0 0 0 0 0 0 0 0 0 0
				0 0 0 0 0 0 0 0 0 0 0 0 0 0 0 0 0 0
				0 0 0 0 0 0 0 0 0 0 0 0 0 0 0 0 0 0
				0 0 0 0 0 0 0 0 0 0 0 0 0 0 0 0 0 0
				0 0 0 0 0 0 0 0 0 0 0 0 0 0 0 0 0 0
				>;

			PS_Config_Lmt_FW_Rawdata_P = <
				2000 2000 2000 2000 2000 2000 2000 2000 2000 2000 2000 2000 2000 2000 2000 2000 2000 2000
				2000 2000 2000 2000 2000 2000 2000 2000 2000 2000 2000 2000 2000 2000 2000 2000 2000 2000
				2000 2000 2000 2000 2000 2000 2000 2000 2000 2000 2000 2000 2000 2000 2000 2000 2000 2000
				2000 2000 2000 2000 2000 2000 2000 2000 2000 2000 2000 2000 2000 2000 2000 2000 2000 2000
				2000 2000 2000 2000 2000 2000 2000 2000 2000 2000 2000 2000 2000 2000 2000 2000 2000 2000
				2000 2000 2000 2000 2000 2000 2000 2000 2000 2000 2000 2000 2000 2000 2000 2000 2000 2000
				2000 2000 2000 2000 2000 2000 2000 2000 2000 2000 2000 2000 2000 2000 2000 2000 2000 2000
				2000 2000 2000 2000 2000 2000 2000 2000 2000 2000 2000 2000 2000 2000 2000 2000 2000 2000
				2000 2000 2000 2000 2000 2000 2000 2000 2000 2000 2000 2000 2000 2000 2000 2000 2000 2000
				2000 2000 2000 2000 2000 2000 2000 2000 2000 2000 2000 2000 2000 2000 2000 2000 2000 2000
				2000 2000 2000 2000 2000 2000 2000 2000 2000 2000 2000 2000 2000 2000 2000 2000 2000 2000
				2000 2000 2000 2000 2000 2000 2000 2000 2000 2000 2000 2000 2000 2000 2000 2000 2000 2000
				2000 2000 2000 2000 2000 2000 2000 2000 2000 2000 2000 2000 2000 2000 2000 2000 2000 2000
				2000 2000 2000 2000 2000 2000 2000 2000 2000 2000 2000 2000 2000 2000 2000 2000 2000 2000
				2000 2000 2000 2000 2000 2000 2000 2000 2000 2000 2000 2000 2000 2000 2000 2000 2000 2000
				2000 2000 2000 2000 2000 2000 2000 2000 2000 2000 2000 2000 2000 2000 2000 2000 2000 2000
				2000 2000 2000 2000 2000 2000 2000 2000 2000 2000 2000 2000 2000 2000 2000 2000 2000 2000
				2000 2000 2000 2000 2000 2000 2000 2000 2000 2000 2000 2000 2000 2000 2000 2000 2000 2000
				2000 2000 2000 2000 2000 2000 2000 2000 2000 2000 2000 2000 2000 2000 2000 2000 2000 2000
				2000 2000 2000 2000 2000 2000 2000 2000 2000 2000 2000 2000 2000 2000 2000 2000 2000 2000
				2000 2000 2000 2000 2000 2000 2000 2000 2000 2000 2000 2000 2000 2000 2000 2000 2000 2000
				2000 2000 2000 2000 2000 2000 2000 2000 2000 2000 2000 2000 2000 2000 2000 2000 2000 2000
				2000 2000 2000 2000 2000 2000 2000 2000 2000 2000 2000 2000 2000 2000 2000 2000 2000 2000
				2000 2000 2000 2000 2000 2000 2000 2000 2000 2000 2000 2000 2000 2000 2000 2000 2000 2000
				2000 2000 2000 2000 2000 2000 2000 2000 2000 2000 2000 2000 2000 2000 2000 2000 2000 2000
				2000 2000 2000 2000 2000 2000 2000 2000 2000 2000 2000 2000 2000 2000 2000 2000 2000 2000
				2000 2000 2000 2000 2000 2000 2000 2000 2000 2000 2000 2000 2000 2000 2000 2000 2000 2000
				2000 2000 2000 2000 2000 2000 2000 2000 2000 2000 2000 2000 2000 2000 2000 2000 2000 2000
				2000 2000 2000 2000 2000 2000 2000 2000 2000 2000 2000 2000 2000 2000 2000 2000 2000 2000
				2000 2000 2000 2000 2000 2000 2000 2000 2000 2000 2000 2000 2000 2000 2000 2000 2000 2000
				2000 2000 2000 2000 2000 2000 2000 2000 2000 2000 2000 2000 2000 2000 2000 2000 2000 2000
				2000 2000 2000 2000 2000 2000 2000 2000 2000 2000 2000 2000 2000 2000 2000 2000 2000 2000
				2000 2000 2000 2000 2000 2000 2000 2000 2000 2000 2000 2000 2000 2000 2000 2000 2000 2000
				2000 2000 2000 2000 2000 2000 2000 2000 2000 2000 2000 2000 2000 2000 2000 2000 2000 2000
				>;

			PS_Config_Lmt_FW_Rawdata_N = <
				0 0 0 0 0 0 0 0 0 0 0 0 0 0 0 0 0 0
				0 0 0 0 0 0 0 0 0 0 0 0 0 0 0 0 0 0
				0 0 0 0 0 0 0 0 0 0 0 0 0 0 0 0 0 0
				0 0 0 0 0 0 0 0 0 0 0 0 0 0 0 0 0 0
				0 0 0 0 0 0 0 0 0 0 0 0 0 0 0 0 0 0
				0 0 0 0 0 0 0 0 0 0 0 0 0 0 0 0 0 0
				0 0 0 0 0 0 0 0 0 0 0 0 0 0 0 0 0 0
				0 0 0 0 0 0 0 0 0 0 0 0 0 0 0 0 0 0
				0 0 0 0 0 0 0 0 0 0 0 0 0 0 0 0 0 0
				0 0 0 0 0 0 0 0 0 0 0 0 0 0 0 0 0 0
				0 0 0 0 0 0 0 0 0 0 0 0 0 0 0 0 0 0
				0 0 0 0 0 0 0 0 0 0 0 0 0 0 0 0 0 0
				0 0 0 0 0 0 0 0 0 0 0 0 0 0 0 0 0 0
				0 0 0 0 0 0 0 0 0 0 0 0 0 0 0 0 0 0
				0 0 0 0 0 0 0 0 0 0 0 0 0 0 0 0 0 0
				0 0 0 0 0 0 0 0 0 0 0 0 0 0 0 0 0 0
				0 0 0 0 0 0 0 0 0 0 0 0 0 0 0 0 0 0
				0 0 0 0 0 0 0 0 0 0 0 0 0 0 0 0 0 0
				0 0 0 0 0 0 0 0 0 0 0 0 0 0 0 0 0 0
				0 0 0 0 0 0 0 0 0 0 0 0 0 0 0 0 0 0
				0 0 0 0 0 0 0 0 0 0 0 0 0 0 0 0 0 0
				0 0 0 0 0 0 0 0 0 0 0 0 0 0 0 0 0 0
				0 0 0 0 0 0 0 0 0 0 0 0 0 0 0 0 0 0
				0 0 0 0 0 0 0 0 0 0 0 0 0 0 0 0 0 0
				0 0 0 0 0 0 0 0 0 0 0 0 0 0 0 0 0 0
				0 0 0 0 0 0 0 0 0 0 0 0 0 0 0 0 0 0
				0 0 0 0 0 0 0 0 0 0 0 0 0 0 0 0 0 0
				0 0 0 0 0 0 0 0 0 0 0 0 0 0 0 0 0 0
				0 0 0 0 0 0 0 0 0 0 0 0 0 0 0 0 0 0
				0 0 0 0 0 0 0 0 0 0 0 0 0 0 0 0 0 0
				0 0 0 0 0 0 0 0 0 0 0 0 0 0 0 0 0 0
				0 0 0 0 0 0 0 0 0 0 0 0 0 0 0 0 0 0
				0 0 0 0 0 0 0 0 0 0 0 0 0 0 0 0 0 0
				0 0 0 0 0 0 0 0 0 0 0 0 0 0 0 0 0 0
				>;

			PS_Config_Lmt_FW_CC_P = <
				511 511 511 511 511 511 511 511 511 511 511 511 511 511 511 511 511 511
				511 511 511 511 511 511 511 511 511 511 511 511 511 511 511 511 511 511
				511 511 511 511 511 511 511 511 511 511 511 511 511 511 511 511 511 511
				511 511 511 511 511 511 511 511 511 511 511 511 511 511 511 511 511 511
				511 511 511 511 511 511 511 511 511 511 511 511 511 511 511 511 511 511
				511 511 511 511 511 511 511 511 511 511 511 511 511 511 511 511 511 511
				511 511 511 511 511 511 511 511 511 511 511 511 511 511 511 511 511 511
				511 511 511 511 511 511 511 511 511 511 511 511 511 511 511 511 511 511
				511 511 511 511 511 511 511 511 511 511 511 511 511 511 511 511 511 511
				511 511 511 511 511 511 511 511 511 511 511 511 511 511 511 511 511 511
				511 511 511 511 511 511 511 511 511 511 511 511 511 511 511 511 511 511
				511 511 511 511 511 511 511 511 511 511 511 511 511 511 511 511 511 511
				511 511 511 511 511 511 511 511 511 511 511 511 511 511 511 511 511 511
				511 511 511 511 511 511 511 511 511 511 511 511 511 511 511 511 511 511
				511 511 511 511 511 511 511 511 511 511 511 511 511 511 511 511 511 511
				511 511 511 511 511 511 511 511 511 511 511 511 511 511 511 511 511 511
				511 511 511 511 511 511 511 511 511 511 511 511 511 511 511 511 511 511
				511 511 511 511 511 511 511 511 511 511 511 511 511 511 511 511 511 511
				511 511 511 511 511 511 511 511 511 511 511 511 511 511 511 511 511 511
				511 511 511 511 511 511 511 511 511 511 511 511 511 511 511 511 511 511
				511 511 511 511 511 511 511 511 511 511 511 511 511 511 511 511 511 511
				511 511 511 511 511 511 511 511 511 511 511 511 511 511 511 511 511 511
				511 511 511 511 511 511 511 511 511 511 511 511 511 511 511 511 511 511
				511 511 511 511 511 511 511 511 511 511 511 511 511 511 511 511 511 511
				511 511 511 511 511 511 511 511 511 511 511 511 511 511 511 511 511 511
				511 511 511 511 511 511 511 511 511 511 511 511 511 511 511 511 511 511
				511 511 511 511 511 511 511 511 511 511 511 511 511 511 511 511 511 511
				511 511 511 511 511 511 511 511 511 511 511 511 511 511 511 511 511 511
				511 511 511 511 511 511 511 511 511 511 511 511 511 511 511 511 511 511
				511 511 511 511 511 511 511 511 511 511 511 511 511 511 511 511 511 511
				511 511 511 511 511 511 511 511 511 511 511 511 511 511 511 511 511 511
				511 511 511 511 511 511 511 511 511 511 511 511 511 511 511 511 511 511
				511 511 511 511 511 511 511 511 511 511 511 511 511 511 511 511 511 511
				511 511 511 511 511 511 511 511 511 511 511 511 511 511 511 511 511 511
				>;

			PS_Config_Lmt_FW_CC_N = <
				0 0 0 0 0 0 0 0 0 0 0 0 0 0 0 0 0 0
				0 0 0 0 0 0 0 0 0 0 0 0 0 0 0 0 0 0
				0 0 0 0 0 0 0 0 0 0 0 0 0 0 0 0 0 0
				0 0 0 0 0 0 0 0 0 0 0 0 0 0 0 0 0 0
				0 0 0 0 0 0 0 0 0 0 0 0 0 0 0 0 0 0
				0 0 0 0 0 0 0 0 0 0 0 0 0 0 0 0 0 0
				0 0 0 0 0 0 0 0 0 0 0 0 0 0 0 0 0 0
				0 0 0 0 0 0 0 0 0 0 0 0 0 0 0 0 0 0
				0 0 0 0 0 0 0 0 0 0 0 0 0 0 0 0 0 0
				0 0 0 0 0 0 0 0 0 0 0 0 0 0 0 0 0 0
				0 0 0 0 0 0 0 0 0 0 0 0 0 0 0 0 0 0
				0 0 0 0 0 0 0 0 0 0 0 0 0 0 0 0 0 0
				0 0 0 0 0 0 0 0 0 0 0 0 0 0 0 0 0 0
				0 0 0 0 0 0 0 0 0 0 0 0 0 0 0 0 0 0
				0 0 0 0 0 0 0 0 0 0 0 0 0 0 0 0 0 0
				0 0 0 0 0 0 0 0 0 0 0 0 0 0 0 0 0 0
				0 0 0 0 0 0 0 0 0 0 0 0 0 0 0 0 0 0
				0 0 0 0 0 0 0 0 0 0 0 0 0 0 0 0 0 0
				0 0 0 0 0 0 0 0 0 0 0 0 0 0 0 0 0 0
				0 0 0 0 0 0 0 0 0 0 0 0 0 0 0 0 0 0
				0 0 0 0 0 0 0 0 0 0 0 0 0 0 0 0 0 0
				0 0 0 0 0 0 0 0 0 0 0 0 0 0 0 0 0 0
				0 0 0 0 0 0 0 0 0 0 0 0 0 0 0 0 0 0
				0 0 0 0 0 0 0 0 0 0 0 0 0 0 0 0 0 0
				0 0 0 0 0 0 0 0 0 0 0 0 0 0 0 0 0 0
				0 0 0 0 0 0 0 0 0 0 0 0 0 0 0 0 0 0
				0 0 0 0 0 0 0 0 0 0 0 0 0 0 0 0 0 0
				0 0 0 0 0 0 0 0 0 0 0 0 0 0 0 0 0 0
				0 0 0 0 0 0 0 0 0 0 0 0 0 0 0 0 0 0
				0 0 0 0 0 0 0 0 0 0 0 0 0 0 0 0 0 0
				0 0 0 0 0 0 0 0 0 0 0 0 0 0 0 0 0 0
				0 0 0 0 0 0 0 0 0 0 0 0 0 0 0 0 0 0
				0 0 0 0 0 0 0 0 0 0 0 0 0 0 0 0 0 0
				0 0 0 0 0 0 0 0 0 0 0 0 0 0 0 0 0 0
				>;

			PS_Config_Lmt_FW_Diff_P = <
				127 127 127 127 127 127 127 127 127 127 127 127 127 127 127 127
				127 127 127 127 127 127 127 127 127 127 127 127 127 127 127 127
				127 127 127 127 127 127 127 127 127 127 127 127 127 127 127 127
				127 127 127 127 127 127 127 127 127 127 127 127 127 127 127 127
				127 127 127 127 127 127 127 127 127 127 127 127 127 127 127 127
				127 127 127 127 127 127 127 127 127 127 127 127 127 127 127 127
				127 127 127 127 127 127 127 127 127 127 127 127 127 127 127 127
				127 127 127 127 127 127 127 127 127 127 127 127 127 127 127 127
				127 127 127 127 127 127 127 127 127 127 127 127 127 127 127 127
				127 127 127 127 127 127 127 127 127 127 127 127 127 127 127 127
				127 127 127 127 127 127 127 127 127 127 127 127 127 127 127 127
				127 127 127 127 127 127 127 127 127 127 127 127 127 127 127 127
				127 127 127 127 127 127 127 127 127 127 127 127 127 127 127 127
				127 127 127 127 127 127 127 127 127 127 127 127 127 127 127 127
				127 127 127 127 127 127 127 127 127 127 127 127 127 127 127 127
				127 127 127 127 127 127 127 127 127 127 127 127 127 127 127 127
				127 127 127 127 127 127 127 127 127 127 127 127 127 127 127 127
				127 127 127 127 127 127 127 127 127 127 127 127 127 127 127 127
				127 127 127 127 127 127 127 127 127 127 127 127 127 127 127 127
				127 127 127 127 127 127 127 127 127 127 127 127 127 127 127 127
				127 127 127 127 127 127 127 127 127 127 127 127 127 127 127 127
				127 127 127 127 127 127 127 127 127 127 127 127 127 127 127 127
				127 127 127 127 127 127 127 127 127 127 127 127 127 127 127 127
				127 127 127 127 127 127 127 127 127 127 127 127 127 127 127 127
				127 127 127 127 127 127 127 127 127 127 127 127 127 127 127 127
				127 127 127 127 127 127 127 127 127 127 127 127 127 127 127 127
				127 127 127 127 127 127 127 127 127 127 127 127 127 127 127 127
				127 127 127 127 127 127 127 127 127 127 127 127 127 127 127 127
				127 127 127 127 127 127 127 127 127 127 127 127 127 127 127 127
				127 127 127 127 127 127 127 127 127 127 127 127 127 127 127 127
				127 127 127 127 127 127 127 127 127 127 127 127 127 127 127 127
				127 127 127 127 127 127 127 127 127 127 127 127 127 127 127 127
				127 127 127 127 127 127 127 127 127 127 127 127 127 127 127 127
				127 127 127 127 127 127 127 127 127 127 127 127 127 127 127 127
				127 127 127 127 127 127 127 127 127 127 127 127 127 127 127 127
				127 127 127 127 127 127 127 127 127 127 127 127 127 127 127 127
				127 127 127 127 127 127 127 127 127 127 127 127 127 127 127 127
				127 127 127 127 127 127 127 127 127 127 127 127 127 127 127 127
				127 127 127 127>;

			PS_Config_Lmt_FW_Diff_N = <
				(-127) (-127) (-127) (-127) (-127) (-127) (-127) (-127) (-127) (-127) (-127) (-127) (-127) (-127) (-127) (-127)
				(-127) (-127) (-127) (-127) (-127) (-127) (-127) (-127) (-127) (-127) (-127) (-127) (-127) (-127) (-127) (-127)
				(-127) (-127) (-127) (-127) (-127) (-127) (-127) (-127) (-127) (-127) (-127) (-127) (-127) (-127) (-127) (-127)
				(-127) (-127) (-127) (-127) (-127) (-127) (-127) (-127) (-127) (-127) (-127) (-127) (-127) (-127) (-127) (-127)
				(-127) (-127) (-127) (-127) (-127) (-127) (-127) (-127) (-127) (-127) (-127) (-127) (-127) (-127) (-127) (-127)
				(-127) (-127) (-127) (-127) (-127) (-127) (-127) (-127) (-127) (-127) (-127) (-127) (-127) (-127) (-127) (-127)
				(-127) (-127) (-127) (-127) (-127) (-127) (-127) (-127) (-127) (-127) (-127) (-127) (-127) (-127) (-127) (-127)
				(-127) (-127) (-127) (-127) (-127) (-127) (-127) (-127) (-127) (-127) (-127) (-127) (-127) (-127) (-127) (-127)
				(-127) (-127) (-127) (-127) (-127) (-127) (-127) (-127) (-127) (-127) (-127) (-127) (-127) (-127) (-127) (-127)
				(-127) (-127) (-127) (-127) (-127) (-127) (-127) (-127) (-127) (-127) (-127) (-127) (-127) (-127) (-127) (-127)
				(-127) (-127) (-127) (-127) (-127) (-127) (-127) (-127) (-127) (-127) (-127) (-127) (-127) (-127) (-127) (-127)
				(-127) (-127) (-127) (-127) (-127) (-127) (-127) (-127) (-127) (-127) (-127) (-127) (-127) (-127) (-127) (-127)
				(-127) (-127) (-127) (-127) (-127) (-127) (-127) (-127) (-127) (-127) (-127) (-127) (-127) (-127) (-127) (-127)
				(-127) (-127) (-127) (-127) (-127) (-127) (-127) (-127) (-127) (-127) (-127) (-127) (-127) (-127) (-127) (-127)
				(-127) (-127) (-127) (-127) (-127) (-127) (-127) (-127) (-127) (-127) (-127) (-127) (-127) (-127) (-127) (-127)
				(-127) (-127) (-127) (-127) (-127) (-127) (-127) (-127) (-127) (-127) (-127) (-127) (-127) (-127) (-127) (-127)
				(-127) (-127) (-127) (-127) (-127) (-127) (-127) (-127) (-127) (-127) (-127) (-127) (-127) (-127) (-127) (-127)
				(-127) (-127) (-127) (-127) (-127) (-127) (-127) (-127) (-127) (-127) (-127) (-127) (-127) (-127) (-127) (-127)
				(-127) (-127) (-127) (-127) (-127) (-127) (-127) (-127) (-127) (-127) (-127) (-127) (-127) (-127) (-127) (-127)
				(-127) (-127) (-127) (-127) (-127) (-127) (-127) (-127) (-127) (-127) (-127) (-127) (-127) (-127) (-127) (-127)
				(-127) (-127) (-127) (-127) (-127) (-127) (-127) (-127) (-127) (-127) (-127) (-127) (-127) (-127) (-127) (-127)
				(-127) (-127) (-127) (-127) (-127) (-127) (-127) (-127) (-127) (-127) (-127) (-127) (-127) (-127) (-127) (-127)
				(-127) (-127) (-127) (-127) (-127) (-127) (-127) (-127) (-127) (-127) (-127) (-127) (-127) (-127) (-127) (-127)
				(-127) (-127) (-127) (-127) (-127) (-127) (-127) (-127) (-127) (-127) (-127) (-127) (-127) (-127) (-127) (-127)
				(-127) (-127) (-127) (-127) (-127) (-127) (-127) (-127) (-127) (-127) (-127) (-127) (-127) (-127) (-127) (-127)
				(-127) (-127) (-127) (-127) (-127) (-127) (-127) (-127) (-127) (-127) (-127) (-127) (-127) (-127) (-127) (-127)
				(-127) (-127) (-127) (-127) (-127) (-127) (-127) (-127) (-127) (-127) (-127) (-127) (-127) (-127) (-127) (-127)
				(-127) (-127) (-127) (-127) (-127) (-127) (-127) (-127) (-127) (-127) (-127) (-127) (-127) (-127) (-127) (-127)
				(-127) (-127) (-127) (-127) (-127) (-127) (-127) (-127) (-127) (-127) (-127) (-127) (-127) (-127) (-127) (-127)
				(-127) (-127) (-127) (-127) (-127) (-127) (-127) (-127) (-127) (-127) (-127) (-127) (-127) (-127) (-127) (-127)
				(-127) (-127) (-127) (-127) (-127) (-127) (-127) (-127) (-127) (-127) (-127) (-127) (-127) (-127) (-127) (-127)
				(-127) (-127) (-127) (-127) (-127) (-127) (-127) (-127) (-127) (-127) (-127) (-127) (-127) (-127) (-127) (-127)
				(-127) (-127) (-127) (-127) (-127) (-127) (-127) (-127) (-127) (-127) (-127) (-127) (-127) (-127) (-127) (-127)
				(-127) (-127) (-127) (-127) (-127) (-127) (-127) (-127) (-127) (-127) (-127) (-127) (-127) (-127) (-127) (-127)
				(-127) (-127) (-127) (-127) (-127) (-127) (-127) (-127) (-127) (-127) (-127) (-127) (-127) (-127) (-127) (-127)
				(-127) (-127) (-127) (-127) (-127) (-127) (-127) (-127) (-127) (-127) (-127) (-127) (-127) (-127) (-127) (-127)
				(-127) (-127) (-127) (-127) (-127) (-127) (-127) (-127) (-127) (-127) (-127) (-127) (-127) (-127) (-127) (-127)
				(-127) (-127) (-127) (-127) (-127) (-127) (-127) (-127) (-127) (-127) (-127) (-127) (-127) (-127) (-127) (-127)
				(-127) (-127) (-127) (-127)>;

			PS_Config_Diff_Test_Frame = <50>;
		};
	};
};
