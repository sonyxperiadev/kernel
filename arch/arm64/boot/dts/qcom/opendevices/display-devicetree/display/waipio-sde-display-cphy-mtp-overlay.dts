/dts-v1/;
/plugin/;

#include "waipio-sde-display-cphy-mtp.dtsi"

/ {
	model = "Qualcomm Technologies, Inc. Waipio MTP";
	compatible = "qcom,waipio-mtp", "qcom,waipio", "qcom,mtp";
	qcom,msm-id = <457 0x10000>, <482 0x10000>, <457 0x20000>, <482 0x20000>, <552 0x10000>;
	qcom,board-id = <0x03010008 0x03>, <0x04010008 0x04>;
};
