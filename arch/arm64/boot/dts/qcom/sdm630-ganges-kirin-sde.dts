/* Copyright (c) 2017, The Linux Foundation. All rights reserved.
 *
 * This program is free software; you can redistribute it and/or modify
 * it under the terms of the GNU General Public License version 2 and
 * only version 2 as published by the Free Software Foundation.
 *
 * This program is distributed in the hope that it will be useful,
 * but WITHOUT ANY WARRANTY; without even the implied warranty of
 * MERCHANTABILITY or FITNESS FOR A PARTICULAR PURPOSE.  See the
 * GNU General Public License for more details.
 */

/dts-v1/;

#include "sdm630.dtsi"
#include "sdm630-mtp.dtsi"
#include "sdm660-internal-codec.dtsi"
#include "sdm630-ganges-common.dtsi"
#include "sdm630-ganges-kirin-common.dtsi"
#include "sdm630-ganges-kirin-touch.dtsi"
#include "sdm630-ganges-kirin-camera.dtsi"
#include "sdm630-sde-overlay.dtsi"
#include "sdm630-ganges-common-display.dtsi"
#include "sdm630-ganges-common-display-sde.dtsi"

/ {
	model = "Sony Mobile Communications. kirin(sdm630)";
	compatible = "somc,kirin-row", "qcom,sdm630-mtp", "qcom,sdm630", "qcom,mtp";
	qcom,board-id = <8 1>;
	qcom,pmic-id = <0x0001001b 0x0101011a 0x0 0x0>,
			<0x0001001b 0x0201011a 0x0 0x0>;
};

&int_codec {
	qcom,model = "sdm660-snd-card-mtp";
};

&sde_dsi_nile_panels {
	qcom,dsi-panel = <&dsi_nt36672a_truly_fhdplus_video>;
};
