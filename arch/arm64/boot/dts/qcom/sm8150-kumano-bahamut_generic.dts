/* Copyright (c) 2017-2018, The Linux Foundation. All rights reserved.
 *
 * This program is free software; you can redistribute it and/or modify
 * it under the terms of the GNU General Public License version 2 and
 * only version 2 as published by the Free Software Foundation.
 *
 * This program is distributed in the hope that it will be useful,
 * but WITHOUT ANY WARRANTY; without even the implied warranty of
 * MERCHANTABILITY or FITNESS FOR A PARTICULAR PURPOSE.  See the
 * GNU General Public License for more details.
 */
/*
 * Copyright (C) 2018 Sony Mobile Communications Inc.
 *
 * This program is free software; you can redistribute it and/or modify
 * it under the terms of the GNU General Public License version 2, as
 * published by the Free Software Foundation.
 */

/dts-v1/;

#include "../qcom/sm8150.dtsi"
#include "../qcom/sm8150-mtp.dtsi"
#include "sm8150-kumano-bahamut_generic.dtsi"

/ {
	model = "Sony Mobile Communications Inc., Bahamut(SM8150 v1)";
	compatible = "somc,bahamut-generic", "qcom,sm8150", "qcom,mtp";
	qcom,board-id = <8 0>;
};
