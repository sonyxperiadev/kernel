#include "kalama-sg-hhg.dtsi"

&soc {
	nvme_vreg: nvme_vreg {
		compatible = "regulator-fixed";
		regulator-name = "nvme_vreg";
		gpio = <&pm8550_gpios 11 GPIO_ACTIVE_HIGH>;
		regulator-min-microvolt = <3300000>;
		regulator-max-microvolt = <3300000>;
		enable-active-high;
	};
};

&pcie1 {
	vreg-3p3-supply = <&nvme_vreg>;
	qcom,boot-option = <0x2>;
	qcom,apss-based-l1ss-sleep;
};

&regulator_ocp_notifier {
	/delete-property/ periph-ac1-supply;
	/delete-property/ periph-ac2-supply;
	/delete-property/ periph-ac3-supply;
	/delete-property/ periph-ac4-supply;
	/delete-property/ periph-ac5-supply;
	/delete-property/ periph-ac6-supply;
	/delete-property/ periph-ac7-supply;
	/delete-property/ periph-bc3-supply;
	/delete-property/ periph-bc4-supply;
	/delete-property/ periph-bc5-supply;
	/delete-property/ periph-bc6-supply;
	/delete-property/ periph-bc7-supply;
};
