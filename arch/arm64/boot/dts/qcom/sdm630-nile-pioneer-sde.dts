/dts-v1/;

#include "sdm630.dtsi"
#include "sdm630-mtp.dtsi"
#include "sdm660-internal-codec.dtsi"
#include "sdm630-nile-common.dtsi"
#include "sdm630-nile-pioneer-common.dtsi"
#include "sdm630-nile-pioneer_camera.dtsi"
#include "sdm630-nile-common-sde-overlay.dtsi"
#include "sdm630-nile-common-display.dtsi"
#include "sdm630-nile-common-display-sde.dtsi"

/ {
	model = "Qualcomm Technologies, Inc. SDM 630 PM660 + PM660L MTP";
	compatible = "qcom,sdm630-mtp", "qcom,sdm630", "qcom,mtp",
			"somc,nile", "somc,pioneer";
	qcom,board-id = <8 0>;
	qcom,pmic-id = <0x0001001b 0x0101011a 0x0 0x0>,
			<0x0001001b 0x0201011a 0x0 0x0>;
};

&tavil_snd {
	qcom,msm-mbhc-moist-cfg = <0>, <0>, <3>;
};

&dsi_panel_cmd_display{
       qcom,dsi-panel = <&dsi_td4322_truly_fhd_cmd>;
};
