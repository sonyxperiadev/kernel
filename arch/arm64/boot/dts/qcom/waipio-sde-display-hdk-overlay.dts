/dts-v1/;
/plugin/;

#include "waipio-sde-display-hdk.dtsi"

/{
	model = "Qualcomm Technologies, Inc. Waipio HDK";
	compatible = "qcom,waipiop-hdk", "qcom,waipiop", "qcom,hdk";
	qcom,msm-id = <482 0x10000>, <482 0x20000>;
	qcom,board-id = <0x1001f 0>;
};
