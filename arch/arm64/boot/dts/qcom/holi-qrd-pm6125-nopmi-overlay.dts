/dts-v1/;
/plugin/;

#include "holi-pm6125-overlay.dtsi"
#include "holi-regulators-pm6125.dtsi"
#include "holi-qrd-pm6125.dtsi"

/ {
	model = "Qualcomm Technologies, Inc. Holi QRD PM6125 NOPMI";
	compatible = "qcom,holi-qrd", "qcom,holi", "qcom,qrd";
	qcom,msm-id = <454 0x10000>, <472 0x10000>;
	qcom,board-id = <0xb 0>;
	qcom,pmic-id-size = <4>;
	qcom,pmic-id = <0x2D 0x0 0x0 0x0>;
};
