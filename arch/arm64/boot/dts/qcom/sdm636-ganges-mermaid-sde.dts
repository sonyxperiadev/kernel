/* Copyright (c) 2017, The Linux Foundation. All rights reserved.
 *
 * This program is free software; you can redistribute it and/or modify
 * it under the terms of the GNU General Public License version 2 and
 * only version 2 as published by the Free Software Foundation.
 *
 * This program is distributed in the hope that it will be useful,
 * but WITHOUT ANY WARRANTY; without even the implied warranty of
 * MERCHANTABILITY or FITNESS FOR A PARTICULAR PURPOSE.  See the
 * GNU General Public License for more details.
 */

/dts-v1/;

#include "sdm636.dtsi"
#include "sdm636-mtp.dtsi"
#include "sdm660-internal-codec.dtsi"
#include "sdm630-ganges-common.dtsi"
#include "sdm636-ganges-mermaid-common.dtsi"
#include "sdm636-ganges-mermaid-touch.dtsi"
#include "sdm636-ganges-mermaid-camera-sensor.dtsi"
#include "sdm660-sde-overlay.dtsi"
#include "sdm630-ganges-common-display.dtsi"
#include "sdm630-ganges-common-display-sde.dtsi"

/ {
	model = "Sony Mobile Communications. mermaid(sdm636)";
	compatible = "somc,mermaid-row", "qcom,sdm636-mtp", "qcom,sdm636", "qcom,mtp";
	qcom,board-id = <8 1>;
	qcom,pmic-id = <0x0001001b 0x0101011a 0x0 0x0>,
			<0x0001001b 0x0201011a 0x0 0x0>,
			<0x0001001b 0x0102001a 0x0 0x0>;
};

&int_codec {
	qcom,model = "sdm660-snd-card-mtp";
};

&dsi_panel_cmd_display {
        qcom,dsi-panel = <&dsi_nt36672a_tianma_fhdplus_video>;
};
