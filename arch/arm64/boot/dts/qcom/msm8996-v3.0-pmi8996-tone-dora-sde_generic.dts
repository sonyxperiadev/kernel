/* Copyright (c) 2015, The Linux Foundation. All rights reserved.
 *
 * This program is free software; you can redistribute it and/or modify
 * it under the terms of the GNU General Public License version 2 and
 * only version 2 as published by the Free Software Foundation.
 *
 * This program is distributed in the hope that it will be useful,
 * but WITHOUT ANY WARRANTY; without even the implied warranty of
 * MERCHANTABILITY or FITNESS FOR A PARTICULAR PURPOSE.  See the
 * GNU General Public License for more details.
 */
/*
 * Copyright (C) 2016 Sony Mobile Communications Inc.
 *
 * This program is free software; you can redistribute it and/or modify
 * it under the terms of the GNU General Public License version 2, as
 * published by the Free Software Foundation.
 */


/dts-v1/;

#include "msm8996-v3.0.dtsi"
#include "pmi8996.dtsi"
#include "msm8996-sde-overlay.dtsi"
#include "msm8996-mtp.dtsi"
#include "msm8996-tone-common.dtsi"
#include "msm8996-tone-common-sde-overlay.dtsi"
#include "msm8996-tone-dora-camera.dtsi"
#include "msm8996-tone-dora-common.dtsi"
#include "msm8996-tone-dora_generic.dtsi"
#include "dsi-panel-somc-dora.dtsi"
#include "dsi-panel-somc-dora-sde.dtsi"

/ {
	model = "SoMC Dora-ROW";
	compatible = "somc,dora-row", "qcom,msm8996";
	qcom,board-id = <8 0>;
};

&dsi_panel_cmd_display {
	qcom,dsi-panel = <&dsi_lgd_synaptics_cmd_8>;

	somc,dsi-panel-list =  <&dsi_auo_synaptics_cmd_4
				&dsi_jdi_synaptics_cmd_6
				&dsi_lgd_synaptics_cmd_8
				&dsi_sharp_synaptics_cmd_3
				&dsi_sharp_synaptics_cmd_9>;
};
