/dts-v1/;
/plugin/;

#include "kalama-v2-pinctrl.dtsi"
/ {
	model = "Qualcomm Technologies, Inc. Kalama";
	compatible = "qcom,kalama";
	qcom,msm-id = <519 0x20000>, <536 0x20000>;
	qcom,board-id = <0 0>;
};
