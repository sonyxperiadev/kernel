/* Copyright (c) 2017, The Linux Foundation. All rights reserved.
 *
 * This program is free software; you can redistribute it and/or modify
 * it under the terms of the GNU General Public License version 2 and
 * only version 2 as published by the Free Software Foundation.
 *
 * This program is distributed in the hope that it will be useful,
 * but WITHOUT ANY WARRANTY; without even the implied warranty of
 * MERCHANTABILITY or FITNESS FOR A PARTICULAR PURPOSE.  See the
 * GNU General Public License for more details.
 */

qcom,kirin_tdk_4297mv {
	qcom, = <24>;
	/* #3562570_Compal_BY36_2645mAh_averaged_MasterSlave_Jul16th2018*/
	somc,initial-capacity-uah = <2870000>;
	qcom,max-voltage-uv = <4297500>;
	qcom,fastchg-current-ma = <2484>;
	qcom,fg-cc-cv-threshold-mv = <4287>;
	qcom,nom-batt-capacity-mah = <2645>;
	qcom,batt-id-kohm = <15>;
	qcom,battery-beta = <4050>;
	qcom,battery-type = "1315-7714-2";
	qcom,checksum = <0x86B7>;
	qcom,gui-version = "PM660GUI - 0.0.0.45";
	qcom,fg-profile-data = [
		 C1 1F AD 05
		 1A 0A 73 FD
		 ED 1C A8 01
		 BE 04 64 03
		 9F 18 D3 22
		 B3 45 93 52
		 88 00 00 00
		 13 00 00 00
		 00 00 B7 BA
		 68 CC 41 AA
		 29 00 08 00
		 1D CA 4F E5
		 B7 FC F6 F2
		 91 F4 6C 0B
		 D3 FD C6 2B
		 1C 06 09 20
		 27 00 14 00
		 9A 1F D9 05
		 16 0A A2 06
		 9D 1C 5D 03
		 A6 15 72 12
		 73 18 08 2A
		 9E 4D E4 5B
		 68 00 00 00
		 0D 00 00 00
		 00 00 94 D5
		 0A CA 41 C3
		 20 00 00 00
		 52 00 4F E5
		 B7 06 E1 EB
		 42 ED 85 02
		 21 06 46 1A
		 99 33 CC FF
		 07 10 00 00
		 6B 0A C2 44
		 20 00 40 00
		 8F 01 0A FA
		 FF 00 00 00
		 00 00 00 00
		 00 00 00 00
		 00 00 00 00
		 00 00 00 00
		 00 00 00 00
		 00 00 00 00
		 00 00 00 00
		 00 00 00 00
		 00 00 00 00
		 00 00 00 00
		 00 00 00 00
		 00 00 00 00
		 00 00 00 00
		 00 00 00 00
		 00 00 00 00
		 00 00 00 00
		 00 00 00 00
		 00 00 00 00
	];

        somc,step-cfg = <
		(-2550) 50    0 4500    0 4200 1
		   50  120    0 4500  552 4200 2
		  120  250    0 4100 1932 4300 3
		  120  250 4100 4200 1380 4300 3
		  120  250 4200 4500 1104 4300 3
		  250  450    0 4150 2070 4300 3
		  250  450 4150 4200 1656 4300 3
		  250  450 4200 4500 1104 4300 3
		  450  550    0 4500  552 4200 4
		  550 2550    0 4500    0 4200 5
        >;
        somc,step-cell-impedance-mohm = <25>;
};
