/* Copyright (c) 2017, The Linux Foundation. All rights reserved.
 *
 * This program is free software; you can redistribute it and/or modify
 * it under the terms of the GNU General Public License version 2 and
 * only version 2 as published by the Free Software Foundation.
 *
 * This program is distributed in the hope that it will be useful,
 * but WITHOUT ANY WARRANTY; without even the implied warranty of
 * MERCHANTABILITY or FITNESS FOR A PARTICULAR PURPOSE.  See the
 * GNU General Public License for more details.
 */

qcom,kirin_tdk_4335mv {
	qcom, = <24>;
	/* #3562568_Compal_BY36_2695mAh_averaged_MasterSlave_Jul16th2018*/
	somc,initial-capacity-uah = <2870000>;
	qcom,max-voltage-uv = <4335000>;
	qcom,fastchg-current-ma = <2484>;
	qcom,fg-cc-cv-threshold-mv = <4325>;
	qcom,nom-batt-capacity-mah = <2695>;
	qcom,batt-id-kohm = <15>;
	qcom,battery-beta = <4050>;
	qcom,battery-type = "1315-7714-1";
	qcom,checksum = <0x765A>;
	qcom,gui-version = "PM660GUI - 0.0.0.45";
	qcom,fg-profile-data = [
		 39 20 30 05
		 79 0A 6F 06
		 FA 1C 07 FB
		 41 05 FE 02
		 8E 18 F7 22
		 83 45 DE 52
		 90 00 00 00
		 12 00 00 00
		 00 00 A3 BB
		 26 CC 0D A2
		 2A 00 08 00
		 46 D3 04 E5
		 D3 FC D3 F2
		 2D F5 7D 0B
		 E4 05 86 2B
		 1B 06 09 20
		 27 00 14 00
		 AB 1F C0 05
		 35 0A 8E 06
		 AC 1C 41 03
		 BB 15 65 12
		 78 18 0B 2A
		 99 4D EC 5B
		 68 00 00 00
		 0D 00 00 00
		 00 00 D2 D5
		 05 00 02 00
		 21 00 00 00
		 94 EA 04 E5
		 BD 06 EC EB
		 6F EC 40 02
		 25 06 C1 1A
		 99 33 CC FF
		 07 10 00 00
		 BF 0A 5C 45
		 21 00 40 00
		 8E 01 0A FA
		 FF 00 00 00
		 00 00 00 00
		 00 00 00 00
		 00 00 00 00
		 00 00 00 00
		 00 00 00 00
		 00 00 00 00
		 00 00 00 00
		 00 00 00 00
		 00 00 00 00
		 00 00 00 00
		 00 00 00 00
		 00 00 00 00
		 00 00 00 00
		 00 00 00 00
		 00 00 00 00
		 00 00 00 00
		 00 00 00 00
		 00 00 00 00
	];

	somc,step-cfg = <
		(-2550) 50    0 4500    0 4200 1
		   50  120    0 4500  552 4200 2
		  120  250    0 4100 1932 4335 3
		  120  250 4100 4200 1380 4335 3
		  120  250 4200 4300 1104 4335 3
		  120  250 4300 4500  828 4335 3
		  250  450    0 4150 2208 4335 3
		  250  450 4150 4200 1932 4335 3
		  250  450 4200 4300 1380 4335 3
		  250  450 4300 4500  828 4335 3
		  450  550    0 4500  552 4200 4
		  550 2550    0 4500    0 4200 5
	>;
	somc,step-cell-impedance-mohm = <25>;
};
