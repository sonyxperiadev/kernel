/* Copyright (c) 2019, The Linux Foundation. All rights reserved.
 *
 * This program is free software; you can redistribute it and/or modify
 * it under the terms of the GNU General Public License version 2 and
 * only version 2 as published by the Free Software Foundation.
 *
 * This program is distributed in the hope that it will be useful,
 * but WITHOUT ANY WARRANTY; without even the implied warranty of
 * MERCHANTABILITY or FITNESS FOR A PARTICULAR PURPOSE.  See the
 * GNU General Public License for more details.
 */

&dsi_td4322_innolux_fhd_cmd {
	somc,panel-colormgr-pcc-prof-avail;
	somc,mdss-dsi-pcc-force-cal;

	somc,mdss-dsi-pcc-enable;
	somc,mdss-dsi-pcc-table = <
		0x00 0x00 0x00 0xFF 0x00 0xFF 0x8000 0x8000 0x8000
		0x00 0x01 0x00 0xFF 0x00 0xFF 0x8000 0x8000 0x8000
		0x00 0x02 0x00 0xFF 0x00 0xFF 0x8000 0x8000 0x8000
		0x00 0x03 0x00 0xFF 0x00 0xFF 0x8000 0x8000 0x8000>;
};

&dsi_td4322_truly_fhd_cmd {
	somc,panel-colormgr-pcc-prof-avail;
	somc,mdss-dsi-pcc-force-cal;

	somc,mdss-dsi-pcc-enable;
	somc,mdss-dsi-pcc-table = <
		0x00 0x00 0x00 0xFF 0x00 0xFF 0x8000 0x8000 0x8000
		0x00 0x01 0x00 0xFF 0x00 0xFF 0x8000 0x8000 0x8000
		0x00 0x02 0x00 0xFF 0x00 0xFF 0x8000 0x8000 0x8000
		0x00 0x03 0x00 0xFF 0x00 0xFF 0x8000 0x8000 0x8000>;
};

&dsi_td4322_csot_fhd_cmd {
	somc,panel-colormgr-pcc-prof-avail;
	somc,mdss-dsi-pcc-force-cal;

	somc,mdss-dsi-pcc-enable;
	somc,mdss-dsi-pcc-table = <
		0x00 0x00 0x00 0xFF 0x00 0xFF 0x8000 0x8000 0x8000
		0x00 0x01 0x00 0xFF 0x00 0xFF 0x8000 0x8000 0x8000
		0x00 0x02 0x00 0xFF 0x00 0xFF 0x8000 0x8000 0x8000
		0x00 0x03 0x00 0xFF 0x00 0xFF 0x8000 0x8000 0x8000>;
};

&dsi_td4328_tianma_fhdplus_cmd {
	somc,panel-colormgr-pcc-prof-avail;
	somc,mdss-dsi-pcc-force-cal;

	somc,mdss-dsi-pcc-enable;
	somc,mdss-dsi-pcc-table = <
		0x00 0x00 0x00 0xFF 0x00 0xFF 0x8000 0x8000 0x8000
		0x00 0x01 0x00 0xFF 0x00 0xFF 0x8000 0x8000 0x8000
		0x00 0x02 0x00 0xFF 0x00 0xFF 0x8000 0x8000 0x8000
		0x00 0x03 0x00 0xFF 0x00 0xFF 0x8000 0x8000 0x8000>;
};
