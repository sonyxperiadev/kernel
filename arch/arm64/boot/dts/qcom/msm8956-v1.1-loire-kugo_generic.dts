/*
 * Copyright (c) 2015, The Linux Foundation. All rights reserved.
 *
 * This program is free software; you can redistribute it and/or modify
 * it under the terms of the GNU General Public License version 2 and
 * only version 2 as published by the Free Software Foundation.
 *
 * This program is distributed in the hope that it will be useful,
 * but WITHOUT ANY WARRANTY; without even the implied warranty of
 * MERCHANTABILITY or FITNESS FOR A PARTICULAR PURPOSE.  See the
 * GNU General Public License for more details.
 */
/*
 * Copyright (C) 2016 Sony Mobile Communications Inc.
 *
 * This program is free software; you can redistribute it and/or modify
 * it under the terms of the GNU General Public License version 2, as
 * published by the Free Software Foundation.
 */

/dts-v1/;
#include "msm8956-v1.1.dtsi"
#include "msm8956-mtp.dtsi"
#include "msm8956-loire-common.dtsi"
#include "msm8956-loire-kugo-common.dtsi"
#include "msm8956-loire-kugo_camera.dtsi"
#include "dsi-panel-somc-kugo.dtsi"

/ {
	model = "SoMC Kugo-ROW";
	compatible = "somc,kugo-row", "qcom,msm8956";
	qcom,board-id= <8 0>;
};
