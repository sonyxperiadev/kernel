/dts-v1/;
/plugin/;

#include <dt-bindings/clock/qcom,camcc-kalama.h>
#include <dt-bindings/clock/qcom,videocc-kalama.h>
#include <dt-bindings/clock/qcom,dispcc-kalama.h>

#include "kalama-mmrm-test-v2.dtsi"

/ {
	model = "Qualcomm Technologies, Inc. Kalama v2 SoC";
	compatible = "qcom,kalama";
	qcom,msm-id = <519 0x20000>, <536 0x20000>, <600 0x20000>, <601 0x20000>;
	qcom,board-id = <0 0>; /* required by merge_dtbs.py */
};
