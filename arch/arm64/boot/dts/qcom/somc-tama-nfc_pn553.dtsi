/* arch/arm64/boot/dts/somc/somc-tama-nfc_pn553.dtsi
 *
 * This program is free software; you can redistribute it and/or modify
 * it under the terms of the GNU General Public License version 2 and
 * only version 2 as published by the Free Software Foundation.
 *
 * This program is distributed in the hope that it will be useful,
 * but WITHOUT ANY WARRANTY; without even the implied warranty of
 * MERCHANTABILITY or FITNESS FOR A PARTICULAR PURPOSE.  See the
 * GNU General Public License for more details.
 */
/*
 * Copyright (C) 2017 Sony Mobile Communications Inc.
 *
 * This program is free software; you can redistribute it and/or modify
 * it under the terms of the GNU General Public License version 2, as
 * published by the Free Software Foundation.
 */

&qupv3_se10_i2c {
	nfc@28 {
		compatible = "nxp,pn553";
		reg = <0x28>;
		interrupt-parent = <&tlmm>;
		interrupts = <63 0x1>;
		nxp,irq_gpio = <&tlmm 63 0x00>;
		nxp,dwld_en = <&tlmm 62 0x00>;
		nxp,ven = <&tlmm 12 0x01>;
		qcom,clk-src = "BBCLK3";
		qcom,clk-gpio = <&pm8998_gpios 21 0x00>;
		clock-names = "nfc_clk";
		clocks = <&clock_rpmh RPMH_LN_BB_CLK3>;
	};
};

&soc {
	nfc,pm-ops {
		compatible = "sony,pn553-pm-ops";
	};
};
