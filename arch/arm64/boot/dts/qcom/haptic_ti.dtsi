&qupv3_se10_i2c {
	status = "ok";
	ti_haptic@5A{
		compatible = "ti,haptic";
		reg = < 0x5A >;
		ti,reset-gpio = <&tlmm 100 0>;
		ti,irq-gpio = <&tlmm 48 0>;
		ti,smart-loop = <0>; /* 0-closeloop, 1-openloop */
		ti,actuator = <1>; /* 0-ERM, 1-LRA */
		ti,rated-voltage = <280>;
		ti,odclamp-voltage = <320>;
		ti,lra-frequency = <235>; /* DON'T Care if ERM */
		status = "okay";
	};
};
