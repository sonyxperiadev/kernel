/dts-v1/;

#include "blair.dtsi"
#include "blair-mtp-usbc.dtsi"
#include "holi-mtp-pm7250b.dtsi"

/ {
	model = "Qualcomm Technologies, Inc. BLAIR MTP USBC audio";
	compatible = "qcom,blair-mtp", "qcom,blair", "qcom,mtp";
	qcom,board-id = <8 1>;
};

&pm7250b_charger {
	dpdm-supply = <&usb2_phy0>;
};
