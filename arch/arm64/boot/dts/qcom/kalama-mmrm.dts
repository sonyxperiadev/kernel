/dts-v1/;
/plugin/;

#include <dt-bindings/clock/qcom,camcc-kalama.h>
#include <dt-bindings/clock/qcom,videocc-kalama.h>
#include <dt-bindings/clock/qcom,dispcc-kalama.h>
#include "kalama-mmrm.dtsi"

/ {
	model = "Qualcomm Technologies, Inc. Kalama v1 SoC";
	compatible = "qcom,kalama";
	qcom,msm-id = <519 0x10000>, <536 0x10000>, <600 0x10000>, <601 0x10000>;
	qcom,board-id = <0 0>; /* required by merge_dtbs.py */
};
