/dts-v1/;
/plugin/;

#include <dt-bindings/interrupt-controller/arm-gic.h>
#include <dt-bindings/soc/qcom,ipcc.h>
#include <dt-bindings/interconnect/qcom,kalama.h>
#include <dt-bindings/clock/qcom,gcc-kalama.h>
#include <dt-bindings/clock/qcom,rpmh.h>
#include "kalama-ipa.dtsi"

/ {
	model = "Qualcomm Technologies, Inc. Kalama SOCs";
	compatible = "qcom,kalama";
	qcom,msm-id = <519 0x10000>, <519 0x20000>, <600 0x20000>;
	qcom,board-id = <0 0>;
};
