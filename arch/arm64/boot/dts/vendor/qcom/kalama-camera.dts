/dts-v1/;
/plugin/;

#include <dt-bindings/clock/qcom,gcc-kalama.h>
#include <dt-bindings/clock/qcom,camcc-kalama.h>
#include <dt-bindings/interconnect/qcom,kalama.h>
#include <dt-bindings/interrupt-controller/arm-gic.h>
#include <dt-bindings/regulator/qcom,rpmh-regulator-levels.h>

#include "kalama-camera.dtsi"
/ {
	model = "Qualcomm Technologies, Inc. Kalama v1 SoC";
	compatible = "qcom,kalama";
	qcom,msm-id = <519 0x10000>, <536 0x10000>;
	qcom,board-id = <0 0>;
};