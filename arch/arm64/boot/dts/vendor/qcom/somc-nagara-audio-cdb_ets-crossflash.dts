/dts-v1/;
/plugin/;

#include "waipio-audio-qrd.dtsi"
#include "somc-nagara-audio-common.dtsi"
#include "somc-nagara-audio-cdb.dtsi"
#include "somc-nagara-audio-ets.dtsi"

/ {
	model = "Sony Corporation. Nagara-CDB ETS Crossflash(WAIPIO QRD with PM8010)";
	compatible = "somc,nagara-cdb-ets", "qcom,waipio", "qcom,qrd";
	qcom,msm-id = <457 0x10000>, <482 0x10000>, <457 0x20000>, <482 0x20000>, <552 0x10000>;
	qcom,board-id = <0x1020B 0>;
};
