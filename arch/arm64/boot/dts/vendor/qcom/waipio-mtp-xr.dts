/dts-v1/;

#include "waipio-le.dtsi"
#include "waipio-mtp.dtsi"

/ {
	model = "Qualcomm Technologies, Inc. Waipio MTP with XR";
	compatible = "qcom,waipio-mtp", "qcom,waipio", "qcom,mtp";
	qcom,board-id = <0x10008 6>;
};
