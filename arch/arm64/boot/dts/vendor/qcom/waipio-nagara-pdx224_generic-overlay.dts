/dts-v1/;
/plugin/;

#include "waipio-qrd.dtsi"
#include "waipio-pm8010-spmi.dtsi"
#include "waipio-nagara-pdx224_generic.dtsi"

#include "somc-nagara-audio-pdx224.dts"
#include "waipio-camera-sensor-nagara-pdx224.dts"
#include "waipio-sde-display-pdx224-overlay.dts"

/ {
	model = "Sony Corporation. PDX-224(WAIPIO QRD with PM8010)";
	compatible = "somc,pdx224-generic", "qcom,waipio", "qcom,qrd";
	qcom,msm-id = <457 0x10000>, <482 0x10000>, <457 0x20000>, <482 0x20000>, <552 0x10000>;
	qcom,board-id = <0x1000b 0>;
};
