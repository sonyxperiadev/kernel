/dts-v1/;

#include "waipio-le.dtsi"
#include "waipio-mtp.dtsi"

/ {
	model = "Qualcomm Technologies, Inc. Waipio MTP XR with PCIE";
	compatible = "qcom,waipio-mtp", "qcom,waipio", "qcom,mtp";
	qcom,board-id = <0x10008 7>;
};
