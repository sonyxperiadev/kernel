/dts-v1/;
/plugin/;

#include "waipio-audio-cdp.dtsi"
 / {
	model = "Qualcomm Technologies, Inc. Waipio CDP";
	compatible = "qcom,waipio-cdp", "qcom,waipio", "qcom,cdp";
	qcom,msm-id = <457 0x10000>, <482 0x10000>, <457 0x20000>, <482 0x20000>, <552 0x10000>;
	qcom,board-id = <0x10001 0>, <0x02010001 0x2>;
};
