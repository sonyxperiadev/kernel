// SPDX-License-Identifier: BSD-3-Clause
/*
 * Copyright (c) 2023 Qualcomm Innovation Center, Inc. All rights reserved.
 */

/dts-v1/;
/plugin/;

#include <dt-bindings/clock/qcom,gcc-parrot.h>
#include <dt-bindings/clock/qcom,camcc-parrot.h>
#include <dt-bindings/interconnect/qcom,parrot.h>
#include <dt-bindings/interrupt-controller/arm-gic.h>
#include <dt-bindings/regulator/qcom,rpmh-regulator-levels.h>

#include "parrot-camera-sensor-qrd.dtsi"

/ {
	model = "Qualcomm Technologies, Inc. Parrot QRD";
	compatible = "qcom,parrot";
	qcom,msm-id = <537 0x10000>, <633 0x10000>, <634 0x10000>, <638 0x10000>;
	qcom,board-id = <0x1000B 0>, <0x1000B 1>, <0x1000B 0x600>, <0x1000B 0x601>;
};