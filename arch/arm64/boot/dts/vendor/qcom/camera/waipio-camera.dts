/dts-v1/;
/plugin/;

#include <dt-bindings/clock/qcom,gcc-waipio.h>
#include <dt-bindings/clock/qcom,camcc-waipio.h>
#include <dt-bindings/interconnect/qcom,waipio.h>
#include <dt-bindings/interrupt-controller/arm-gic.h>
#include <dt-bindings/regulator/qcom,rpmh-regulator-levels.h>

#include "waipio-camera.dtsi"
/ {
	model = "Qualcomm Technologies, Inc. Waipio v1 SoC";
	compatible = "qcom,waipio", "qcom,waipiop";
	qcom,msm-id = <457 0x10000>, <482 0x10000>, <457 0x20000>, <482 0x20000>, <552 0x10000>;
	qcom,board-id = <0 0>;
};
