/dts-v1/;
/plugin/;

#include "waipio-sde-display-qrd.dtsi"
#include "somc-nagara-display.dtsi"
#include "somc-nagara-display-cdb.dtsi"

/{
	model = "Sony Corporation. Nagara-CDB ETS Crossflash(Waipio QRD with PM8010)";
	compatible = "somc,nagara-cdb", "qcom,waipio", "qcom,qrd";
	qcom,msm-id = <457 0x10000>, <482 0x10000>, <457 0x20000>, <482 0x20000>, <552 0x10000>;
	qcom,board-id = <0x1020B 0>;
};
