/dts-v1/;
/plugin/;

#include "waipio-audio-atp.dtsi"
 / {
	model = "Qualcomm Technologies, Inc. Waipio ATP";
	compatible = "qcom,waipio", "qcom,waipio-atp", "qcom,atp";
	qcom,msm-id = <457 0x10000>, <482 0x10000>, <457 0x20000>, <482 0x20000>, <552 0x10000>;
	qcom,board-id = <0x10021 0>;
};
