/dts-v1/;

#include "parrot-4gb.dtsi"
#include "parrot-wcn6750.dtsi"
#include "parrot-idp-wcn6750-amoled-rcm-4gb.dtsi"
#include "parrot-idp-pm7250b.dtsi"

/ {
	model = "Qualcomm Technologies, Inc. Parrot WCN6750 IDP 4GB DDR + AMOLED + RCM";
	compatible = "qcom,parrot-idp", "qcom,parrot", "qcom,idp";
	qcom,board-id = <34 0x602>;
};
