// SPDX-License-Identifier: BSD-3-Clause
/*
 * Copyright (c) 2024 Qualcomm Innovation Center, Inc. All rights reserved.
 */

/dts-v1/;
/plugin/;

#include <dt-bindings/interrupt-controller/arm-gic.h>
#include <dt-bindings/soc/qcom,ipcc.h>
#include <dt-bindings/interconnect/qcom,pineapple.h>
#include <dt-bindings/clock/qcom,videocc-pineapple.h>
#include <dt-bindings/clock/qcom,gcc-pineapple.h>
#include <dt-bindings/arm/msm/qti-smmu-proxy-dt-ids.h>

#include "pineapple-eva.dtsi"

/ {
	model = "Qualcomm Technologies, Inc. pineapple v1,v2 SoC";
	compatible = "qcom,pineapple";
	qcom,msm-id = <557 0x10000>, <557 0x20000>;
	qcom,board-id = <0 0>, <15 0>, <8 0>, <11 0>, <1 0>;
};
