/dts-v1/;
/plugin/;

#include "waipio-audio-qrd.dtsi"
#include "somc-nagara-audio-common.dtsi"
#include "somc-nagara-audio-cdb.dtsi"

/ {
	model = "Sony Corporation. Nagara-CDB Crossflash(Waipio QRD with PM8010)";
	compatible = "somc,nagara-cdb", "qcom,waipio", "qcom,qrd";
	qcom,msm-id = <457 0x10000>, <482 0x10000>, <457 0x20000>, <482 0x20000>, <552 0x10000>;
	qcom,board-id =  <0x1010B 0>;
};
