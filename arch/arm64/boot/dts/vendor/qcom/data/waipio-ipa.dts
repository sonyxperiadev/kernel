/dts-v1/;
/plugin/;

#include <dt-bindings/interrupt-controller/arm-gic.h>
#include <dt-bindings/soc/qcom,ipcc.h>
#include <dt-bindings/interconnect/qcom,waipio.h>
#include <dt-bindings/clock/qcom,gcc-waipio.h>
#include <dt-bindings/clock/qcom,rpmh.h>

#include "waipio-ipa.dtsi"

/ {
	model = "Qualcomm Technologies, Inc. Waipio SoC";
	compatible = "qcom,waipio";
	qcom,msm-id = <457 0x10000>;
	qcom,board-id = <0 0>;
};
