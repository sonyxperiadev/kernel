&mdss_mdp {
	dsi_dual_rdp370f_fhd_vid: qcom,mdss_dsi_dual_rdp370f_fhd_video {
		qcom,mdss-dsi-panel-name = "RaonTech Non-FSC mode video mode dsi panel";
		qcom,mdss-dsi-panel-type = "dsi_video_mode";

		qcom,dsi-ctrl-num = <0 1>;
		qcom,dsi-phy-num = <0 1>;

		qcom,mdss-dsi-virtual-channel-id = <0>;
		qcom,mdss-dsi-stream = <0>;
		qcom,mdss-dsi-bpp = <24>;
		qcom,mdss-dsi-underflow-color = <0xff>;
		qcom,mdss-dsi-border-color = <0>;
		qcom,mdss-dsi-panel-peak-brightness = <4200000>;
		qcom,mdss-dsi-panel-blackness-level = <3230>;
		qcom,mdss-dsi-bllp-eof-power-mode;
		qcom,mdss-dsi-bllp-power-mode;
		qcom,mdss-dsi-lane-0-state;
		qcom,mdss-dsi-lane-1-state;
		qcom,mdss-dsi-lane-2-state;
		qcom,mdss-dsi-lane-3-state;
		qcom,mdss-dsi-dma-trigger = "trigger_sw";
		qcom,mdss-dsi-mdp-trigger = "none";
		qcom,mdss-dsi-reset-sequence = <0 10>, <1 10>;

		qcom,mdss-dsi-display-timings {
			timing@0 {
				cell-index = <0>;
				qcom,mdss-dsi-panel-width = <1920>;
				qcom,mdss-dsi-panel-height = <1080>;
				qcom,mdss-dsi-h-front-porch = <88>;
				qcom,mdss-dsi-h-back-porch = <148>;
				qcom,mdss-dsi-h-pulse-width = <44>;
				qcom,mdss-dsi-h-sync-skew = <0>;
				qcom,mdss-dsi-v-back-porch = <36>;
				qcom,mdss-dsi-v-front-porch = <4>;
				qcom,mdss-dsi-v-pulse-width = <5>;
				qcom,mdss-dsi-h-left-border = <0>;
				qcom,mdss-dsi-h-right-border = <0>;
				qcom,mdss-dsi-v-top-border = <0>;
				qcom,mdss-dsi-v-bottom-border = <0>;
				qcom,mdss-dsi-panel-framerate = <60>;
				qcom,mdss-dsi-on-command =
					[32 01 00 00 00 00 02 00 00];
				qcom,mdss-dsi-off-command =
					[22 01 00 00 00 00 02 00 00];
				qcom,mdss-dsi-on-command-state = "dsi_lp_mode";
				qcom,mdss-dsi-off-command-state = "dsi_lp_mode";
				qcom,mdss-dsi-h-sync-pulse = <0>;
			};
		};
	};
};
