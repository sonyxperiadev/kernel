/dts-v1/;

#include "parrot-4gb.dtsi"
#include "parrot-wcn6750.dtsi"
#include "parrot-qrd-wcn6750-4gb.dtsi"
#include "parrot-qrd-pm7250b.dtsi"

/ {
	model = "Qualcomm Technologies, Inc. Parrot WCN6750 QRD 4GB DDR";
	compatible = "qcom,parrot-qrd", "qcom,parrot", "qcom,qrd";
	qcom,board-id = <0x1000B 0x601>;
};
