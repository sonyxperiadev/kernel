// SPDX-License-Identifier: BSD-3-Clause
/*
 * Copyright (c) Qualcomm Technologies, Inc. and/or its subsidiaries.
 */

#include "parrot.dtsi"

&reserved_memory {
	/delete-node/ hyp_region@83600000;
	/delete-node/ hyp_region1@0x82200000;

	hyp_mem: hyp_region@80000000 {
		no-map;
		reg = <0x0 0x80000000 0x0 0x600000>;
	};
};
