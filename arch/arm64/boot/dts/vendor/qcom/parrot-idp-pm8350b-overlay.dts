/dts-v1/;
/plugin/;

#include "parrot-wcn6750.dtsi"
#include "parrot-idp.dtsi"
#include "parrot-idp-pm8350b.dtsi"

/ {
	model = "Qualcomm Technologies, Inc. Parrot IDP";
	compatible = "qcom,parrot-idp", "qcom,parrot", "qcom,idp";
	qcom,msm-id = <537 0x10000>, <583 0x10000>, <613 0x10000>;
	qcom,board-id = <34 0>;
};
