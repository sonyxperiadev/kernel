/dts-v1/;
/plugin/;

#include <dt-bindings/clock/qcom,gcc-kalama.h>
#include <dt-bindings/clock/qcom,camcc-kalama.h>
#include <dt-bindings/interconnect/qcom,kalama.h>
#include <dt-bindings/interrupt-controller/arm-gic.h>
#include <dt-bindings/regulator/qcom,rpmh-regulator-levels.h>

#include "kalama-camera-sensor-qrd.dtsi"
/ {
	model = "Qualcomm Technologies, Inc. Kalama QRD";
	compatible = "qcom,kalama-qrd", "qcom,kalama"
	qcom,msm-id = <519 0x10000>, <536 0x10000>;
	qcom,board-id = <0x1000B 0>;
};