/dts-v1/;
/plugin/;

#include "waipio-qrd.dtsi"
#include "waipio-pm8010-spmi.dtsi"
#include "waipio-nagara-cdb_ets.dtsi"

/ {
	model = "Sony Corporation. Nagara-CDB ETS(WAIPIO QRD with PM8010)";
	compatible = "somc,nagara-cdb-ets", "qcom,waipio", "qcom,qrd";
	qcom,msm-id = <457 0x10000>, <482 0x10000>, <457 0x20000>, <482 0x20000>, <552 0x10000>;
	qcom,board-id = <0x1000b 0>;
};
