/dts-v1/;
/plugin/;

#include <dt-bindings/soc/qcom,ipcc.h>
#include <dt-bindings/interrupt-controller/arm-gic.h>

#include "waipio-synx.dtsi"

/ {
	model = "Qualcomm Technologies, Inc. Waipio SoCs";
	compatible = "qcom,waipio", "qcom,waipiop";
	qcom,msm-id = <457 0x10000>, <482 0x10000>, <457 0x20000>, <482 0x20000>;
	qcom,board-id = <0 0>;
};
