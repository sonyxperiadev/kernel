/dts-v1/;

#include "waipio-lte.dtsi"
#include "waipio-qrd.dtsi"
#include "waipio-pm8010-spmi.dtsi"
#include "waipio-nagara-pdx224_ets.dtsi"

/ {
	model = "Sony Corporation. PDX-224 ETS(WAIPIO LTE QRD with PM8010)";
	compatible = "somc,pdx224-ets", "qcom,waipio", "qcom,qrd";
	qcom,board-id = <0x1000b 0>;
};
