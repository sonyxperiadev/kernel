// SPDX-License-Identifier: BSD-3-Clause
/*
 * Copyright (c) 2024 Qualcomm Innovation Center, Inc. All rights reserved.
 */

/dts-v1/;

#include "parrot.dtsi"
#include "parrot-qrd-wcn6750.dtsi"
#include "parrot-qrd-pm7250b.dtsi"

/ {
	model = "Qualcomm Technologies, Inc. Parrot WCN6750 QRD";
	compatible = "qcom,parrot-qrd", "qcom,parrot", "qcom,qrd";
	qcom,board-id = <0x1000B 1>;
};
