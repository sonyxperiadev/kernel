/dts-v1/;

#include "waipio.dtsi"
#include "waipio-qrd.dtsi"
#include "waipio-pm8010-spmi.dtsi"
#include "waipio-nagara-cdb.dtsi"

/ {
	model = "Sony Corporation. Nagara-CDB(Waipio QRD with PM8010)";
	compatible = "somc,nagara-cdb", "qcom,waipio", "qcom,qrd";
	qcom,board-id = <0x1000b 0>;
};
