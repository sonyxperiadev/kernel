/dts-v1/;
/plugin/;

#include "waipio-audio-hdk.dtsi"
 / {
	model = "Qualcomm Technologies, Inc. WaipioP HDK";
	compatible = "qcom,waipiop-qrd", "com,waipiop", "qcom,hdk";
	qcom,msm-id = <457 0x10000>, <482 0x10000>, <457 0x20000>, <482 0x20000>, <552 0x10000>;
	qcom,board-id = <0x1001f 0>;
};
