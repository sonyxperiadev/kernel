// SPDX-License-Identifier: BSD-3-Clause
/*
 * Copyright (c) 2024 Qualcomm Innovation Center, Inc. All rights reserved.
 */

#include "pineapple-vidc.dtsi"

/* Pineapple V2-specific changes */
&msm_vidc {
	compatible = "qcom,sm8650-vidc-v2";
};

