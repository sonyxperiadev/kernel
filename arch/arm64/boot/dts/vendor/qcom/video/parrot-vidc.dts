// SPDX-License-Identifier: BSD-3-Clause
/*
 * Copyright (c) 2024 Qualcomm Innovation Center, Inc. All rights reserved.
 */

/dts-v1/;
/plugin/;

#include <dt-bindings/interrupt-controller/arm-gic.h>
#include <dt-bindings/clock/qcom,gcc-parrot.h>
#include <dt-bindings/interconnect/qcom,parrot.h>
#include <dt-bindings/clock/qcom,videocc-parrot.h>
#include "parrot-vidc.dtsi"

/ {
	model = "Qualcomm Technologies, Inc. Parrot";
	compatible = "qcom,parrot";
	qcom,msm-id = <537 0x10000>, <583 0x10000>, <613 0x10000>, <631 0x10000>, <633 0x10000>, <634 0x10000>, <638 0x10000>, <663 0x10000>, <713 0x10000>, <714 0x10000>, <715 0x10000>;
	qcom,board-id = <0 0>, <0 0x600>;
};
