/dts-v1/;

#include "parrotp.dtsi"
#include "parrot-wcn6750.dtsi"
#include "parrotp-idp.dtsi"
#include "parrot-idp-pm8350b.dtsi"

/ {
	model = "Qualcomm Technologies, Inc. ParrotP IDP";
	compatible = "qcom,parrotp-idp", "qcom,parrotp", "qcom,idp";
	qcom,board-id = <34 0>;
};
