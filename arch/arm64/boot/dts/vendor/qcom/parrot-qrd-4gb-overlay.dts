/dts-v1/;
/plugin/;

#include "parrot-wcn3990.dtsi"
#include "parrot-qrd-4gb.dtsi"
#include "parrot-qrd-pm7250b.dtsi"

/ {
	model = "Qualcomm Technologies, Inc. Parrot QRD 4GB DDR";
	compatible = "qcom,parrot-qrd", "qcom,parrot", "qcom,qrd";
	qcom,msm-id = <537 0x10000>;
	qcom,board-id = <0x1000B 0x600>;
};
