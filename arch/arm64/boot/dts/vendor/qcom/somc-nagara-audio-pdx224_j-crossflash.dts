/dts-v1/;
/plugin/;

#include "waipio-audio-qrd.dtsi"
#include "somc-nagara-audio-common.dtsi"
#include "somc-nagara-audio-pdx224.dtsi"
#include "somc-nagara-audio-j.dtsi"

/ {
	model = "Sony Corporation. PDX-224 J Crossflash(WAIPIO QRD with PM8010)";
	compatible = "somc,pdx224-j", "qcom,waipio", "qcom,qrd";
	qcom,msm-id = <457 0x10000>, <482 0x10000>, <457 0x20000>, <482 0x20000>, <552 0x10000>;
	qcom,board-id = <0x1080B 0>;
};
