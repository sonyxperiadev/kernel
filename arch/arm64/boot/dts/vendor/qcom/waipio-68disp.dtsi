&soc {
};

&qupv3_se4_i2c {
	#address-cells = <1>;
	#size-cells = <0>;

	status = "ok";
	qcom,i2c-touch-active = "goodix,gt9916";

	goodix-berlin@5d {
		compatible = "goodix,gt9916";
		reg = <0x5d>;

		goodix,avdd-name = "avdd";
		goodix,iovdd-name = "iovdd";
		iovdd-supply = <&L8C>;
		avdd-supply = <&L3C>;

		interrupt-parent = <&tlmm>;
		interrupts = <21 0x2008>;
		goodix,reset-gpio = <&tlmm 20 0x00>;
		goodix,irq-gpio = <&tlmm 21 0x2008>;
		goodix,irq-flags = <2>;
		goodix,panel-max-x = <1080>;
		goodix,panel-max-y = <2400>;
		goodix,panel-max-w = <255>;
		goodix,panel-max-p = <4096>;
		goodix,firmware-name = "goodix_firmware_i2c.bin";
		goodix,config-name = "goodix_cfg_group_i2c.bin";
		invert_xy;
		pinctrl-names = "pmx_ts_active", "pmx_ts_suspend", "pmx_ts_release";
		pinctrl-0 = <&ts_active>;
		pinctrl-1 = <&ts_int_suspend &ts_reset_suspend>;
		pinctrl-2 = <&ts_release>;
	};
};

&qupv3_se4_spi {
	 status = "disabled";
};
