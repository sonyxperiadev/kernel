/dts-v1/;
/plugin/;

#include "waipio-mtp.dtsi"
#include "waipio-pm8010-spmi.dtsi"
/ {
	model = "Qualcomm Technologies, Inc. Waipio MTP with XR";
	compatible = "qcom,waipio-mtp", "qcom,waipio", "qcom,mtp";
	qcom,msm-id = <457 0x10000>;
	qcom,board-id = <0x10008 6>;
};

&soc {
};

&pcie1 {
	status = "disabled";
};
