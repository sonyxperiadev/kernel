/dts-v1/;

#include "waipio-le.dtsi"
#include "waipio-cdp.dtsi"

/ {
	model = "Qualcomm Technologies, Inc. Waipio CDP XR with PCIE";
	compatible = "qcom,waipio-cdp", "qcom,waipio", "qcom,cdp";
	qcom,board-id = <0x10001 4>;
};
