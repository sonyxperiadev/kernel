// SPDX-License-Identifier: BSD-3-Clause
/*
 * Copyright (c) 2022-2023 Qualcomm Innovation Center, Inc. All rights reserved.
 */

/dts-v1/;

#include "pineapple.dtsi"

/ {
	model = "Qualcomm Technologies, Inc. Pineapple SoC";
	compatible = "qcom,pineapple";
	qcom,board-id = <0 0>;
};
