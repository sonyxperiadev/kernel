// SPDX-License-Identifier: BSD-3-Clause
/*
 * Copyright (c) 2024 Qualcomm Innovation Center, Inc. All rights reserved.
 */

/dts-v1/;
/plugin/;

#include "parrot-wcn3990-bt.dtsi"

/ {
	model = "Qualcomm Technologies, Inc. Parrot SoC";
	compatible = "qcom,parrot";
	qcom,msm-id = <537 0x10000>, <583 0x10000>,
			<613 0x10000>, <631 0x10000>,
			<633 0x10000>, <634 0x10000>,
			<638 0x10000>, <663 0x10000>,
			<713 0x10000>, <714 0x10000>,
			<715 0x10000>;
	qcom,board-id = <33 0>, <34 1>, <34 3>, <34 0x601>, <34 0x603>, <0x1000B 0x600>, <0x1000B 0>;
};

