/* Copyright (c) Qualcomm Technologies, Inc. and/or its subsidiaries.
 * SPDX-License-Identifier: BSD-3-Clause-Clear
 */

/dts-v1/;
/plugin/;

#include <dt-bindings/clock/qcom,gcc-parrot.h>
#include <dt-bindings/interrupt-controller/arm-gic.h>
#include <dt-bindings/interconnect/qcom,parrot.h>
#include <dt-bindings/regulator/qcom,rpmh-regulator-levels.h>

#include "waipio-audio.dtsi"

/ {
	model = "Qualcomm Technologies, Inc. Parrot SoC";
	compatible = "qcom,parrot";
	qcom,msm-id = <537 0x10000>, <583 0x10000>, <613 0x10000>, <631 0x10000>,
			<633 0x10000>, <634 0x10000>, <638 0x10000>, <663 0x10000>,
			<713 0x10000>, <714 0x10000>, <715 0x10000>;
	qcom,board-id = <0 0>, <0 0x600>;
};
