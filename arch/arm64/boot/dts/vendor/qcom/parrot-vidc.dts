/dts-v1/;
/plugin/;

#include <dt-bindings/interrupt-controller/arm-gic.h>
#include <dt-bindings/clock/qcom,gcc-parrot.h>
#include <dt-bindings/interconnect/qcom,parrot.h>
#include <dt-bindings/clock/qcom,videocc-parrot.h>
#include "parrot-vidc.dtsi"

/ {
	model = "Qualcomm Technologies, Inc. Parrot";
	compatible = "qcom,parrot";
	qcom,msm-id = <537 0x10000>;
	qcom,board-id = <0 0>, <0 0x600>;
};
