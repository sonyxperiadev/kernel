// SPDX-License-Identifier: BSD-3-Clause
/*
 * Copyright (c) 2024 Qualcomm Innovation Center, Inc. All rights reserved.
 */

&soc {
	msm_mmrm: qcom,mmrm {
		compatible = "qcom,msm-mmrm", "qcom,pineapple-mmrm";
		status = "okay";

		/* MMRM clock threshold */
		mmrm-peak-threshold = <10000>;

		/* MM Rail info */
		mm-rail-corners = "lowsvs", "svs", "svsl1", "nom", "noml1", "turbo";
		mm-rail-fact-volt = <38929 40633 41944 44237 49349 49349>;

		/* Scaling factors */
		scaling-fact-dyn = <50856 55706 59638 66847 84804 84804>;
		scaling-fact-leak = <831718 890766 938410 1025967 1249903 1249903>;

		/* Client info */
		mmrm-client-info =
			<0x1 CAM_CC_IFE_0_CLK_SRC 25563894 315884 1>,
			<0x1 CAM_CC_IFE_1_CLK_SRC 25563894 315884 1>,
			<0x1 CAM_CC_IFE_2_CLK_SRC 25563894 315884 1>,
			<0x1 CAM_CC_CSID_CLK_SRC 2121415 56165 3>,
			<0x1 CAM_CC_SFE_0_CLK_SRC 23995177 352199 1>,
			<0x1 CAM_CC_SFE_1_CLK_SRC 23995177 352199 1>,
			<0x1 CAM_CC_SFE_2_CLK_SRC 23995177 352199 1>,
			<0x1 CAM_CC_IPE_NPS_CLK_SRC 76475209 874251 1>,
			<0x1 CAM_CC_BPS_CLK_SRC 39943309 67337 1>,
			<0x1 CAM_CC_IFE_LITE_CLK_SRC 1329704 29190 2>,
			<0x1 CAM_CC_JPEG_CLK_SRC 778295 18351 4>,
			<0x1 CAM_CC_CAMNOC_AXI_RT_CLK_SRC 8018836 158270 1>,
			<0x1 CAM_CC_IFE_LITE_CSID_CLK_SRC 238635 15257 2>,
			<0x1 CAM_CC_ICP_CLK_SRC 329148 7590 1>,

			<0x1 CAM_CC_CPHY_RX_CLK_SRC 19661 33247 10>,
			<0x1 CAM_CC_CSI0PHYTIMER_CLK_SRC 6554 5 1>,
			<0x1 CAM_CC_CSI1PHYTIMER_CLK_SRC 6554 5 1>,
			<0x1 CAM_CC_CSI2PHYTIMER_CLK_SRC 6554 5 1>,
			<0x1 CAM_CC_CSI3PHYTIMER_CLK_SRC 6554 5 1>,
			<0x1 CAM_CC_CSI4PHYTIMER_CLK_SRC 6554 5 1>,
			<0x1 CAM_CC_CSI5PHYTIMER_CLK_SRC 6554 5 1>,
			<0x1 CAM_CC_CSI6PHYTIMER_CLK_SRC 6554 5 1>,
			<0x1 CAM_CC_CSI7PHYTIMER_CLK_SRC 6554 5 1>,
			<0x1 CAM_CC_CCI_0_CLK_SRC 0 397 1>,
			<0x1 CAM_CC_CCI_1_CLK_SRC 0 397 1>,
			<0x1 CAM_CC_CCI_2_CLK_SRC 0 397 1>,
			<0x1 CAM_CC_SLOW_AHB_CLK_SRC 58983 11666 1>,
			<0x1 CAM_CC_FAST_AHB_CLK_SRC 32768 6492 1>,
			<0x1 CAM_CC_CRE_CLK_SRC 84182 1927 1>,

			<0x2 VIDEO_CC_MVS1_CLK_SRC 140136940 1283195 1>,
			<0x3 DISP_CC_MDSS_MDP_CLK_SRC 14273741 213648 1>,
			<0x3 DISP_CC_MDSS_DPTX0_LINK_CLK_SRC 707789 3572 1>,
			<0x4 VIDEO_CC_MVS0_CLK_SRC 41008497 1926104 1>;
	};
};
