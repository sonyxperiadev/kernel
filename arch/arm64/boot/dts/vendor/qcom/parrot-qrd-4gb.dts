/dts-v1/;

#include "parrot-4gb.dtsi"
#include "parrot-wcn3990.dtsi"
#include "parrot-qrd-4gb.dtsi"
#include "parrot-qrd-pm7250b.dtsi"

/ {
	model = "Qualcomm Technologies, Inc. Parrot QRD 4GB DDR";
	compatible = "qcom,parrot-qrd", "qcom,parrot", "qcom,qrd";
	qcom,board-id = <0x1000B 0x600>;
};
