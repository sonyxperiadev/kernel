/dts-v1/;
/plugin/;

#include "parrot-sde-display-idp-amoled.dtsi"

/ {
	model = "Qualcomm Technologies, Inc. Parrot IDP + AMOLED";
	compatible = "qcom,parrot-idp", "qcom,parrot", "qcom,idp";
	qcom,msm-id = <537 0x10000>;
	qcom,board-id = <34 2>, <34 3>, <34 4>, <34 0x602>, <34 0x603>, <34 0x604>;
};
