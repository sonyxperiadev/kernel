/dts-v1/;
/plugin/;

#include "parrot-sde-display-qrd.dtsi"

/{
	model = "Qualcomm Technologies, Inc. Parrot QRD";
	compatible = "qcom,parrot-qrd", "qcom,parrot", "qcom,qrd";
	qcom,msm-id = <537 0x10000>;
	qcom,board-id = <0x1000B 0>, <0x1000B 1>, <0x1000B 0x600>, <0x1000B 0x601>;
};
