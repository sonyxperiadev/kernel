&mdss_mdp {
	dsi_nt36672e_dsc_fhd_plus_60hz_video: qcom,mdss_dsi_nt36672e_dsc_fhd_plus_60hz_video {
		qcom,mdss-dsi-panel-name =
			"nt36672e lcd video mode dsi novatek panel with DSC";
		qcom,mdss-dsi-panel-type = "dsi_video_mode";
		qcom,dsi-ctrl-num = <0>;
		qcom,dsi-phy-num = <0>;
		qcom,mdss-dsi-virtual-channel-id = <0>;
		qcom,mdss-dsi-stream = <0>;
		qcom,mdss-dsi-bpp = <24>;
		qcom,mdss-dsi-border-color = <0>;
		qcom,mdss-dsi-traffic-mode = "burst_mode";
		qcom,mdss-dsi-bllp-power-mode;
		qcom,mdss-dsi-bllp-eof-power-mode;
		qcom,mdss-dsi-lane-0-state;
		qcom,mdss-dsi-lane-1-state;
		qcom,mdss-dsi-lane-2-state;
		qcom,mdss-dsi-lane-3-state;
		qcom,mdss-dsi-dma-trigger = "trigger_sw";
		qcom,mdss-dsi-mdp-trigger = "none";
		qcom,mdss-dsi-reset-sequence = <1 10>, <0 10>, <1 10>;
		qcom,mdss-dsi-tx-eot-append;
		qcom,adjust-timer-wakeup-ms = <1>;
		qcom,mdss-dsi-panel-hdr-enabled;
		qcom,mdss-dsi-panel-hdr-color-primaries = <39000 16000 33750
						 39800 13250 34450 7500 3000>;
		qcom,mdss-dsi-panel-peak-brightness = <6450000>;
		qcom,mdss-dsi-panel-blackness-level = <4961>;

		qcom,mdss-dsi-display-timings {
			timing@0 {
				cell-index = <0>;
				qcom,mdss-dsi-panel-width = <1080>;
				qcom,mdss-dsi-panel-height = <2408>;
				qcom,mdss-dsi-h-front-porch = <76>;
				qcom,mdss-dsi-h-back-porch = <56>;
				qcom,mdss-dsi-h-pulse-width = <12>;
				qcom,mdss-dsi-h-sync-skew = <0>;
				qcom,mdss-dsi-v-back-porch = <10>;
				qcom,mdss-dsi-v-front-porch = <46>;
				qcom,mdss-dsi-v-pulse-width = <10>;
				qcom,mdss-dsi-panel-framerate = <60>;
				qcom,mdss-dsi-on-command = [
					39 01 00 00 00 00 02 ff 10
					39 01 00 00 00 00 02 fb 01
					39 01 00 00 00 00 02 b0 00
					39 01 00 00 00 00 02 c0 03
					39 01 00 00 00 00 11 c1 89 28 00 08 00 aa 02 0e 00 2b 00 07 0d b7 0c b7
					39 01 00 00 00 00 03 c2 1b a0
					15 01 00 00 00 00 02 35 00   // enable TE
					39 01 00 00 00 00 02 ff 20
					39 01 00 00 00 00 02 fb 01
					39 01 00 00 00 00 02 01 66
					39 01 00 00 00 00 02 06 40
					39 01 00 00 00 00 02 07 38
					39 01 00 00 00 00 02 2f 83
					39 01 00 00 00 00 02 69 91
					39 01 00 00 00 00 02 95 d1
					39 01 00 00 00 00 02 96 d1
					39 01 00 00 00 00 02 f2 64
					39 01 00 00 00 00 02 f3 54
					39 01 00 00 00 00 02 f4 64
					39 01 00 00 00 00 02 f5 54
					39 01 00 00 00 00 02 f6 64
					39 01 00 00 00 00 02 f7 54
					39 01 00 00 00 00 02 f8 64
					39 01 00 00 00 00 02 f9 54
					39 01 00 00 00 00 02 ff 24
					39 01 00 00 00 00 02 fb 01
					39 01 00 00 00 00 02 01 0f
					39 01 00 00 00 00 02 03 0c
					39 01 00 00 00 00 02 05 1d
					39 01 00 00 00 00 02 08 2f
					39 01 00 00 00 00 02 09 2e
					39 01 00 00 00 00 02 0a 2d
					39 01 00 00 00 00 02 0b 2c
					39 01 00 00 00 00 02 11 17
					39 01 00 00 00 00 02 12 13
					39 01 00 00 00 00 02 13 15
					39 01 00 00 00 00 02 15 14
					39 01 00 00 00 00 02 16 16
					39 01 00 00 00 00 02 17 18
					39 01 00 00 00 00 02 1b 01
					39 01 00 00 00 00 02 1d 1d
					39 01 00 00 00 00 02 20 2f
					39 01 00 00 00 00 02 21 2e
					39 01 00 00 00 00 02 22 2d
					39 01 00 00 00 00 02 23 2c
					39 01 00 00 00 00 02 29 17
					39 01 00 00 00 00 02 2a 13
					39 01 00 00 00 00 02 2b 15
					39 01 00 00 00 00 02 2f 14
					39 01 00 00 00 00 02 30 16
					39 01 00 00 00 00 02 31 18
					39 01 00 00 00 00 02 32 04
					39 01 00 00 00 00 02 34 10
					39 01 00 00 00 00 02 35 1f
					39 01 00 00 00 00 02 36 1f
					39 01 00 00 00 00 02 4d 14
					39 01 00 00 00 00 02 4e 36
					39 01 00 00 00 00 02 4f 36
					39 01 00 00 00 00 02 53 36
					39 01 00 00 00 00 02 71 30
					39 01 00 00 00 00 02 79 11
					39 01 00 00 00 00 02 7a 82
					39 01 00 00 00 00 02 7b 8f
					39 01 00 00 00 00 02 7d 04
					39 01 00 00 00 00 02 80 04
					39 01 00 00 00 00 02 81 04
					39 01 00 00 00 00 02 82 13
					39 01 00 00 00 00 02 84 31
					39 01 00 00 00 00 02 85 00
					39 01 00 00 00 00 02 86 00
					39 01 00 00 00 00 02 87 00
					39 01 00 00 00 00 02 90 13
					39 01 00 00 00 00 02 92 31
					39 01 00 00 00 00 02 93 00
					39 01 00 00 00 00 02 94 00
					39 01 00 00 00 00 02 95 00
					39 01 00 00 00 00 02 9c f4
					39 01 00 00 00 00 02 9d 01
					39 01 00 00 00 00 02 a0 0f
					39 01 00 00 00 00 02 a2 0f
					39 01 00 00 00 00 02 a3 02
					39 01 00 00 00 00 02 a4 04
					39 01 00 00 00 00 02 a5 04
					39 01 00 00 00 00 02 c6 c0
					39 01 00 00 00 00 02 c9 00
					39 01 00 00 00 00 02 d9 80
					39 01 00 00 00 00 02 e9 02
					39 01 00 00 00 00 02 ff 25
					39 01 00 00 00 00 02 fb 01
					39 01 00 00 00 00 02 18 22
					39 01 00 00 00 00 02 19 e4
					39 01 00 00 00 00 02 21 40
					39 01 00 00 00 00 02 66 d8
					39 01 00 00 00 00 02 68 50
					39 01 00 00 00 00 02 69 10
					39 01 00 00 00 00 02 6b 00
					39 01 00 00 00 00 02 6d 0d
					39 01 00 00 00 00 02 6e 48
					39 01 00 00 00 00 02 72 41
					39 01 00 00 00 00 02 73 4a
					39 01 00 00 00 00 02 74 d0
					39 01 00 00 00 00 02 77 62
					39 01 00 00 00 00 02 79 7e
					39 01 00 00 00 00 02 7d 03
					39 01 00 00 00 00 02 7e 15
					39 01 00 00 00 00 02 7f 00
					39 01 00 00 00 00 02 84 4d
					39 01 00 00 00 00 02 cf 80
					39 01 00 00 00 00 02 d6 80
					39 01 00 00 00 00 02 d7 80
					39 01 00 00 00 00 02 ef 20
					39 01 00 00 00 00 02 f0 84
					39 01 00 00 00 00 02 ff 26
					39 01 00 00 00 00 02 fb 01
					39 01 00 00 00 00 02 81 0f
					39 01 00 00 00 00 02 83 01
					39 01 00 00 00 00 02 84 03
					39 01 00 00 00 00 02 85 01
					39 01 00 00 00 00 02 86 03
					39 01 00 00 00 00 02 87 01
					39 01 00 00 00 00 02 88 05
					39 01 00 00 00 00 02 8a 1a
					39 01 00 00 00 00 02 8b 11
					39 01 00 00 00 00 02 8c 24
					39 01 00 00 00 00 02 8e 42
					39 01 00 00 00 00 02 8f 11
					39 01 00 00 00 00 02 90 11
					39 01 00 00 00 00 02 91 11
					39 01 00 00 00 00 02 9a 80
					39 01 00 00 00 00 02 9b 04
					39 01 00 00 00 00 02 9c 00
					39 01 00 00 00 00 02 9d 00
					39 01 00 00 00 00 02 9e 00
					39 01 00 00 00 00 02 ff 27
					39 01 00 00 00 00 02 fb 01
					39 01 00 00 00 00 02 01 68
					39 01 00 00 00 00 02 20 81
					39 01 00 00 00 00 02 21 6a
					39 01 00 00 00 00 02 25 81
					39 01 00 00 00 00 02 26 94
					39 01 00 00 00 00 02 6e 00
					39 01 00 00 00 00 02 6f 00
					39 01 00 00 00 00 02 70 00
					39 01 00 00 00 00 02 71 00
					39 01 00 00 00 00 02 72 00
					39 01 00 00 00 00 02 75 00
					39 01 00 00 00 00 02 76 00
					39 01 00 00 00 00 02 77 00
					39 01 00 00 00 00 02 7d 09
					39 01 00 00 00 00 02 7e 67
					39 01 00 00 00 00 02 80 23
					39 01 00 00 00 00 02 82 09
					39 01 00 00 00 00 02 83 67
					39 01 00 00 00 00 02 88 01
					39 01 00 00 00 00 02 89 10
					39 01 00 00 00 00 02 a5 10
					39 01 00 00 00 00 02 a6 23
					39 01 00 00 00 00 02 a7 01
					39 01 00 00 00 00 02 b6 40
					39 01 00 00 00 00 02 e5 02
					39 01 00 00 00 00 02 e6 d3
					39 01 00 00 00 00 02 eb 03
					39 01 00 00 00 00 02 ec 28
					39 01 00 00 00 00 02 ff 2a
					39 01 00 00 00 00 02 fb 01
					39 01 00 00 00 00 02 00 91
					39 01 00 00 00 00 02 03 20
					39 01 00 00 00 00 02 07 50
					39 01 00 00 00 00 02 0a 70
					39 01 00 00 00 00 02 0c 04
					39 01 00 00 00 00 02 0d 40
					39 01 00 00 00 00 02 0f 01
					39 01 00 00 00 00 02 11 e0
					39 01 00 00 00 00 02 15 0f
					39 01 00 00 00 00 02 16 a4
					39 01 00 00 00 00 02 19 0f
					39 01 00 00 00 00 02 1a 78
					39 01 00 00 00 00 02 1b 23
					39 01 00 00 00 00 02 1d 36
					39 01 00 00 00 00 02 1e 3e
					39 01 00 00 00 00 02 1f 3e
					39 01 00 00 00 00 02 20 3e
					39 01 00 00 00 00 02 28 fd
					39 01 00 00 00 00 02 29 12
					39 01 00 00 00 00 02 2a e1
					39 01 00 00 00 00 02 2d 0a
					39 01 00 00 00 00 02 30 49
					39 01 00 00 00 00 02 33 96
					39 01 00 00 00 00 02 34 ff
					39 01 00 00 00 00 02 35 40
					39 01 00 00 00 00 02 36 de
					39 01 00 00 00 00 02 37 f9
					39 01 00 00 00 00 02 38 45
					39 01 00 00 00 00 02 39 d9
					39 01 00 00 00 00 02 3a 49
					39 01 00 00 00 00 02 4a f0
					39 01 00 00 00 00 02 7a 09
					39 01 00 00 00 00 02 7b 40
					39 01 00 00 00 00 02 7f f0
					39 01 00 00 00 00 02 83 0f
					39 01 00 00 00 00 02 84 a4
					39 01 00 00 00 00 02 87 0f
					39 01 00 00 00 00 02 88 78
					39 01 00 00 00 00 02 89 23
					39 01 00 00 00 00 02 8b 36
					39 01 00 00 00 00 02 8c 7d
					39 01 00 00 00 00 02 8d 7d
					39 01 00 00 00 00 02 8e 7d
					39 01 00 00 00 00 02 ff 20
					39 01 00 00 00 00 02 fb 01
					39 01 00 00 00 00 11 b0 00 00 00 17 00 49 00 6a 00 89 00 9f 00 b6 00 c8
					39 01 00 00 00 00 11 b1 00 d9 01 10 01 3a 01 7a 01 a9 01 f2 02 2d 02 2e
					39 01 00 00 00 00 11 b2 02 64 02 a3 02 ca 03 00 03 1e 03 4a 03 59 03 6a
					39 01 00 00 00 00 0f b3 03 7d 03 93 03 ab 03 c8 03 ec 03 fe 00 00
					39 01 00 00 00 00 11 b4 00 00 00 1b 00 51 00 71 00 90 00 a7 00 bf 00 d1
					39 01 00 00 00 00 11 b5 00 e2 01 1a 01 43 01 83 01 b2 01 fa 02 34 02 36
					39 01 00 00 00 00 11 b6 02 6b 02 a8 02 d0 03 03 03 21 03 4d 03 5b 03 6b
					39 01 00 00 00 00 0f b7 03 7e 03 94 03 ac 03 c8 03 ec 03 fe 00 00
					39 01 00 00 00 00 11 b8 00 00 00 1b 00 51 00 72 00 92 00 a8 00 bf 00 d1
					39 01 00 00 00 00 11 b9 00 e2 01 18 01 42 01 81 01 af 01 f5 02 2f 02 31
					39 01 00 00 00 00 11 ba 02 68 02 a6 02 cd 03 01 03 1f 03 4a 03 59 03 6a
					39 01 00 00 00 00 0f bb 03 7d 03 93 03 ab 03 c8 03 ec 03 fe 00 00
					39 01 00 00 00 00 02 ff 21
					39 01 00 00 00 00 02 fb 01
					39 01 00 00 00 00 11 b0 00 00 00 17 00 49 00 6a 00 89 00 9f 00 b6 00 c8
					39 01 00 00 00 00 11 b1 00 d9 01 10 01 3a 01 7a 01 a9 01 f2 02 2d 02 2e
					39 01 00 00 00 00 11 b2 02 64 02 a3 02 ca 03 00 03 1e 03 4a 03 59 03 6a
					39 01 00 00 00 00 0f b3 03 7d 03 93 03 ab 03 c8 03 ec 03 fe 00 00
					39 01 00 00 00 00 11 b4 00 00 00 1b 00 51 00 71 00 90 00 a7 00 bf 00 d1
					39 01 00 00 00 00 11 b5 00 e2 01 1a 01 43 01 83 01 b2 01 fa 02 34 02 36
					39 01 00 00 00 00 11 b6 02 6b 02 a8 02 d0 03 03 03 21 03 4d 03 5b 03 6b
					39 01 00 00 00 00 0f b7 03 7e 03 94 03 ac 03 c8 03 ec 03 fe 00 00
					39 01 00 00 00 00 11 b8 00 00 00 1b 00 51 00 72 00 92 00 a8 00 bf 00 d1
					39 01 00 00 00 00 11 b9 00 e2 01 18 01 42 01 81 01 af 01 f5 02 2f 02 31
					39 01 00 00 00 00 11 ba 02 68 02 a6 02 cd 03 01 03 1f 03 4a 03 59 03 6a
					39 01 00 00 00 00 0f bb 03 7d 03 93 03 ab 03 c8 03 ec 03 fe 00 00
					39 01 00 00 00 00 02 ff 2c
					39 01 00 00 00 00 02 fb 01
					39 01 00 00 00 00 02 61 1f
					39 01 00 00 00 00 02 62 1f
					39 01 00 00 00 00 02 7e 03
					39 01 00 00 00 00 02 6a 14
					39 01 00 00 00 00 02 6b 36
					39 01 00 00 00 00 02 6c 36
					39 01 00 00 00 00 02 6d 36
					39 01 00 00 00 00 02 53 04
					39 01 00 00 00 00 02 54 04
					39 01 00 00 00 00 02 55 04
					39 01 00 00 00 00 02 56 0f
					39 01 00 00 00 00 02 58 0f
					39 01 00 00 00 00 02 59 0f
					39 01 00 00 00 00 02 ff f0
					39 01 00 00 00 00 02 fb 01
					39 01 00 00 00 00 02 5a 00
					39 01 00 00 00 00 02 ff 10
					05 01 00 00 78 00 01 11
					05 01 00 00 64 00 01 29
				];
				qcom,mdss-dsi-on-command-state = "dsi_lp_mode";
				qcom,mdss-dsi-off-command = [
					05 01 00 00 10 00 01 28
					05 01 00 00 32 00 01 10
				];
				qcom,mdss-dsi-off-command-state = "dsi_lp_mode";
				qcom,compression-mode = "dsc";
				qcom,mdss-dsc-slice-height = <8>;
				qcom,mdss-dsc-slice-width = <540>;
				qcom,mdss-dsc-slice-per-pkt = <1>;
				qcom,mdss-dsc-bit-per-component = <8>;
				qcom,mdss-dsc-bit-per-pixel = <8>;
				qcom,mdss-dsc-block-prediction-enable;
			};
		};
	};
};
