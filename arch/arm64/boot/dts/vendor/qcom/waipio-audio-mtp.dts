/dts-v1/;
/plugin/;

#include "waipio-audio-mtp.dtsi"
 / {
	model = "Qualcomm Technologies, Inc. Waipio MTP";
	compatible = "qcom,waipio";
	qcom,msm-id = <457 0x10000>, <482 0x10000>, <457 0x20000>, <482 0x20000>, <552 0x10000>;
	qcom,board-id = <0x10008 0>, <0x02010008 0>, <0x03010008 0x03>, <0x04010008 0x04>;
};
