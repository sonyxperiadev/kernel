/dts-v1/;
/plugin/;

#include "../qcom/parrot-qrd.dtsi"
#include "../qcom/parrot-qrd-pm7250b.dtsi"
#include "../qcom/wlan/parrot-wcn3990.dtsi"
#include "parrot-columbia-pdx246_generic.dtsi"

/ {
	model = "Sony Corporation. PDX-246(Parrot QRD)";
	compatible = "somc,pdx246-generic", "qcom,parrot-qrd",
			"qcom,parrot", "qcom,qrd";
	qcom,msm-id = <537 0x10000>;
	qcom,board-id = <0x1000B 0>;
};
