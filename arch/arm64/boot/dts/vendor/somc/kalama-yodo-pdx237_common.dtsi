#include "kalama-yodo-common.dtsi"

&soc {
};

/* GPIO_159 : NC */
 /* Follow QC */

/* GPIO_160 : NC */
 /* Follow QC */

/* GPIO_161 : NC */
 /* Follow QC */

/* GPIO_186 : CS35L45_GPIO3 */
 /* Don't set here */

#include "somc-yodo-audio-common.dtsi"
#include "somc-yodo-audio-pdx237.dtsi"
#include "somc-yodo-charger-common.dtsi"
#include "somc-yodo-charger-pdx237.dtsi"
#include "somc-yodo-display.dtsi"
#include "somc-yodo-display-pdx237.dtsi"
#include "somc-yodo-touchscreen-pdx237.dtsi"
