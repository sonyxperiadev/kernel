#include <dt-bindings/gpio/gpio.h>
#include <dt-bindings/input/input.h>

#include <dt-bindings/pinctrl/qcom,pmic-gpio.h>
#include <dt-bindings/regulator/qcom,rpmh-regulator-levels.h>

&soc {

	somc_pinctrl: somc_pinctrl {
		compatible = "somc-pinctrl";
		pinctrl-names = "platform_common_default",
				"product_common_default",
				"variant_default";
		pinctrl-0 = <&sm_gpio_0 &sm_gpio_1 &sm_gpio_2 &sm_gpio_3 &sm_gpio_4
			     &sm_gpio_5 &sm_gpio_6 &sm_gpio_7 &sm_gpio_8 &sm_gpio_9
			     &sm_gpio_10 &sm_gpio_11 &sm_gpio_12 &sm_gpio_13 &sm_gpio_14
			     &sm_gpio_15 &sm_gpio_20 &sm_gpio_21 &sm_gpio_22 &sm_gpio_23
			     &sm_gpio_28 &sm_gpio_46 &sm_gpio_48 &sm_gpio_49 &sm_gpio_50
			     &sm_gpio_51 &sm_gpio_52 &sm_gpio_53 &sm_gpio_54 &sm_gpio_55
			     /*&sm_gpio_56 &sm_gpio_57*/ &sm_gpio_58 &sm_gpio_59 /*&sm_gpio_60*/
			     /* &sm_gpio_61 &sm_gpio_62 &sm_gpio_63*/ &sm_gpio_64 &sm_gpio_65
			     &sm_gpio_66 &sm_gpio_67 &sm_gpio_68 &sm_gpio_69 &sm_gpio_70
			     &sm_gpio_71 &sm_gpio_72 &sm_gpio_73 &sm_gpio_75 &sm_gpio_77
			     &sm_gpio_78 &sm_gpio_79 &sm_gpio_81 &sm_gpio_82 &sm_gpio_83
			     /*&sm_gpio_84*/ &sm_gpio_85 /*&sm_gpio_86*/ &sm_gpio_87 &sm_gpio_88
			     &sm_gpio_89 &sm_gpio_90 &sm_gpio_91 &sm_gpio_92 &sm_gpio_93
			     &sm_gpio_97 &sm_gpio_98 &sm_gpio_99 &sm_gpio_100 &sm_gpio_101
			     &sm_gpio_102 &sm_gpio_103 &sm_gpio_104 &sm_gpio_105 &sm_gpio_106
			     &sm_gpio_108 &sm_gpio_109 &sm_gpio_110 &sm_gpio_111 &sm_gpio_112
			     &sm_gpio_113 &sm_gpio_114 &sm_gpio_115 &sm_gpio_116 &sm_gpio_117
			     &sm_gpio_118 &sm_gpio_119 &sm_gpio_120 /*&sm_gpio_121 &sm_gpio_122*/
			     /*&sm_gpio_123*/ &sm_gpio_124 &sm_gpio_125 &sm_gpio_126 &sm_gpio_127
			     &sm_gpio_128 &sm_gpio_129 /*&sm_gpio_133*/ &sm_gpio_137 &sm_gpio_144
			     &sm_gpio_151 &sm_gpio_153 &sm_gpio_155 /*&sm_gpio_161 &sm_gpio_162*/
			     &sm_gpio_163 &sm_gpio_164 &sm_gpio_182 &sm_gpio_183 &sm_gpio_188
			     &sm_gpio_189 &sm_gpio_200 &sm_gpio_201 &sm_gpio_206 &sm_gpio_207
			     &sm_gpio_208 &sm_gpio_209>;

		/* If product common default setting is needed,
		fill pinctrl-1 value in <product>_common.dtsi */
		pinctrl-1 = <>;

		/* If variant specific default setting is needed,
		fill pinctrl-2 value in <variant>.dtsi */
		pinctrl-2 = <>;
	};

	somc_pinctrl_pmic: somc_pinctrl_pmic {
		compatible = "somc-pinctrl-pmic";
		pinctrl-names = "platform_common_default",
				"product_common_default",
				"variant_default";

		pinctrl-0 = <&pmk8550_gpio_1 &pmk8550_gpio_2 &pmk8550_gpio_5 &pm8550_gpio_1
			     &pm8550_gpio_2 &pm8550_gpio_3 /*&pm8550_gpio_6*/ &pm8550_gpio_9
			     &pm8550_gpio_11 /*&pm8550_gpio_12*/ &pm8550b_gpio_1 &pm8550b_gpio_2
			     &pm8550b_gpio_3 &pm8550b_gpio_4 &pm8550b_gpio_5 &pm8550b_gpio_6
			     /*&pm8550b_gpio_7 &pm8550b_gpio_8*/ &pm8550b_gpio_9 &pm8550b_gpio_10
			     &pm8550b_gpio_12 &pm8550vs_c_gpio_4 &pm8550vs_c_gpio_5 &pm8550vs_c_gpio_6
			     &pm8550vs_d_gpio_4 &pm8550vs_e_gpio_4 &pm8550vs_e_gpio_5 &pm8550vs_e_gpio_6
			     /*&pm8550vs_g_gpio_4*/ &pm8550vs_g_gpio_6 &pm8550ve_gpio_4 &pm8550ve_gpio_5
			     &pm8550ve_gpio_6 &pm8550ve_gpio_7 &pm8550ve_gpio_8>;

		/* If product common PMIC default setting is needed,
		fill pinctrl-1 value in <product>_common.dtsi */
		pinctrl-1 = <>;

		/* If variant specific PMIC default setting is needed,
		fill pinctrl-2 value in <variant>.dtsi */
		pinctrl-2 = <>;
	};

	last_logs@ffcc0000 {
		compatible = "rd_last_logs";
		label = "last_logs";
		memory-region = "log";
	};
	egistec_fp {
		status = "ok";
		compatible = "fp-egistec";
		egistec,gpio_reset = <&tlmm 89 0x00>;			// reset gpio pin num
		egistec,gpio_irq = <&tlmm 92 0x00>;			// irq gpio pin num
		egistec,gpio_vcc_en= <&pm8550_gpios 9 0x00>;		// vcc enable gpio pin num
		fp-ctrl-power;						// enable power control
		fp-gpio-vcc-enable;					// use gpio enable power or not
		fp-gpio-ext-ldo;					// yodo use regulator pm_humu_bob1
		pinctrl-names = "egis_rst_high", "egis_rst_low", "egis_vcc_high", "egis_vcc_low", "egis_irq_active", "egis_irq_low";
		pinctrl-0 = <&EGIS_RST_active>;
		pinctrl-1 = <&EGIS_RST_sleep>;
		pinctrl-2 = <&EGIS_VCC_active>;
		pinctrl-3 = <&EGIS_VCC_sleep>;
		pinctrl-4 = <&sm_gpio_92_input_pull_up>;
		pinctrl-5 = <&sm_gpio_92>;
		vcc_fp-supply = <&pm_humu_bob1>;
		egis-fp,vcc-voltage = <3400000 3800000>;
		egis-fp,vcc-current = <1000000>;
		egis-fp,vcc-max-voltage = <3960000>;
	};
};

&tlmm {
	EGIS_RST_active: EGIS_RST_active {
		mux {
			pins = "gpio89";
			function = "gpio";
		};

		config {
			pins = "gpio89";
			drive-strength = <2>;
			bias-disable;
			output-high;
		};
	};

	EGIS_RST_sleep: EGIS_RST_sleep {
		mux {
			pins = "gpio89";
			function = "gpio";
		};

		config {
			pins = "gpio89";
			drive-strength = <2>;
			bias-disable;
			output-low;
		};
	};
};

&pm8550_gpios {
	EGIS_VCC_active: EGIS_VCC_active {
		pins = "gpio9";
		function = "normal";
		output-high;
		drive-push-pull; /* Digital Out */
		qcom,drive-strength = <PMIC_GPIO_STRENGTH_LOW>;
		power-source = <1>;
	};

	EGIS_VCC_sleep: EGIS_VCC_sleep {
		pins = "gpio9";
		function = "normal";
		output-low;
		drive-push-pull; /* Digital Out */
		qcom,drive-strength = <PMIC_GPIO_STRENGTH_LOW>;
		power-source = <1>;
	};
};

/* TS_I2C */
&qupv3_se4_i2c {
	pinctrl-0 = <&sm_gpio_48 &sm_gpio_49>;
	pinctrl-1 = <&sm_gpio_48_suspend &sm_gpio_49_suspend>;
	qcom,clk-freq-out = <400000>;
	status = "okay";
};

/* APPS_I2C_0 */
&qupv3_hub_i2c4 {
	pinctrl-0 = <&sm_gpio_72 &sm_gpio_73>;
	pinctrl-1 = <&sm_gpio_72_suspend &sm_gpio_73_suspend>;
	qcom,clk-freq-out = <400000>;
	status = "okay";
};

&pm_humu_bob1 {
	regulator-min-microvolt = <3400000>;
	qcom,init-voltage = <3400000>;
	status = "okay";
};

&pm_humu_l2 {
	regulator-min-microvolt = <3300000>;
	regulator-max-microvolt = <3300000>;
	qcom,init-voltage = <3300000>;
	status = "okay";
};

&pm_humu_l10 {
	status = "disabled";
};

&pm_humu_l11 {
	status = "disabled";
};

&pm_humu_l14 {
	qcom,regulator-type = <0>;      /* LDO */
	regulator-min-microvolt = <3300000>;
	regulator-max-microvolt = <3300000>;
	qcom,init-voltage = <3300000>;
	status = "okay";
};

&pm8010m_l1 {
	regulator-min-microvolt = <870000>;      /* LDO */
	regulator-max-microvolt = <870000>;
	qcom,init-voltage = <870000>;
	status = "okay";
};

&pm8010m_l2 {
	regulator-min-microvolt = <1050000>;
	regulator-max-microvolt = <1050000>;
	qcom,init-voltage = <1050000>;
	status = "okay";
};

&pm8010m_l3 {
	regulator-min-microvolt = <2800000>;
	regulator-max-microvolt = <2800000>;
	qcom,init-voltage = <2800000>;
	status = "okay";
};

&pm8010m_l4 {
	status = "disabled";
};

&pm8010m_l5 {
	regulator-min-microvolt = <1800000>;
	regulator-max-microvolt = <1800000>;
	qcom,init-voltage = <1800000>;
	status = "okay";
};

&pm8010m_l6 {
	regulator-min-microvolt = <2800000>;
	regulator-max-microvolt = <2800000>;
	qcom,init-voltage = <2800000>;
	status = "okay";
};

&pm8010m_l7 {
	status = "disabled";
};

&pm8010n_l1 {
	regulator-min-microvolt = <810000>;      /* LDO */
	regulator-max-microvolt = <810000>;
	qcom,init-voltage = <810000>;
	status = "okay";
};

&pm8010n_l2 {
	regulator-min-microvolt = <900000>;
	regulator-max-microvolt = <900000>;
	qcom,init-voltage = <900000>;
	status = "okay";
};

&pm8010n_l3 {
	regulator-min-microvolt = <2800000>;
	regulator-max-microvolt = <2800000>;
	qcom,init-voltage = <2800000>;
	status = "okay";
};

&pm8010n_l4 {
	regulator-min-microvolt = <2800000>;
	regulator-max-microvolt = <2800000>;
	qcom,init-voltage = <2800000>;
	status = "okay";
};

&pm8010n_l5 {
	regulator-min-microvolt = <2800000>;
	regulator-max-microvolt = <2800000>;
	qcom,init-voltage = <2800000>;
	status = "okay";
};

&pm8010n_l6 {
	regulator-min-microvolt = <2800000>;
	regulator-max-microvolt = <2800000>;
	qcom,init-voltage = <2800000>;
	status = "okay";
};

&pm8010n_l7 {
	status = "disabled";
};

&pmk8550_gpios {

	/* GPIO_1: ASSIGN3_THERM */
	pmk8550_gpio_1: pmk8550_gpio_1 {
		pins = "gpio1";
		function = "normal";
		bias-high-impedance; /* Analog PIN */
		power-source = <1>;
	};

	/* GPIO_2: ASSIGN4_THERM */
	pmk8550_gpio_2: pmk8550_gpio_2 {
		pins = "gpio2";
		function = "normal";
		bias-high-impedance; /* Analog PIN */
		power-source = <1>;
	};

	/* GPIO_3: PMK_SLEEP_CLK_1P8 */
	/* Follow QC */

	/* GPIO_4: PMK8650_OPTION */
	/* Follow QC */

	/* GPIO_5: IEC_THERM */
	pmk8550_gpio_5: pmk8550_gpio_5 {
		pins = "gpio5";
		function = "normal";
		bias-high-impedance; /* Analog PIN */
		power-source = <1>;
	};

	/* GPIO_6: PMIC_RB */
	/* Follow QC */
};

&pm8550_gpios {

	/* GPIO_1: NC */
	pm8550_gpio_1: pm8550_gpio_1 {
		pins = "gpio1";
		function = "normal";
		bias-high-impedance; /* DISABLE GPIO_1 */
	};

	/* GPIO_2: NC */
	pm8550_gpio_2: pm8550_gpio_2 {
		pins = "gpio2";
		function = "normal";
		bias-high-impedance; /* DISABLE GPIO_2 */
	};

	/* GPIO_3: PA_THERM2 */
	pm8550_gpio_3: pm8550_gpio_3 {
		pins = "gpio3";
		function = "normal";
		bias-high-impedance; /* Analog PIN */
		power-source = <0>;
	};

	/* GPIO_4: NC */
	/* Follow QC */

	/* GPIO_5: NC */
	/* Follow QC */

	/* GPIO_6: VOL_DOWN_N */
	pm8550_gpio_6: pm8550_gpio_6 {
		pins = "gpio6";
		function = "normal";
		input-enable;
		bias-pull-up; /* Digital In */
		power-source = <1>;
	};

	/* GPIO_7: NC */
	/* Follow QC */

	/* GPIO_8: UIM1_LS_EN */
	/* Follow QC */

	/* GPIO_9: FP_LDO_EN */
		pm8550_gpio_9: pm8550_gpio_9 {
		pins = "gpio9";
		function = "normal";
		output-low;
		drive-push-pull; /* Digital Out */
		qcom,drive-strength = <PMIC_GPIO_STRENGTH_LOW>;
		power-source = <1>;
	};

	/* GPIO_10: UIM1_LS_EN */
	/* Follow QC */

	/* GPIO_11: NC */
	pm8550_gpio_11: pm8550_gpio_11 {
		pins = "gpio11";
		function = "normal";
		bias-high-impedance; /* DISABLE GPIO_11 */
	};

	/* GPIO_12: TRAY_DET */
	pm8550_gpio_12: pm8550_gpio_12 {
		pins = "gpio12";
		function = "normal";
		input-enable;
		bias-pull-down; /* Digital In */
		power-source = <2>;
	};
};

&sd_card_det_default {
	/delete-property/ bias-pull-up;
	bias-pull-down;
	power-source = <2>;
};

&pm8550b_gpios {

	/* GPIO_1: SPK_THERM */
	pm8550b_gpio_1: pm8550b_gpio_1 {
		pins = "gpio1";
		function = "normal";
		bias-high-impedance; /* DISABLE GPIO_2 */
	};

	/* GPIO_2: NC */
	pm8550b_gpio_2: pm8550b_gpio_2 {
		pins = "gpio2";
		function = "normal";
		bias-high-impedance; /* DISABLE GPIO_2 */
	};

	/* GPIO_3: NC */
	pm8550b_gpio_3: pm8550b_gpio_3 {
		pins = "gpio3";
		function = "normal";
		bias-high-impedance; /* DISABLE GPIO_3 */
	};

	/* GPIO_4: NC */
	pm8550b_gpio_4: pm8550b_gpio_4 {
		pins = "gpio4";
		function = "normal";
		bias-high-impedance; /* DISABLE GPIO_4 */
	};

	/* GPIO_5: LCD_ID */
	pm8550b_gpio_5: pm8550b_gpio_5 {
		pins = "gpio5";
		function = "normal";
		bias-high-impedance; /* Analog PIN */
		power-source = <1>;
	};

	/* GPIO_6: RF_ID */
	pm8550b_gpio_6: pm8550b_gpio_6 {
		pins = "gpio6";
		function = "normal";
		bias-high-impedance; /* Analog PIN */
		power-source = <1>;
	};

	/* GPIO_7: SNAPSHOT_N */
	pm8550b_gpio_7: pm8550b_gpio_7 {
		pins = "gpio7";
		function = "normal";
		input-enable;
		bias-pull-up; /* Digital In */
		power-source = <1>;
	};

	/* GPIO_8: FOCUS_N */
	pm8550b_gpio_8: pm8550b_gpio_8 {
		pins = "gpio8";
		function = "normal";
		input-enable;
		bias-pull-up; /* Digital In */
		power-source = <1>;
	};

	/* GPIO_9: NC */
	pm8550b_gpio_9: pm8550b_gpio_9 {
		pins = "gpio9";
		function = "normal";
		bias-high-impedance; /* DISABLE GPIO_9 */
	};

	/* GPIO_10: ASSIGN1_THERM */
	pm8550b_gpio_10: pm8550b_gpio_10 {
		pins = "gpio10";
		function = "normal";
		bias-high-impedance; /* Analog PIN */
		power-source = <0>;
	};

	/* GPIO_11: NC */
	/* Follow QC */

	/* GPIO_12: NC */
	pm8550b_gpio_12: pm8550b_gpio_12 {
		pins = "gpio12";
		function = "normal";
		bias-high-impedance; /* DISABLE GPIO_12 */
	};
};

&pm8550vs_c_gpios {

	/* GPIO_1: GND */
	/* Follow QC */

	/* GPIO_2: GND */
	/* Follow QC */

	/* GPIO_3: NC */
	/* Follow QC */

	/* GPIO_4: NC */
	pm8550vs_c_gpio_4: pm8550vs_c_gpio_4 {
		pins = "gpio4";
		function = "normal";
		bias-high-impedance; /* DISABLE GPIO_4 */
	};

	/* GPIO_5: NC */
	pm8550vs_c_gpio_5: pm8550vs_c_gpio_5 {
		pins = "gpio5";
		function = "normal";
		bias-high-impedance; /* DISABLE GPIO_5 */
	};

	/* GPIO_6: NC */
	pm8550vs_c_gpio_6: pm8550vs_c_gpio_6 {
		pins = "gpio6";
		function = "normal";
		bias-high-impedance; /* DISABLE GPIO_6 */
	};
};

&pm8550vs_d_gpios {

	/* GPIO_1: NC */
	/* Follow QC */

	/* GPIO_2: GND */
	/* Follow QC */

	/* GPIO_3: NC */
	/* Follow QC */

	/* GPIO_4: CAM_PWR_A_CS */
	pm8550vs_d_gpio_4: pm8550vs_d_gpio_4 {
		pins = "gpio4";
		output-low;
		drive-push-pull; /* Digital Out */
		qcom,drive-strength = <PMIC_GPIO_STRENGTH_LOW>;
		power-source = <1>;
	};

	/* GPIO_5: PM8010_1_RESET_N */
	/* Follow QC */

	/* GPIO_6: PM8010_2_RESET_N */
	/* Follow QC */

};

&pm8550vs_e_gpios {

	/* GPIO_1: GND */
	/* Follow QC */

	/* GPIO_2: NC */
	/* Follow QC */

	/* GPIO_3: NC */
	/* Follow QC */

	/* GPIO_4: NC */
	pm8550vs_e_gpio_4: pm8550vs_e_gpio_4 {
		pins = "gpio4";
		function = "normal";
		bias-high-impedance; /* DISABLE GPIO_4 */
	};

	/* GPIO_5: 1.5KCPU_VREG_L2E */
	pm8550vs_e_gpio_5: pm8550vs_e_gpio_5 {
		pins = "gpio5";
		function = "normal";
		bias-high-impedance; /* DISABLE GPIO_5 */
	};

	/* GPIO_6: NC */
	pm8550vs_e_gpio_6: pm8550vs_e_gpio_6 {
		pins = "gpio6";
		function = "normal";
		bias-high-impedance; /* DISABLE GPIO_6 */
	};
};

&pm8550vs_g_gpios {

	/* GPIO_1: NC */
	/* Follow QC */

	/* GPIO_2: NC */
	/* Follow QC */

	/* GPIO_3: NC */
	/* Follow QC */

	/* GPIO_4: WLC_TXPWR_EN */
	pm8550vs_g_gpio_4: pm8550vs_g_gpio_4 {
		pins = "gpio4";
		output-low;
		drive-push-pull; /* Digital Out */
		qcom,drive-strength = <PMIC_GPIO_STRENGTH_LOW>;
		power-source = <1>;
	};

	/* GPIO_5: NC */
	/* Follow QC */

	/* GPIO_6: NC */
	pm8550vs_g_gpio_6: pm8550vs_g_gpio_6 {
		pins = "gpio6";
		function = "normal";
		bias-high-impedance; /* DISABLE GPIO_6 */
	};
};

&pm8550ve_d_gpios {

	/* GPIO_1: GND */
	/* Follow QC */

	/* GPIO_2: NC */
	/* Follow QC */

	/* GPIO_3: NC */
	/* Follow QC */

	/* GPIO_4: NC */
	pm8550ve_gpio_4: pm8550ve_gpio_4 {
		pins = "gpio4";
		function = "normal";
		bias-high-impedance; /* DISABLE GPIO_4 */
	};

	/* GPIO_5: NC */
	pm8550ve_gpio_5: pm8550ve_gpio_5 {
		pins = "gpio5";
		function = "normal";
		bias-high-impedance; /* DISABLE GPIO_5 */
	};

	/* GPIO_6: NC */
	pm8550ve_gpio_6: pm8550ve_gpio_6 {
		pins = "gpio6";
		function = "normal";
		bias-high-impedance; /* DISABLE GPIO_6 */
	};

	/* GPIO_7: NC */
	pm8550ve_gpio_7: pm8550ve_gpio_7 {
		pins = "gpio7";
		function = "normal";
		bias-high-impedance; /* DISABLE GPIO_7 */
	};

	/* GPIO_8: EXT_BOB_EN */
	pm8550ve_gpio_8: pm8550ve_gpio_8 {
		pins = "gpio8";
		output-low;
		drive-push-pull; /* Digital Out */
		qcom,drive-strength = <PMIC_GPIO_STRENGTH_LOW>;
		power-source = <1>;
	};
};

&pcie1 {
	status = "disabled";
};

&tlmm {
	/* GPIO_0 : SW_SERVICE */
	sm_gpio_0: sm_gpio_0 {
		mux {
			pins = "gpio0";
			function = "gpio";
		};

		config {
			pins = "gpio0";
			drive-strength = <2>;
			bias-pull-up;
			input-enable;
		};
	};

	/* GPIO_1 : CAM2_RESET_N */
	sm_gpio_1: sm_gpio_1 {
		mux {
			pins = "gpio1";
			function = "gpio";
		};

		config {
			pins = "gpio1";
			drive-strength = <2>;
			bias-disable;
			output-low;
		};
	};

	/* GPIO_2 : CAM0_RESET_N */
	sm_gpio_2: sm_gpio_2 {
		mux {
			pins = "gpio2";
			function = "gpio";
		};

		config {
			pins = "gpio2";
			drive-strength = <2>;
			bias-disable;
			output-low;
		};
	};

	/* GPIO_3 : NC */
	sm_gpio_3: sm_gpio_3 {
		mux {
			pins = "gpio3";
			function = "gpio";
		};

		config {
			pins = "gpio3";
			drive-strength = <2>;
			bias-pull-down;
			input-enable;
		};
	};

	/* GPIO_4 : NC */
	sm_gpio_4: sm_gpio_4 {
		mux {
			pins = "gpio4";
			function = "gpio";
		};

		config {
			pins = "gpio4";
			drive-strength = <2>;
			bias-pull-down;
			input-enable;
		};
	};

	/* GPIO_5 : NC */
	sm_gpio_5: sm_gpio_5 {
		mux {
			pins = "gpio5";
			function = "gpio";
		};

		config {
			pins = "gpio5";
			drive-strength = <2>;
			bias-pull-down;
			input-enable;
		};
	};

	/* GPIO_6 : NC */
	sm_gpio_6: sm_gpio_6 {
		mux {
			pins = "gpio6";
			function = "gpio";
		};

		config {
			pins = "gpio6";
			drive-strength = <2>;
			bias-pull-down;
			input-enable;
		};
	};

	/* GPIO_7 : NC */
	sm_gpio_7: sm_gpio_7 {
		mux {
			pins = "gpio7";
			function = "gpio";
		};

		config {
			pins = "gpio7";
			drive-strength = <2>;
			bias-pull-down;
			input-enable;
		};
	};

	/* GPIO_8 : NC */
	sm_gpio_8: sm_gpio_8 {
		mux {
			pins = "gpio8";
			function = "gpio";
		};

		config {
			pins = "gpio8";
			drive-strength = <2>;
			bias-pull-down;
			input-enable;
		};
	};

	/* GPIO_9 : NC */
	sm_gpio_9: sm_gpio_9 {
		mux {
			pins = "gpio9";
			function = "gpio";
		};

		config {
			pins = "gpio9";
			drive-strength = <2>;
			bias-pull-down;
			input-enable;
		};
	};

	/* GPIO_10 : NC */
	sm_gpio_10: sm_gpio_10 {
		mux {
			pins = "gpio10";
			function = "gpio";
		};

		config {
			pins = "gpio10";
			drive-strength = <2>;
			bias-pull-down;
			input-enable;
		};
	};

	/* GPIO_11 : NC */
	sm_gpio_11: sm_gpio_11 {
		mux {
			pins = "gpio11";
			function = "gpio";
		};

		config {
			pins = "gpio11";
			drive-strength = <2>;
			bias-pull-down;
			input-enable;
		};
	};

	/* GPIO_12 : CCI_I2C3_SDA */
	sm_gpio_12: sm_gpio_12 {
		mux {
			pins = "gpio12";
			function = "cci_i2c_sda3";
		};

		config {
			pins = "gpio12";
			drive-strength = <2>;
			bias-disable;
		};
	};

	/* GPIO_13 : CCI_I2C3_SCL */
	sm_gpio_13: sm_gpio_13 {
		mux {
			pins = "gpio13";
			function = "cci_i2c_scl3";
		};

		config {
			pins = "gpio13";
			drive-strength = <2>;
			bias-disable;
		};
	};

	/* GPIO_14 : NC */
	sm_gpio_14: sm_gpio_14 {
		mux {
			pins = "gpio14";
			function = "gpio";
		};

		config {
			pins = "gpio14";
			drive-strength = <2>;
			bias-pull-down;
			input-enable;
		};
	};

	/* GPIO_15 : CAM1_RESET_N */
	sm_gpio_15: sm_gpio_15 {
		mux {
			pins = "gpio15";
			function = "gpio";
		};

		config {
			pins = "gpio15";
			drive-strength = <2>;
			bias-disable;
			output-low;
		};
	};

	/* GPIO_16 : HMT_WLAN_EN */
	/* Follow QC */

	/* GPIO_17 : HMT_BT_EN */
	/* Follow QC */

	/* GPIO_18 : HMT_SW_CTRL */
	/* Follow QC */

	/* GPIO_19 : HMT_SW_CTRL_WL_CX */
	/* Follow QC */

	/* GPIO_20 : NC */
	sm_gpio_20: sm_gpio_20 {
		mux {
			pins = "gpio20";
			function = "gpio";
		};

		config {
			pins = "gpio20";
			drive-strength = <2>;
			bias-pull-down;
			input-enable;
		};
	};

	/* GPIO_21 : NC */
	sm_gpio_21: sm_gpio_21 {
		mux {
			pins = "gpio21";
			function = "gpio";
		};

		config {
			pins = "gpio21";
			drive-strength = <2>;
			bias-pull-down;
			input-enable;
		};
	};

	/* GPIO_22 : NC */
	sm_gpio_22: sm_gpio_22 {
		mux {
			pins = "gpio22";
			function = "gpio";
		};

		config {
			pins = "gpio22";
			drive-strength = <2>;
			bias-pull-down;
			input-enable;
		};
	};

	/* GPIO_23 : NC */
	sm_gpio_23: sm_gpio_23 {
		mux {
			pins = "gpio23";
			function = "gpio";
		};

		config {
			pins = "gpio23";
			drive-strength = <2>;
			bias-pull-down;
			input-enable;
		};
	};

	/* GPIO_24 : HMT_BT_UART_CTS */
	/* Follow QC */

	/* GPIO_25 : HMT_BT_UART_RFR */
	/* Follow QC */

	/* GPIO_26 : HMT_BT_UART_TX*/
	/* Follow QC */

	/* GPIO_27 : HMT_BT_UART_RX */
	/* Follow QC */

	/* GPIO_28 : NC */
	sm_gpio_28: sm_gpio_28 {
		mux {
			pins = "gpio28";
			function = "gpio";
		};

		config {
			pins = "gpio28";
			drive-strength = <2>;
			bias-pull-down;
			input-enable;
		};
	};

	/* GPIO_29 : USB_CC_DIR */
	/* Follow QC */

	/* GPIO_30 : DEBUG_UART_TX */
	/* Follow QC */

	/* GPIO_31 : DEBUG_UART_RX */
	/* Follow QC */

	/* GPIO_32 : NFC_I2C_SDA */
	/* Follow QC */

	/* GPIO_33 : NFC_I2C_SCL */
	/* Follow QC */

	/* GPIO_34 : NFC_EN */
	/* Follow QC */

	/* GPIO_35 : NFC_CLK_REQ */
	/* Follow QC */

	/* GPIO_40 : FP_SPI_MISO */
	/* Follow QC */

	/* GPIO_41 : FP_SPI_MOSI */
	/* Follow QC */

	/* GPIO_42 : FP_SPI_CLK */
	/* Follow QC */

	/* GPIO_43 : FP_SPI_CS_N */
	/* Follow QC */

	/* GPIO_44 : APPS_1P2_I2C_SDA */
	/* Follow QC */

	/* GPIO_45 : APPS_1P2_I2C_SCL */
	/* Follow QC */

	/* GPIO_46 : NC */
	sm_gpio_46: sm_gpio_46 {
		mux {
			pins = "gpio46";
			function = "gpio";
		};

		config {
			pins = "gpio46";
			drive-strength = <2>;
			bias-pull-down;
			input-enable;
		};
	};

	/* GPIO_47 : TRAY_DET */
	/* Follow QC */

	/* GPIO_48 : TS_I2C_SDA */
	sm_gpio_48: sm_gpio_48 {
		mux {
			pins = "gpio48";
			function = "qup1_se4_l0";
		};

		config {
			pins = "gpio48";
			drive-strength = <2>;
			bias-disable;
		};
	};

	/* GPIO_48 : TS_I2C_SDA (Suspend) */
	sm_gpio_48_suspend: sm_gpio_48_suspend {
		mux {
			pins = "gpio48";
			function = "gpio";
		};

		config {
			pins = "gpio48";
			drive-strength = <2>;
			bias-disable;
			input-enable;
		};
	};

	/* GPIO_49 : TS_I2C_SCL */
	sm_gpio_49: sm_gpio_49 {
		mux {
			pins = "gpio49";
			function = "qup1_se4_l1";
		};

		config {
			pins = "gpio49";
			drive-strength = <2>;
			bias-disable;
		};
	};

	/* GPIO_49 : TS_I2C_SCL (Suspend) */
	sm_gpio_49_suspend: sm_gpio_49_suspend {
		mux {
			pins = "gpio49";
			function = "gpio";
		};

		config {
			pins = "gpio49";
			drive-strength = <2>;
			bias-disable;
			input-enable;
		};
	};

	/* GPIO_50 : NC */
	sm_gpio_50: sm_gpio_50 {
		mux {
			pins = "gpio50";
			function = "gpio";
		};

		config {
			pins = "gpio50";
			drive-strength = <2>;
			bias-pull-down;
			input-enable;
		};
	};

	/* GPIO_51 : NC */
	sm_gpio_51: sm_gpio_51 {
		mux {
			pins = "gpio51";
			function = "gpio";
		};

		config {
			pins = "gpio51";
			drive-strength = <2>;
			bias-pull-down;
			input-enable;
		};
	};

	/* GPIO_52 : NC */
	sm_gpio_52: sm_gpio_52 {
		mux {
			pins = "gpio52";
			function = "gpio";
		};

			config {
			pins = "gpio52";
			drive-strength = <2>;
			bias-pull-down;
			input-enable;
		};
	};

	/* GPIO_53 : DISP_ERR_FG */
	sm_gpio_53: sm_gpio_53 {
		mux {
			pins = "gpio53";
			function = "gpio";
		};

		config {
			pins = "gpio53";
			drive-strength = <2>;
			bias-pull-down;
			input-enable;
		};
	};

	/* GPIO_54 : NC */
	sm_gpio_54: sm_gpio_54 {
		mux {
			pins = "gpio54";
			function = "gpio";
		};

		config {
			pins = "gpio54";
			drive-strength = <2>;
			bias-pull-down;
			input-enable;
		};
	};

	/* GPIO_55 : NC */
	sm_gpio_55: sm_gpio_55 {
		mux {
			pins = "gpio55";
			function = "gpio";
		};

		config {
			pins = "gpio55";
			drive-strength = <2>;
			bias-pull-down;
			input-enable;
		};
	};

	/* GPIO_56 : WLC_I2C_SDA */
	sm_gpio_56: sm_gpio_56 {
		mux {
			pins = "gpio56";
                        function = "qup1_se6_l0";
		};

		config {
			pins = "gpio56";
			drive-strength = <2>;
			bias-disable;
		};
	};

	/* GPIO_57 : WLC_I2C_SCL */
	sm_gpio_57: sm_gpio_57 {
		mux {
			pins = "gpio57";
			function = "qup1_se6_l1";
		};

		config {
			pins = "gpio57";
			drive-strength = <2>;
			bias-disable;
		};
	};

	/* GPIO_58 : RF_ID_EXTENSION_1 */
	sm_gpio_58: sm_gpio_58 {
		mux {
			pins = "gpio58";
			function = "gpio";
		};

		config {
			pins = "gpio58";
			drive-strength = <2>;
			bias-pull-down;
			input-enable;
		};
	};

	/* GPIO_59 : RF_ID_EXTENSION_2 */
	sm_gpio_59: sm_gpio_59 {
		mux {
			pins = "gpio59";
			function = "gpio";
		};

		config {
			pins = "gpio59";
			drive-strength = <2>;
			bias-pull-down;
			input-enable;
		};
	};

	/* GPIO_60 : NFC_ESE_SPI_MISO_1P8 */
	/* Don't set here */

	/* GPIO_61 : NFC_ESE_SPI_MOSI_1P8 */
	/* Don't set here */

	/* GPIO_62 : NFC_ESE_SPI_CLK_1P8 */
	/* Don't set here */

	/* GPIO_63 : NFC_ESE_SPI_CS_N_1P8 */
	/* Don't set here */

	/* GPIO_64 : ALS_PROX_INT_N */
	sm_gpio_64: sm_gpio_64 {
		mux {
			pins = "gpio64";
			function = "gpio";
		};

		config {
			pins = "gpio64";
			drive-strength = <2>;
			bias-disable;
			input-enable;
		};
	};

	/* GPIO_65 : NC */
	sm_gpio_65: sm_gpio_65 {
		mux {
			pins = "gpio65";
			function = "gpio";
		};

		config {
			pins = "gpio65";
			drive-strength = <2>;
			bias-pull-down;
			input-enable;
		};
	};

	/* GPIO_66 : HAP_I2C_SDA */
	sm_gpio_66: sm_gpio_66 {
		mux {
			pins = "gpio66";
			function = "i2chub0_se1_l0";
		};

		config {
			pins = "gpio66";
			drive-strength = <2>;
			bias-disable;
		};
	};

	/* GPIO_66 : HAP_I2C_SDA (Suspend) */
	sm_gpio_66_suspend: sm_gpio_66_suspend {
		mux {
			pins = "gpio66";
			function = "gpio";
		};

		config {
			pins = "gpio66";
			drive-strength = <2>;
			bias-disable;
			input-enable;
		};
	};

	/* GPIO_67 : HAP_I2C_SCL */
	sm_gpio_67: sm_gpio_67 {
		mux {
			pins = "gpio67";
			function = "i2chub0_se1_l1";
		};

		config {
			pins = "gpio67";
			drive-strength = <2>;
			bias-disable;
		};
	};

	/* GPIO_67 : HAP_I2C_SCL (Suspend) */
	sm_gpio_67_suspend: sm_gpio_67_suspend {
		mux {
			pins = "gpio67";
			function = "gpio";
		};

		config {
			pins = "gpio67";
			drive-strength = <2>;
			bias-disable;
			input-enable;
		};
	};

	/* GPIO_68 : HAP_INT_N */
	sm_gpio_68: sm_gpio_68 {
		mux {
			pins = "gpio68";
			function = "gpio";
		};

		config {
			pins = "gpio68";
			drive-strength = <2>;
			bias-disable;
			input-enable;
		};
	};

	/* GPIO_69 : WLC_INT_N */
	sm_gpio_69: sm_gpio_69 {
		mux {
			pins = "gpio69";
			function = "gpio";
		};

		config {
			pins = "gpio69";
			drive-strength = <2>;
			bias-pull-up;
			input-enable;
		};
	};

	/* GPIO_70 : SPK_AMP_I2C_SDA */
	sm_gpio_70: sm_gpio_70 {
		mux {
			pins = "gpio70";
			function = "i2chub0_se3_l0";
		};

		config {
			pins = "gpio70";
			drive-strength = <2>;
			bias-disable;
		};
	};

	/* GPIO_70: SPK_AMP_I2C_SDA (Suspend) */
	sm_gpio_70_suspend: sm_gpio_70_suspend {
		mux {
			pins = "gpio70";
			function = "gpio";
		};

		config {
			pins = "gpio70";
			drive-strength = <2>;
			bias-disable;
			input-enable;
		};
	};

	/* GPIO_71 : SPK_AMP_I2C_SCL */
	sm_gpio_71: sm_gpio_71 {
		mux {
			pins = "gpio71";
			function = "i2chub0_se3_l1";
		};

		config {
			pins = "gpio71";
			drive-strength = <2>;
			bias-disable;
		};
	};

	/* GPIO_71 : SPK_AMP_I2C_SCL (Suspend) */
	sm_gpio_71_suspend: sm_gpio_71_suspend {
		mux {
			pins = "gpio71";
			function = "gpio";
		};

		config {
			pins = "gpio71";
			drive-strength = <2>;
			bias-disable;
			input-enable;
		};
	};

	/* GPIO_72 : APPS_I2C_0_SDA */
	sm_gpio_72: sm_gpio_72 {
		mux {
			pins = "gpio72";
			function = "i2chub0_se4_l0";
		};

		config {
			pins = "gpio72";
			drive-strength = <2>;
			bias-pull-up;
			qcom,i2c_pull;
		};
	};

	/* GPIO_72 : APPS_I2C_0_SDA (Suspend) */
	sm_gpio_72_suspend: sm_gpio_72_suspend {
		mux {
			pins = "gpio72";
			function = "gpio";
		};

		config {
			pins = "gpio72";
			drive-strength = <2>;
			bias-pull-up;
			input-enable;
		};
	};

	/* GPIO_73 : APPS_I2C_0_SCL */
	sm_gpio_73: sm_gpio_73 {
		mux {
			pins = "gpio73";
			function = "i2chub0_se4_l1";
		};

		config {
			pins = "gpio73";
			drive-strength = <2>;
			bias-pull-up;
			qcom,i2c_pull;
		};
	};

	/* GPIO_73 : APPS_I2C_0_SCL (suspend) */
	sm_gpio_73_suspend: sm_gpio_73_suspend {
		mux {
			pins = "gpio73";
			function = "gpio";
		};

		config {
			pins = "gpio73";
			drive-strength = <2>;
			bias-pull-up;
			input-enable;
		};
	};

	/* GPIO_75 : NFC_IRQ */
	sm_gpio_75: sm_gpio_75 {
		mux {
			pins = "gpio75";
			function = "gpio";
		};

		config {
			pins = "gpio75";
			drive-strength = <2>;
			bias-pull-down;
			input-enable;
		};
	};

	/* GPIO_76 : TRAY_DET */
	/* Follow QC */

	/* GPIO_77 : NC */
	sm_gpio_77: sm_gpio_77 {
		mux {
			pins = "gpio77";
			function = "gpio";
		};

		config {
			pins = "gpio77";
			drive-strength = <2>;
			bias-pull-down;
			input-enable;
		};
	};

	/* GPIO_78 : HAP_RST_N*/
	sm_gpio_78: sm_gpio_78 {
		mux {
			pins = "gpio78";
			function = "gpio";
		};

		config {
			pins = "gpio78";
			drive-strength = <2>;
			bias-disable;
			output-low;
		};
	};

	/* GPIO_79 : NC */
	sm_gpio_79: sm_gpio_79 {
		mux {
			pins = "gpio79";
			function = "gpio";
		};

		config {
			pins = "gpio79";
			drive-strength = <2>;
			bias-pull-down;
			input-enable;
		};
	};

	/* GPIO_80 : IMU1_INT */
	/* Follow QC */

	/* GPIO_81 : VREG_WIDEC_AVDD_2P0_EN */
	sm_gpio_81: sm_gpio_81 {
		mux {
			pins = "gpio81";
			function = "gpio";
		};

		config {
			pins = "gpio81";
			drive-strength = <2>;
			bias-disable;
			output-low;
		};
	};

	/* GPIO_82 : VREG_TELEC_AVDD_1P3_EN */
	sm_gpio_82: sm_gpio_82 {
		mux {
			pins = "gpio82";
			function = "gpio";
		};

		config {
			pins = "gpio82";
			drive-strength = <2>;
			bias-disable;
			output-low;
		};
	};

	/* GPIO_83 : FORCE_USB_BOOT */
	sm_gpio_83: sm_gpio_83 {
		mux {
			pins = "gpio83";
			function = "gpio";
		};

		config {
			pins = "gpio83";
			drive-strength = <2>;
			bias-pull-down;
			input-enable;
		};
	};

	/* GPIO_84 : NC */
	sm_gpio_84: sm_gpio_84 {
		mux {
			pins = "gpio84";
			function = "gpio";
		};

		config {
			pins = "gpio84";
			drive-strength = <2>;
			bias-pull-down;
			input-enable;
		};
	};

	/* GPIO_85 : NC */
	sm_gpio_85: sm_gpio_85 {
		mux {
			pins = "gpio85";
			function = "gpio";
		};

		config {
			pins = "gpio85";
			drive-strength = <2>;
			bias-pull-down;
			input-enable;
		};
	};

	/* GPIO_86 : DISP_VSYNC */
	sm_gpio_86: sm_gpio_86 {
		mux {
			pins = "gpio86";
			function = "mdp_vsync";
		};

		config {
			pins = "gpio86";
			drive-strength = <2>;
			bias-disable;
		};
	};

	/* GPIO_87 : HW_ID_0 */
	sm_gpio_87: sm_gpio_87 {
		mux {
			pins = "gpio87";
			function = "gpio";
		};

		config {
			pins = "gpio87";
			drive-strength = <2>;
			bias-pull-up;
			input-enable;
		};
	};

	/* GPIO_88 : HW_ID_1 */
	sm_gpio_88: sm_gpio_88 {
		mux {
			pins = "gpio88";
			function = "gpio";
		};

		config {
			pins = "gpio88";
			drive-strength = <2>;
			bias-pull-up;
			input-enable;
		};
	};

	/* GPIO_89 : FP_RESET_N */
	sm_gpio_89: sm_gpio_89 {
		mux {
			pins = "gpio89";
			function = "gpio";
		};

		config {
			pins = "gpio89";
			drive-strength = <2>;
			bias-disable;
			output-low;
		};
	};

	/* GPIO_90 : NC */
	sm_gpio_90: sm_gpio_90 {
		mux {
			pins = "gpio90";
			function = "gpio";
		};

		config {
			pins = "gpio90";
			drive-strength = <2>;
			bias-pull-down;
			input-enable;
		};
	};

	/* GPIO_91 : NC */
	sm_gpio_91: sm_gpio_91 {
		mux {
			pins = "gpio91";
			function = "gpio";
		};

		config {
			pins = "gpio91";
			drive-strength = <2>;
			bias-pull-down;
			input-enable;
		};
	};

	/* GPIO_92 : FP_INT_N */
	sm_gpio_92: sm_gpio_92 {
		mux {
			pins = "gpio92";
			function = "gpio";
		};

		config {
			pins = "gpio92";
			drive-strength = <2>;
			bias-disable;
			output-low;
		};
	};

	sm_gpio_92_input_pull_up: sm_gpio_92_input_pull_up {
		mux {
			pins = "gpio92";
			function = "gpio";
		};

		config {
			pins = "gpio92";
			drive-strength = <2>;
			bias-pull-up;
			input-enable;
		};
	};

	/* GPIO_93 : NC */
	sm_gpio_93: sm_gpio_93 {
		mux {
			pins = "gpio93";
			function = "gpio";
		};

		config {
			pins = "gpio93";
			drive-strength = <2>;
			bias-pull-down;
			input-enable;
		};
	};

	/* GPIO_94 : PCIE0_RESET_N */
	/* Follow QC */

	/* GPIO_95 : PCIE0_CLK_REQ_N */
	/* Follow QC */

	/* GPIO_96 : PCIE0_WAKE_N */
	/* Follow QC */

	/* GPIO_97 : NC */
	sm_gpio_97: sm_gpio_97 {
		mux {
			pins = "gpio97";
			function = "gpio";
		};

		config {
			pins = "gpio97";
			drive-strength = <2>;
			bias-pull-down;
			input-enable;
		};
	};

	/* GPIO_98 : NC */
	sm_gpio_98: sm_gpio_98 {
		mux {
			pins = "gpio98";
			function = "gpio";
		};

		config {
			pins = "gpio98";
			drive-strength = <2>;
			bias-pull-down;
			input-enable;
		};
	};

	/* GPIO_99 : NC */
	sm_gpio_99: sm_gpio_99 {
		mux {
			pins = "gpio99";
			function = "gpio";
		};

		config {
			pins = "gpio99";
			drive-strength = <2>;
			bias-pull-down;
			input-enable;
		};
	};

	/* GPIO_100 : NC */
	sm_gpio_100: sm_gpio_100 {
		mux {
			pins = "gpio100";
			function = "gpio";
		};

		config {
			pins = "gpio100";
			drive-strength = <2>;
			bias-pull-down;
			input-enable;
		};
	};

	/* GPIO_101 : CAM_MCLK1 */
	sm_gpio_101: sm_gpio_101 {
		mux {
			pins = "gpio101";
			function = "cam_mclk";
		};

		config {
			pins = "gpio101";
			drive-strength = <2>;
			bias-disable;
		};
	};

	/* GPIO_102 : CAM_MCLK2 */
	sm_gpio_102: sm_gpio_102 {
		mux {
			pins = "gpio102";
			function = "cam_aon_mclk2";
		};

		config {
			pins = "gpio102";
			drive-strength = <2>;
			bias-disable;
		};
	};

	/* GPIO_103 : CAM_MCLK3 */
	sm_gpio_103: sm_gpio_103 {
		mux {
			pins = "gpio103";
			function = "cam_mclk";
		};

		config {
			pins = "gpio103";
			drive-strength = <2>;
			bias-disable;
		};
	};

	/* GPIO_104 : NC */
	sm_gpio_104: sm_gpio_104 {
		mux {
			pins = "gpio104";
			function = "gpio";
		};

		config {
			pins = "gpio104";
			drive-strength = <2>;
			bias-pull-down;
			input-enable;
		};
	};

	/* GPIO_105 : NC */
	sm_gpio_105: sm_gpio_105 {
		mux {
			pins = "gpio105";
			function = "gpio";
		};

		config {
			pins = "gpio105";
			drive-strength = <2>;
			bias-pull-down;
			input-enable;
		};
	};

	/* GPIO_106 : NC */
	sm_gpio_106: sm_gpio_106 {
		mux {
			pins = "gpio106";
			function = "gpio";
		};

		config {
			pins = "gpio106";
			drive-strength = <2>;
			bias-pull-down;
			input-enable;
		};
	};

	/* GPIO_107 : WCD_RESET_N */
	/* Follow QC */

	/* GPIO_108 : NC */
	sm_gpio_108: sm_gpio_108 {
		mux {
			pins = "gpio108";
			function = "gpio";
		};

		config {
			pins = "gpio108";
			drive-strength = <2>;
			bias-pull-down;
			input-enable;
		};
	};

	/* GPIO_109 : CAM3_RESET_N */
	sm_gpio_109: sm_gpio_109 {
		mux {
			pins = "gpio109";
			function = "gpio";
		};

		config {
			pins = "gpio109";
			drive-strength = <2>;
			bias-disable;
			output-low;
		};
	};

	/* GPIO_110 : NC */
	sm_gpio_110: sm_gpio_110 {
		mux {
			pins = "gpio110";
			function = "gpio";
		};

		config {
			pins = "gpio110";
			drive-strength = <2>;
			bias-pull-down;
			input-enable;
		};
	};

	/* GPIO_111 : NC */
	sm_gpio_111: sm_gpio_111 {
		mux {
			pins = "gpio111";
			function = "gpio";
		};

		config {
			pins = "gpio111";
			drive-strength = <2>;
			bias-pull-down;
			input-enable;
		};
	};

	/* GPIO_112 : NC */
	sm_gpio_112: sm_gpio_112 {
		mux {
			pins = "gpio112";
			function = "gpio";
		};

		config {
			pins = "gpio112";
			drive-strength = <2>;
			bias-pull-down;
			input-enable;
		};
	};

	/* GPIO_113 : CCI_I2C0_SDA */
	sm_gpio_113: sm_gpio_113 {
		mux {
			pins = "gpio113";
			function = "cci_i2c_sda0";
		};

		config {
			pins = "gpio113";
			drive-strength = <2>;
			bias-disable;
		};
	};

	/* GPIO_114 : CCI_I2C0_SCL */
	sm_gpio_114: sm_gpio_114 {
		mux {
			pins = "gpio114";
			function = "cci_i2c_scl0";
		};

		config {
			pins = "gpio114";
			drive-strength = <2>;
			bias-disable;
		};
	};

	/* GPIO_115 : CCI_I2C1_SDA */
	sm_gpio_115: sm_gpio_115 {
		mux {
			pins = "gpio115";
			function = "cci_i2c_sda1";
		};

		config {
			pins = "gpio115";
			drive-strength = <2>;
			bias-disable;
		};
	};

	/* GPIO_116 :  CCI_I2C1_SCL*/
	sm_gpio_116: sm_gpio_116 {
		mux {
			pins = "gpio116";
			function = "cci_i2c_scl1";
		};

		config {
			pins = "gpio116";
			drive-strength = <2>;
			 bias-disable;
		};
	};

	/* GPIO_117 : CCI_I2C2_SDA */
	sm_gpio_117: sm_gpio_117 {
		mux {
			pins = "gpio117";
			function = "cci_i2c_sda2";
		};

		config {
			pins = "gpio117";
			drive-strength = <2>;
			bias-disable;
		};
	};

	/* GPIO_118 : CCI_I2C2_SCL */
	sm_gpio_118: sm_gpio_118 {
		mux {
			pins = "gpio118";
			function = "cci_i2c_scl2";
		};

		config {
			pins = "gpio118";
			drive-strength = <2>;
			bias-disable;
		};
	};

	/* GPIO_119 : DEBUG_GPIO0 */
	sm_gpio_119: sm_gpio_119 {
		mux {
			pins = "gpio119";
			function = "gpio";
		};

		config {
			pins = "gpio119";
			drive-strength = <2>;
			bias-pull-down;
			input-enable;

		};
	};

	/* GPIO_120 : NC */
	sm_gpio_120: sm_gpio_120 {
		mux {
			pins = "gpio120";
			function = "gpio";
		};

		config {
			pins = "gpio120";
			drive-strength = <2>;
			bias-pull-down;
			input-enable;
		};
	};

	/* GPIO_121 : NC */
	sm_gpio_121: sm_gpio_121 {
		mux {
			pins = "gpio121";
			function = "gpio";
		};

		config {
			pins = "gpio121";
			drive-strength = <2>;
			bias-pull-down;
			input-enable;
		};
	};

	/* GPIO_122 : NC */
	sm_gpio_122: sm_gpio_122 {
		mux {
			pins = "gpio122";
			function = "gpio";
		};

		config {
			pins = "gpio122";
			drive-strength = <2>;
			bias-pull-down;
			input-enable;
		};
	};

	/* GPIO_123 : NC */
	sm_gpio_123: sm_gpio_123 {
		mux {
			pins = "gpio123";
			function = "gpio";
		};

		config {
			pins = "gpio123";
			drive-strength = <2>;
			bias-pull-down;
			input-enable;
		};
	};

	/* GPIO_124 : NC */
	sm_gpio_124: sm_gpio_124 {
		mux {
			pins = "gpio124";
			function = "gpio";
		};

		config {
			pins = "gpio124";
			drive-strength = <2>;
			bias-pull-down;
			input-enable;
		};
	};

	/* GPIO_125 : NC */
	sm_gpio_125: sm_gpio_125 {
		mux {
			pins = "gpio125";
			function = "gpio";
		};

		config {
			pins = "gpio125";
			drive-strength = <2>;
			bias-pull-down;
			input-enable;
		};
	};

	/* GPIO_126 : HAP_I2S_CLK */
	sm_gpio_126: sm_gpio_126 {
		mux {
			pins = "gpio126";
			function = "i2s0_sck";
		};

		config {
			pins = "gpio126";
			drive-strength = <2>;
			bias-disable;
		};
	};

	/* GPIO_127 : HAP_I2S_DOUT */
	sm_gpio_127: sm_gpio_127 {
		mux {
			pins = "gpio127";
			function = "i2s0_data0";
		};

		config {
			pins = "gpio127";
			drive-strength = <2>;
			bias-disable;
		};
	};

	/* GPIO_128 : HAP_TRG1 */
	sm_gpio_128: sm_gpio_128 {
		mux {
			pins = "gpio128";
			function = "gpio";
		};

		config {
			pins = "gpio128";
			drive-strength = <2>;
			bias-disable;
			output-low;
		};
	};

	/* GPIO_129 : HAP_I2S_SYNC */
	sm_gpio_129: sm_gpio_129 {
		mux {
			pins = "gpio129";
			function = "i2s0_ws";
		};

		config {
			pins = "gpio129";
			drive-strength = <2>;
			bias-disable;
		};
	};

	/* GPIO_130 : UIM1_DATA_1P2 */
	/* Follow QC */

	/* GPIO_131 : UIM1_CLK_1P2 */
	/* Follow QC */

	/* GPIO_132 : UIM1_RESET_1P2 */
	/* Follow QC */

	/* GPIO_133 : DISP_RESET_N */
	sm_gpio_133: sm_gpio_133 {
		mux {
			pins = "gpio133";
			function = "gpio";
		};

		config {
			pins = "gpio133";
			drive-strength = <2>;
			bias-disable;
			output-low;
		};
	};

	/* GPIO_134 : UIM2_DATA_1P8 */
	/* Follow QC */

	/* GPIO_135 : UIM2_CLK_1P8 */
	/* Follow QC */

	/* GPIO_136 : UIM2_RESET_1P8 */
	/* Follow QC */

	/* GPIO_137 : RF_LCD_ID_EN */
	sm_gpio_137: sm_gpio_137 {
		mux {
			pins = "gpio137";
			function = "gpio";
		};

		config {
			pins = "gpio137";
			drive-strength = <2>;
			bias-disable;
			output-low;
		};
	};

	/* GPIO_138 : SM_RFFE0_CLK */
	/* Follow QC */

	/* GPIO_139 : SM_RFFE0_DATA */
	/* Follow QC */

	/* GPIO_140 : SM_RFFE1_CLK */
	/* Follow QC */

	/* GPIO_141 : SM_RFFE1_DATA */
	/* Follow QC */

	/* GPIO_142 : SM_RFFE2_CLK */
	/* Follow QC */

	/* GPIO_143 : SM_RFFE2_DATA */
	/* Follow QC */

	/* GPIO_144 : NC */
	sm_gpio_144: sm_gpio_144 {
		mux {
			pins = "gpio144";
			function = "gpio";
		};

		config {
			pins = "gpio144";
			drive-strength = <2>;
			bias-pull-down;
			input-enable;
		};
	};

	/* GPIO_145 : HMT_AS_EN */
	/* Follow QC */

	/* GPIO_146 : LAA_RX_EN*/
	/* Follow QC */

	/* GPIO_147 : PA_MUTING*/
	/* Follow QC */

	/* GPIO_148 : WLAN_COEX_UART1_RX */
	/* Follow QC */

	/* GPIO_149 : WLAN_COEX_UART1_TX */
	/* Follow QC */

	/* GPIO_150 : GNSS_ELNA_EN0 */
	/* Follow QC */

	/* GPIO_151 : NC */
	sm_gpio_151: sm_gpio_151 {
		mux {
			pins = "gpio151";
			function = "gpio";
		};

		config {
			pins = "gpio151";
			drive-strength = <2>;
			bias-pull-down;
			input-enable;
		};
	};

	/* GPIO_152 : WCD_USBSW_RESET */
	/* Follow QC */

	/* GPIO_153 : NC */
	sm_gpio_153: sm_gpio_153 {
		mux {
			pins = "gpio153";
			function = "gpio";
		};

		config {
			pins = "gpio153";
			drive-strength = <2>;
			bias-pull-down;
			input-enable;
		};
	};

	/* GPIO_154 : SDR_GNSS_SYNC */
	/* Follow QC */

	/* GPIO_155 : NFC_COLD_RST */
	sm_gpio_155: sm_gpio_155 {
		mux {
			pins = "gpio155";
			function = "gpio";
		};

		config {
			pins = "gpio155";
			drive-strength = <2>;
			bias-disable;
			output-low;
		};
	};

	/* GPIO_156 : SDR_QLINK0_L_REQ */
	/* Follow QC */

	/* GPIO_157 : SDR_QLINK0_L_EN */
	/* Follow QC */

	/* GPIO_158 : SDR_WMSS_RESET_N */
	/* Follow QC */

	/* GPIO_159 : SDR_QLINK0_B_REQ */
	/* Follow QC */

	/* GPIO_160 : SDR_QLINK0_B_EN */
	/* Follow QC */

	/* GPIO_161 : TS_RESET_N */
	sm_gpio_161: sm_gpio_161 {
		mux {
			pins = "gpio161";
			function = "gpio";
		};

		config {
			pins = "gpio161";
			drive-strength = <2>;
			bias-disable;
			output-low;
		};
	};

	/* GPIO_162 : TS_INT_N */
	sm_gpio_162: sm_gpio_162 {
		mux {
			pins = "gpio162";
			function = "gpio";
		};

		config {
			pins = "gpio162";
			drive-strength = <2>;
			bias-disable;
			input-enable;
		};
	};

	/* GPIO_163 : NC */
	sm_gpio_163: sm_gpio_163 {
		mux {
			pins = "gpio163";
			function = "gpio";
		};

		config {
			pins = "gpio163";
			drive-strength = <2>;
			bias-pull-down;
			input-enable;
		};
	};

	/* GPIO_164 : NC */
	sm_gpio_164: sm_gpio_164 {
		mux {
			pins = "gpio164";
			function = "gpio";
		};

		config {
			pins = "gpio164";
			drive-strength = <2>;
			bias-pull-down;
			input-enable;
		};
	};

	/* GPIO_165 : WCD_SWR_TX_CLK */
	/* Don't set here */

	/* GPIO_166 : WCD_SWR_TX_DATA0 */
	/* Don't set here */

	/* GPIO_167 : WCD_SWR_TX_DATA1 */
	/* Don't set here */

	/* GPIO_168 : WCD_SWR_RX_CLK */
	/* Don't set here */

	/* GPIO_169 : WCD_SWR_RX_DATA0 */
	/* Don't set here */

	/* GPIO_170 : WCD_SWR_RX_DATA1 */
	/* Don't set here */

	/* GPIO_171 : SM_DMIC1_CLK */
	/* Don't set here */

	/* GPIO_175 : SPK_AMP_I2S_CLK */
	/* Don't set here */

	/* GPIO_176 : SPK_AMP_I2S_WS */
	/* Don't set here */

	/* GPIO_177 : SM_DMIC3_CLK */
	/* Don't set here */

	/* GPIO_178 : SM_DMIC3_DATA */
	/* Don't set here */

	/* GPIO_179 : WCD_SWR_TX_DATA2 */
	/* Don't set here */

	/* GPIO_180 : SPK_AMP_I2S_ASP_DIN */
	/* Don't set here */

	/* GPIO_181 : SPK_AMP_I2S_ASP_DOUT */
	/* Don't set here */

	/*GPIO_182 : SPK_AMP_INT_N */
	sm_gpio_182: sm_gpio_182 {
		mux {
			pins = "gpio182";
			function = "gpio";
		};

		config {
			pins = "gpio182";
			drive-strength = <2>;
			bias-disable;
			input-enable;
		};
	};

	/* GPIO_183 : SPK_AMP_RESET_N */
	sm_gpio_183: sm_gpio_183 {
		mux {
			pins = "gpio183";
			function = "gpio";
		};

		config {
			pins = "gpio183";
			drive-strength = <2>;
			bias-disable;
			output-low;
		};
	};

	/* GPIO_184 : HMT_WLAN_BT_SLIMBUS_CLK */
	/* Don't set here */

	/* GPIO_185 : HMT_WLAN_BT_SLIMBUS_DAT0 */
	/* Don't set here */

	/* GPIO_186 : NC */
	/* Don't set here */

	/* GPIO_187 : BLE_OOB_WAKEUP */
	/* Don't set here */

	/* GPIO_188 : OIS_TELE_I2C_SDA */
	sm_gpio_188: sm_gpio_188 {
		mux {
			pins = "gpio188";
			function = "gpio";
		};

		config {
			pins = "gpio188";
			qcom,remote;
		};
	};

	/* GPIO_189 : OIS_TELE_I2C_SCL */
	sm_gpio_189: sm_gpio_189 {
		mux {
			pins = "gpio189";
			function = "gpio";
		};

		config {
			pins = "gpio189";
			qcom,remote;
		};
	};

	/* GPIO_190 : MAG_I2C_SDA */
	/* Don't set here */

	/* GPIO_191 : MAG_I2C_SCL */
	/* Don't set here */

	/* GPIO_192 : IMU_SPI_MISO */
	/* Don't set here */

	/* GPIO_193 : IMU_SPI_MOSI */
	/* Don't set here */

	/* GPIO_194 : IMU_SPI_CLK */
	/* Don't set here */

	/* GPIO_195 : IMU_SPI_CS_N */
	/* Don't set here */

	/* GPIO_196 : SENSOR_I2C_SDA */
	/* Don't set here */

	/* GPIO_197 : SENSOR_I2C_SCL */
	/* Don't set here */

	/* GPIO_198 : NC */
	/* Don't set here */

	/* GPIO_199 : NC */
	/* Don't set here */

	/* GPIO_200 : NC */
	sm_gpio_200: sm_gpio_200 {
		mux {
			pins = "gpio200";
			function = "gpio";
		};

		config {
			pins = "gpio200";
			drive-strength = <2>;
			bias-pull-down;
			input-enable;
		};
	};

	/* GPIO_201 : OIS_ENABLE_TELE */
	sm_gpio_201: sm_gpio_201 {
		mux {
			pins = "gpio201";
			function = "gpio";
		};

		config {
			pins = "gpio201";
			drive-strength = <2>;
			bias-pull-down;
			input-enable;
		};
	};

	/* GPIO_202 : HMT_BLE_UART_TX */
	/* Follow QC */

	/* GPIO_203 : HMT_BLE_UART_RX */
	/* Follow QC */

	/* GPIO_204 : HMT_HOST_SOL_OUT */
	/* Follow QC */

	/* GPIO_205 : HMT_WLAN_SOL_IN */
	/* Follow QC */

	/* GPIO_206 : NC */
	sm_gpio_206: sm_gpio_206 {
		mux {
			pins = "gpio206";
			function = "gpio";
		};

		config {
			pins = "gpio206";
			drive-strength = <2>;
			bias-pull-down;
			input-enable;
		};
	};

	/* GPIO_207 : NC */
	sm_gpio_207: sm_gpio_207 {
		mux {
			pins = "gpio207";
			function = "gpio";
		};

		config {
			pins = "gpio207";
			drive-strength = <2>;
			bias-pull-down;
			input-enable;
		};
	};

	/* GPIO_208 : NC */
	sm_gpio_208: sm_gpio_208 {
		mux {
			pins = "gpio208";
			function = "gpio";
		};

		config {
			pins = "gpio208";
			drive-strength = <2>;
			bias-pull-down;
			input-enable;
		};
	};

	/* GPIO_209 : NC */
	sm_gpio_209: sm_gpio_209 {
		mux {
			pins = "gpio209";
			function = "gpio";
		};

		config {
			pins = "gpio209";
			drive-strength = <2>;
			bias-pull-down;
			input-enable;
		};
	};

	qcom,qbt_handler {
		status = "disabled";
	};
};

&apps_rsc_drv2 {
	rpmh-regulator-ldob4 {
		compatible = "qcom,rpmh-vrm-regulator";
		qcom,resource-name = "ldob4";
		qcom,regulator-type = "pmic4-ldo";
		qcom,supported-modes =
			<RPMH_REGULATOR_MODE_LPM
			 RPMH_REGULATOR_MODE_HPM>;
		qcom,mode-threshold-currents = <0 10000>;

		L4B: pm_humu_l4: regulator-pm-humu-l4 {
			regulator-name = "pm_humu_l4";
			qcom,set = <RPMH_REGULATOR_SET_ALL>;
			regulator-min-microvolt = <1800000>;
			regulator-max-microvolt = <1800000>;
			qcom,init-voltage = <1800000>;
			qcom,init-mode = <RPMH_REGULATOR_MODE_HPM>;
		};
	};

	rpmh-regulator-ldob12 {
		/delete-property/ proxy-supply;

		L12B: pm_humu_l12: regulator-pm-humu-l12 {
			/delete-property/ qcom,proxy-consumer-enable;
		};
	};

	rpmh-regulator-ldob13 {
		/delete-property/ proxy-supply;

		L13B: pm_humu_l13: regulator-pm-humu-l13 {
			/delete-property/ qcom,proxy-consumer-enable;
		};
	};
};

&pm_v6g_l2 {
	regulator-min-microvolt = <1700000>;
	regulator-max-microvolt = <1700000>;
	qcom,init-voltage = <1700000>;
	status = "okay";
};

&pm_humu_l14 {
	regulator-min-microvolt = <3300000>;
	regulator-max-microvolt = <3300000>;
	qcom,init-voltage = <3300000>;
	status = "okay";
};

&pmk8550_vadc {
	pm8550b_pa_therm2 {
		reg = <PM8550_ADC5_GEN3_AMUX1_GPIO3_100K_PU>;
		label = "pm8550b_pa_therm2";
		qcom,ratiometric;
		qcom,hw-settle-time = <200>;
		qcom,pre-scaling = <1 1>;
		qcom,adc-tm-type = <1>;
	};

	pmk8550_assign3_therm {
		reg = <PMK8550_ADC5_GEN3_AMUX_THM2_GPIO1_100K_PU>;
		label = "pmk8550_assign3_therm";
		qcom,ratiometric;
		qcom,hw-settle-time = <200>;
		qcom,pre-scaling = <1 1>;
		qcom,adc-tm-type = <1>;
	};

	pmk8550_assign4_therm {
		reg = <PMK8550_ADC5_GEN3_AMUX_THM3_GPIO2_100K_PU>;
		label = "pmk8550_assign4_therm";
		qcom,ratiometric;
		qcom,hw-settle-time = <200>;
		qcom,pre-scaling = <1 1>;
		qcom,adc-tm-type = <1>;
	};

	pmk8550_iec_therm {
		reg = <PMK8550_ADC5_GEN3_AMUX_THM6_GPIO5_100K_PU>;
		label = "pmk8550_iec_therm";
		qcom,ratiometric;
		qcom,hw-settle-time = <200>;
		qcom,pre-scaling = <1 1>;
		qcom,adc-tm-type = <1>;
	};
};

&thermal_zones {
	skin-msm-therm {
		status = "disabled";
	};

	cam-flash-therm {
		status = "disabled";
	};

	wlan-therm {
		status = "disabled";
	};

	pa-therm-1 {
		status = "disabled";
	};

	rear-tof-therm {
		status = "disabled";
	};

	usb-therm {
		status = "disabled";
	};

	wls-therm {
		status = "disabled";
	};

	xo-therm {
		status = "disabled";
	};

	sdm_therm {
		polling-delay-passive = <0>;
		polling-delay = <0>;
		thermal-sensors = <&pmk8550_vadc PM8550_ADC5_GEN3_AMUX_THM1_100K_PU>;
		trips {
			active-config0 {
				temperature = <125000>;
				hysteresis = <1000>;
				type = "passive";
			};

			active-config1 {
				temperature = <125000>;
				hysteresis = <1000>;
				type = "passive";
			};
		};
	};

	flash_therm {
		polling-delay-passive = <0>;
		polling-delay = <0>;
		thermal-sensors = <&pmk8550_vadc PM8550_ADC5_GEN3_AMUX_THM2_100K_PU>;
		trips {
			active-config0 {
				temperature = <125000>;
				hysteresis = <1000>;
				type = "passive";
			};

			active-config1 {
				temperature = <125000>;
				hysteresis = <1000>;
				type = "passive";
			};
		};
	};

	assign2_therm {
		polling-delay-passive = <0>;
		polling-delay = <0>;
		thermal-sensors = <&pmk8550_vadc PM8550_ADC5_GEN3_AMUX_THM3_100K_PU>;
		trips {
			active-config0 {
				temperature = <125000>;
				hysteresis = <1000>;
				type = "passive";
			};

			active-config1 {
				temperature = <125000>;
				hysteresis = <1000>;
				type = "passive";
			};
		};
	};

	pa_therm1 {
		polling-delay-passive = <0>;
		polling-delay = <0>;
		thermal-sensors = <&pmk8550_vadc PM8550_ADC5_GEN3_AMUX_THM4_100K_PU>;
		trips {
			active-config0 {
				temperature = <125000>;
				hysteresis = <1000>;
				type = "passive";
			};

			active-config1 {
				temperature = <125000>;
				hysteresis = <1000>;
				type = "passive";
			};
		};
	};

	disp_therm {
		polling-delay-passive = <0>;
		polling-delay = <0>;
		thermal-sensors = <&pmk8550_vadc PM8550_ADC5_GEN3_AMUX_THM5_100K_PU>;
		trips {
			active-config0 {
				temperature = <125000>;
				hysteresis = <1000>;
				type = "passive";
			};

			active-config1 {
				temperature = <125000>;
				hysteresis = <1000>;
				type = "passive";
			};
		};
	};

	usb_therm {
		polling-delay-passive = <0>;
		polling-delay = <0>;
		thermal-sensors = <&pmk8550_vadc PM8550B_ADC5_GEN3_AMUX_THM4_USB_THERM_100K_PU>;
		trips {
			active-config0 {
				temperature = <125000>;
				hysteresis = <1000>;
				type = "passive";
			};

			active-config1 {
				temperature = <125000>;
				hysteresis = <1000>;
				type = "passive";
			};
		};
	};

	assign1_therm {
		polling-delay-passive = <0>;
		polling-delay = <0>;
		thermal-sensors = <&pmk8550_vadc PM8550B_ADC5_GEN3_AMUX_THM6_GPIO10_100K_PU>;
		trips {
			active-config0 {
				temperature = <125000>;
				hysteresis = <1000>;
				type = "passive";
			};

			active-config1 {
				temperature = <125000>;
				hysteresis = <1000>;
				type = "passive";
			};
		};
	};

	xo_therm {
		polling-delay-passive = <0>;
		polling-delay = <0>;
		thermal-sensors = <&pmk8550_vadc PMK8550_ADC5_GEN3_AMUX_THM1_XO_THERM_100K_PU>;
		trips {
			active-config0 {
				temperature = <125000>;
				hysteresis = <1000>;
				type = "passive";
			};

			active-config1 {
				temperature = <125000>;
				hysteresis = <1000>;
				type = "passive";
			};
		};
	};

	pa_therm2 {
		polling-delay-passive = <0>;
		polling-delay = <0>;
		thermal-sensors = <&pmk8550_vadc PM8550_ADC5_GEN3_AMUX1_GPIO3_100K_PU>;
		trips {
			active-config0 {
				temperature = <125000>;
				hysteresis = <1000>;
				type = "passive";
			};

			active-config1 {
				temperature = <125000>;
				hysteresis = <1000>;
				type = "passive";
			};
		};
	};

	assign3_therm {
		polling-delay-passive = <0>;
		polling-delay = <0>;
		thermal-sensors = <&pmk8550_vadc PMK8550_ADC5_GEN3_AMUX_THM2_GPIO1_100K_PU>;
		trips {
			active-config0 {
				temperature = <125000>;
				hysteresis = <1000>;
				type = "passive";
			};

			active-config1 {
				temperature = <125000>;
				hysteresis = <1000>;
				type = "passive";
			};
		};
	};

	assign4_therm {
		polling-delay-passive = <0>;
		polling-delay = <0>;
		thermal-sensors = <&pmk8550_vadc PMK8550_ADC5_GEN3_AMUX_THM3_GPIO2_100K_PU>;
		trips {
			active-config0 {
				temperature = <125000>;
				hysteresis = <1000>;
				type = "passive";
			};

			active-config1 {
				temperature = <125000>;
				hysteresis = <1000>;
				type = "passive";
			};
		};
	};

	iec_therm {
		polling-delay-passive = <0>;
		polling-delay = <0>;
		thermal-sensors = <&pmk8550_vadc PMK8550_ADC5_GEN3_AMUX_THM6_GPIO5_100K_PU>;
		trips {
			active-config0 {
				temperature = <125000>;
				hysteresis = <1000>;
				type = "passive";
			};

			active-config1 {
				temperature = <125000>;
				hysteresis = <1000>;
				type = "passive";
			};
		};
	};

	socd {
		trips {
			socd-trip {
				temperature = <95>;
				hysteresis = <0>;
				type = "passive";
			};
		};
	};
};

&qupv3_se4_spi {
	status = "disabled";
};

&spmi_bus {
	qcom,pmk8550@0 {
		pon_hlos@1300 {
			resin {
				linux,code = <KEY_VOLUMEUP>;
			};
		};
	};
};

&soc {
	gpio_keys {
		pinctrl-0 = <&pm8550_gpio_6
			     &pm8550b_gpio_7
			     &pm8550b_gpio_8>;

		vol_up {
			status = "disabled";
		};

		vol_dn {
			label = "volume_down";
			gpios = <&pm8550_gpios 6 GPIO_ACTIVE_LOW>;
			linux,input-type = <1>;
			linux,code = <KEY_VOLUMEDOWN>;
			gpio-key,wakeup;
			debounce-interval = <15>;
			linux,can-disable;
		};

		cam_snapshot {
			label = "cam_snapshot";
			gpios = <&pm8550b_gpios 7 GPIO_ACTIVE_LOW>;
			linux,input-type = <1>;
			linux,code = <766>;
			gpio-key,wakeup;
			debounce-interval = <15>;
			linux,can-disable;
		};

		cam_focus {
			label = "cam_focus";
			gpios = <&pm8550b_gpios 8 GPIO_ACTIVE_LOW>;
			linux,input-type = <1>;
			linux,code = <KEY_CAMERA_FOCUS>;
			gpio-key,wakeup;
			debounce-interval = <15>;
			linux,can-disable;
		};
	};
};

&usb0 {
	dwc3@a600000 {
		/* Primary USB maximum-speed */
		maximum-speed = "super-speed";
		/* disable USB2 LPM */
		snps,usb2-lpm-disable;
		snps,usb2-gadget-lpm-disable;
	};
};

&sdhc_2 {
	/* forbid DDR50/SDR104 */
	sdhci-caps-mask = <0x6 0x0>;
	cd-gpios = <&pm8550_gpios 12 GPIO_ACTIVE_HIGH>;
};

&pm8550b_haptics {
	status = "disabled";
};

&usb0 {
       pinctrl-names = "unused";
       /delete-property/ pinctrl-0;
       /delete-property/ gpios;
       qcom,disable-host-ssphy-powerdown = <1>;
};

&redriver {
       status = "disabled";
};

&qmc_dma_mem {
       status = "disabled";
};

&usb_qmp_dp_phy {
       pinctrl-names = "default";
};

&pm8550_flash0 {
	qcom,max-current-ma = <1000>;
};

&pm8550_flash3 {
	qcom,max-current-ma = <1000>;
};

&pm8550_torch0 {
	qcom,max-current-ma = <500>;
};

&pm8550_torch3 {
	qcom,max-current-ma = <500>;
};

&pm8550_switch0 {
	qcom,led-mask = <9>; /* Channels 1 & 4 */
	qcom,symmetry-en;
};
