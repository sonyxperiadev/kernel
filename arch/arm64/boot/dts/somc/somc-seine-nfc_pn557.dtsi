// SPDX-License-Identifier: GPL-2.0-only
/*
 * Copyright (c) 2019, The Linux Foundation. All rights reserved.
 */

&qupv3_se1_i2c {
	#address-cells = <1>;
	#size-cells = <0>;

	nfc@28 {
		compatible = "nxp,pn553";
		reg = <0x28>;
		interrupt-parent = <&tlmm>;
		interrupts = <85 0x1>;
		nxp,irq_gpio = <&tlmm 85 0x00>;
		nxp,dwld_en = <&tlmm 84 0x00>;
		nxp,ven = <&tlmm 83 0x01>;
		nxp,ese-pwr = <&tlmm 24 0x00>;
	};
};

&soc {
	nfc,pm-ops {
		compatible = "sony,pn553-pm-ops";
	};
};
