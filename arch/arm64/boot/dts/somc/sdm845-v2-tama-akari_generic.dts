// SPDX-License-Identifier: GPL-2.0-only
/*
 * Copyright (c) 2017, The Linux Foundation. All rights reserved.
 */

/dts-v1/;

#include "../qcom/sdm845-v2.dtsi"
#include "../qcom/sdm845-sde-display.dtsi"
#include "../qcom/sdm845-mtp.dtsi"
#include "sdm845-tama-akari_generic.dtsi"

/ {
	model = "Sony Mobile Communications. Akari(SDM845 v2)";
	compatible = "somc,akari-row", "qcom,sdm845", "qcom,mtp";
	qcom,board-id = <8 0>;
};
