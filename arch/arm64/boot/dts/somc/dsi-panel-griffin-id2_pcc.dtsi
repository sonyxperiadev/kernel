// SPDX-License-Identifier: GPL-2.0-only
/*
 * Copyright (c) 2018, The Linux Foundation. All rights reserved.
 */

/* pcc-table for 4K OLED */
&dsi_2{
	somc,mdss-dsi-uv-command = [
		06 01 00 00 00 00 01 DA
		06 01 00 00 00 00 01 DB];
	somc,mdss-dsi-uv-param-type = <4>;
	somc,mdss-dsi-uv-command-state = "dsi_lp_mode";
	somc,mdss-dsi-pcc-enable;
	somc,mdss-dsi-pcc-table-size = <226>;
	somc,mdss-dsi-pcc-table = <
		0x00 0x01 0x38 0x3B 0x38 0x3B 0x8000 0x8000 0x8000
		0x00 0x02 0x34 0x37 0x38 0x3B 0x8000 0x8000 0x8000
		0x00 0x03 0x30 0x33 0x38 0x3B 0x8000 0x8000 0x8000
		0x00 0x04 0x2C 0x2F 0x38 0x3B 0x8000 0x8000 0x8000
		0x00 0x05 0x28 0x2B 0x38 0x3B 0x8000 0x8000 0x8000
		0x00 0x06 0x24 0x27 0x38 0x3B 0x8000 0x8000 0x8000
		0x00 0x07 0x20 0x23 0x38 0x3B 0x8000 0x8000 0x8000
		0x00 0x08 0x1C 0x1F 0x38 0x3B 0x8000 0x8000 0x8000
		0x00 0x09 0x18 0x1B 0x38 0x3B 0x8000 0x8000 0x8000
		0x00 0x0A 0x14 0x17 0x38 0x3B 0x8000 0x8000 0x8000
		0x00 0x0B 0x10 0x13 0x38 0x3B 0x8000 0x8000 0x8000
		0x00 0x0C 0x0C 0x0F 0x38 0x3B 0x8000 0x8000 0x8000
		0x00 0x0D 0x08 0x0B 0x38 0x3B 0x8000 0x8000 0x8000
		0x00 0x0E 0x04 0x07 0x38 0x3B 0x8000 0x8000 0x8000
		0x00 0x0F 0x00 0x03 0x38 0x3B 0x8000 0x8000 0x8000
		0x00 0x10 0x38 0x3B 0x34 0x37 0x8000 0x8000 0x8000
		0x00 0x11 0x34 0x37 0x34 0x37 0x8000 0x8000 0x8000
		0x00 0x12 0x30 0x33 0x34 0x37 0x8000 0x8000 0x8000
		0x00 0x13 0x2C 0x2F 0x34 0x37 0x8000 0x8000 0x8000
		0x00 0x14 0x28 0x2B 0x34 0x37 0x8000 0x8000 0x8000
		0x00 0x15 0x24 0x27 0x34 0x37 0x8000 0x8000 0x8000
		0x00 0x16 0x20 0x23 0x34 0x37 0x8000 0x8000 0x8000
		0x00 0x17 0x1C 0x1F 0x34 0x37 0x8000 0x8000 0x8000
		0x00 0x18 0x18 0x1B 0x34 0x37 0x8000 0x8000 0x8000
		0x00 0x19 0x14 0x17 0x34 0x37 0x8000 0x8000 0x8000
		0x00 0x1A 0x10 0x13 0x34 0x37 0x8000 0x8000 0x8000
		0x00 0x1B 0x0C 0x0F 0x34 0x37 0x8000 0x8000 0x8000
		0x00 0x1C 0x08 0x0B 0x34 0x37 0x8000 0x8000 0x8000
		0x00 0x1D 0x04 0x07 0x34 0x37 0x8000 0x8000 0x8000
		0x00 0x1E 0x00 0x03 0x34 0x37 0x8000 0x8000 0x8000
		0x00 0x1F 0x38 0x3B 0x30 0x33 0x8000 0x8000 0x8000
		0x00 0x20 0x34 0x37 0x30 0x33 0x8000 0x8000 0x8000
		0x00 0x21 0x30 0x33 0x30 0x33 0x8000 0x8000 0x8000
		0x00 0x22 0x2C 0x2F 0x30 0x33 0x8000 0x8000 0x8000
		0x00 0x23 0x28 0x2B 0x30 0x33 0x8000 0x8000 0x8000
		0x00 0x24 0x24 0x27 0x30 0x33 0x8000 0x8000 0x8000
		0x00 0x25 0x20 0x23 0x30 0x33 0x8000 0x8000 0x8000
		0x00 0x26 0x1C 0x1F 0x30 0x33 0x8000 0x8000 0x8000
		0x00 0x27 0x18 0x1B 0x30 0x33 0x8000 0x8000 0x8000
		0x00 0x28 0x14 0x17 0x30 0x33 0x8000 0x8000 0x8000
		0x00 0x29 0x10 0x13 0x30 0x33 0x8000 0x8000 0x8000
		0x00 0x2A 0x0C 0x0F 0x30 0x33 0x8000 0x8000 0x8000
		0x00 0x2B 0x08 0x0B 0x30 0x33 0x8000 0x8000 0x8000
		0x00 0x2C 0x04 0x07 0x30 0x33 0x8000 0x8000 0x8000
		0x00 0x2D 0x00 0x03 0x30 0x33 0x8000 0x8000 0x8000
		0x00 0x2E 0x38 0x3B 0x2C 0x2F 0x8000 0x8000 0x8000
		0x00 0x2F 0x34 0x37 0x2C 0x2F 0x8000 0x8000 0x8000
		0x00 0x30 0x30 0x33 0x2C 0x2F 0x8000 0x8000 0x8000
		0x00 0x31 0x2C 0x2F 0x2C 0x2F 0x8000 0x8000 0x8000
		0x00 0x32 0x28 0x2B 0x2C 0x2F 0x8000 0x8000 0x8000
		0x00 0x33 0x24 0x27 0x2C 0x2F 0x8000 0x8000 0x8000
		0x00 0x34 0x20 0x23 0x2C 0x2F 0x8000 0x8000 0x8000
		0x00 0x35 0x1C 0x1F 0x2C 0x2F 0x8000 0x8000 0x8000
		0x00 0x36 0x18 0x1B 0x2C 0x2F 0x8000 0x8000 0x8000
		0x00 0x37 0x14 0x17 0x2C 0x2F 0x8000 0x8000 0x8000
		0x00 0x38 0x10 0x13 0x2C 0x2F 0x8000 0x8000 0x8000
		0x00 0x39 0x0C 0x0F 0x2C 0x2F 0x8000 0x8000 0x8000
		0x00 0x3A 0x08 0x0B 0x2C 0x2F 0x8000 0x8000 0x8000
		0x00 0x3B 0x04 0x07 0x2C 0x2F 0x8000 0x8000 0x8000
		0x00 0x3C 0x00 0x03 0x2C 0x2F 0x8000 0x8000 0x8000
		0x00 0x3D 0x38 0x3B 0x28 0x2B 0x8000 0x8000 0x8000
		0x00 0x3E 0x34 0x37 0x28 0x2B 0x8000 0x8000 0x8000
		0x00 0x3F 0x30 0x33 0x28 0x2B 0x8000 0x8000 0x8000
		0x00 0x40 0x2C 0x2F 0x28 0x2B 0x8000 0x8000 0x8000
		0x00 0x41 0x28 0x2B 0x28 0x2B 0x8000 0x8000 0x8000
		0x00 0x42 0x24 0x27 0x28 0x2B 0x8000 0x8000 0x8000
		0x00 0x43 0x20 0x23 0x28 0x2B 0x8000 0x8000 0x8000
		0x00 0x44 0x1C 0x1F 0x28 0x2B 0x8000 0x8000 0x8000
		0x00 0x45 0x18 0x1B 0x28 0x2B 0x8000 0x8000 0x8000
		0x00 0x46 0x14 0x17 0x28 0x2B 0x8000 0x8000 0x8000
		0x00 0x47 0x10 0x13 0x28 0x2B 0x8000 0x8000 0x8000
		0x00 0x48 0x0C 0x0F 0x28 0x2B 0x8000 0x8000 0x8000
		0x00 0x49 0x08 0x0B 0x28 0x2B 0x8000 0x8000 0x8000
		0x00 0x4A 0x04 0x07 0x28 0x2B 0x8000 0x8000 0x8000
		0x00 0x4B 0x00 0x03 0x28 0x2B 0x8000 0x8000 0x8000
		0x00 0x4C 0x38 0x3B 0x24 0x27 0x8000 0x8000 0x8000
		0x00 0x4D 0x34 0x37 0x24 0x27 0x8000 0x8000 0x8000
		0x00 0x4E 0x30 0x33 0x24 0x27 0x8000 0x8000 0x8000
		0x00 0x4F 0x2C 0x2F 0x24 0x27 0x8000 0x8000 0x8000
		0x00 0x50 0x28 0x2B 0x24 0x27 0x8000 0x8000 0x8000
		0x00 0x51 0x24 0x27 0x24 0x27 0x8000 0x8000 0x8000
		0x00 0x52 0x20 0x23 0x24 0x27 0x8000 0x8000 0x8000
		0x00 0x53 0x1C 0x1F 0x24 0x27 0x8000 0x8000 0x8000
		0x00 0x54 0x18 0x1B 0x24 0x27 0x8000 0x8000 0x8000
		0x00 0x55 0x14 0x17 0x24 0x27 0x8000 0x8000 0x8000
		0x00 0x56 0x10 0x13 0x24 0x27 0x8000 0x8000 0x8000
		0x00 0x57 0x0C 0x0F 0x24 0x27 0x8000 0x8000 0x8000
		0x00 0x58 0x08 0x0B 0x24 0x27 0x8000 0x8000 0x8000
		0x00 0x59 0x04 0x07 0x24 0x27 0x8000 0x8000 0x8000
		0x00 0x5A 0x00 0x03 0x24 0x27 0x8000 0x8000 0x8000
		0x00 0x5B 0x38 0x3B 0x20 0x23 0x8000 0x8000 0x8000
		0x00 0x5C 0x34 0x37 0x20 0x23 0x8000 0x8000 0x8000
		0x00 0x5D 0x30 0x33 0x20 0x23 0x8000 0x8000 0x8000
		0x00 0x5E 0x2C 0x2F 0x20 0x23 0x8000 0x8000 0x8000
		0x00 0x5F 0x28 0x2B 0x20 0x23 0x8000 0x8000 0x8000
		0x00 0x60 0x24 0x27 0x20 0x23 0x8000 0x8000 0x8000
		0x00 0x61 0x20 0x23 0x20 0x23 0x8000 0x8000 0x8000
		0x00 0x62 0x1C 0x1F 0x20 0x23 0x8000 0x8000 0x8000
		0x00 0x63 0x18 0x1B 0x20 0x23 0x8000 0x8000 0x8000
		0x00 0x64 0x14 0x17 0x20 0x23 0x8000 0x8000 0x8000
		0x00 0x65 0x10 0x13 0x20 0x23 0x8000 0x8000 0x8000
		0x00 0x66 0x0C 0x0F 0x20 0x23 0x8000 0x8000 0x8000
		0x00 0x67 0x08 0x0B 0x20 0x23 0x8000 0x8000 0x8000
		0x00 0x68 0x04 0x07 0x20 0x23 0x8000 0x8000 0x8000
		0x00 0x69 0x00 0x03 0x20 0x23 0x8000 0x8000 0x8000
		0x00 0x6A 0x38 0x3B 0x1C 0x1F 0x8000 0x8000 0x8000
		0x00 0x6B 0x34 0x37 0x1C 0x1F 0x8000 0x8000 0x8000
		0x00 0x6C 0x30 0x33 0x1C 0x1F 0x8000 0x8000 0x8000
		0x00 0x6D 0x2C 0x2F 0x1C 0x1F 0x8000 0x8000 0x8000
		0x00 0x6E 0x28 0x2B 0x1C 0x1F 0x8000 0x8000 0x8000
		0x00 0x6F 0x24 0x27 0x1C 0x1F 0x8000 0x8000 0x8000
		0x00 0x70 0x20 0x23 0x1C 0x1F 0x8000 0x8000 0x8000
		0x00 0x71 0x1C 0x1F 0x1C 0x1F 0x8000 0x8000 0x8000
		0x00 0x72 0x18 0x1B 0x1C 0x1F 0x8000 0x8000 0x8000
		0x00 0x73 0x14 0x17 0x1C 0x1F 0x8000 0x8000 0x8000
		0x00 0x74 0x10 0x13 0x1C 0x1F 0x8000 0x8000 0x8000
		0x00 0x75 0x0C 0x0F 0x1C 0x1F 0x8000 0x8000 0x8000
		0x00 0x76 0x08 0x0B 0x1C 0x1F 0x8000 0x8000 0x8000
		0x00 0x77 0x04 0x07 0x1C 0x1F 0x8000 0x8000 0x8000
		0x00 0x78 0x00 0x03 0x1C 0x1F 0x8000 0x8000 0x8000
		0x00 0x79 0x38 0x3B 0x18 0x1B 0x8000 0x8000 0x8000
		0x00 0x7A 0x34 0x37 0x18 0x1B 0x8000 0x8000 0x8000
		0x00 0x7B 0x30 0x33 0x18 0x1B 0x8000 0x8000 0x8000
		0x00 0x7C 0x2C 0x2F 0x18 0x1B 0x8000 0x8000 0x8000
		0x00 0x7D 0x28 0x2B 0x18 0x1B 0x8000 0x8000 0x8000
		0x00 0x7E 0x24 0x27 0x18 0x1B 0x8000 0x8000 0x8000
		0x00 0x7F 0x20 0x23 0x18 0x1B 0x8000 0x8000 0x8000
		0x00 0x80 0x1C 0x1F 0x18 0x1B 0x8000 0x8000 0x8000
		0x00 0x81 0x18 0x1B 0x18 0x1B 0x8000 0x8000 0x8000
		0x00 0x82 0x14 0x17 0x18 0x1B 0x8000 0x8000 0x8000
		0x00 0x83 0x10 0x13 0x18 0x1B 0x8000 0x8000 0x8000
		0x00 0x84 0x0C 0x0F 0x18 0x1B 0x8000 0x8000 0x8000
		0x00 0x85 0x08 0x0B 0x18 0x1B 0x8000 0x8000 0x8000
		0x00 0x86 0x04 0x07 0x18 0x1B 0x8000 0x8000 0x8000
		0x00 0x87 0x00 0x03 0x18 0x1B 0x8000 0x8000 0x8000
		0x00 0x88 0x38 0x3B 0x14 0x17 0x8000 0x8000 0x8000
		0x00 0x89 0x34 0x37 0x14 0x17 0x8000 0x8000 0x8000
		0x00 0x8A 0x30 0x33 0x14 0x17 0x8000 0x8000 0x8000
		0x00 0x8B 0x2C 0x2F 0x14 0x17 0x8000 0x8000 0x8000
		0x00 0x8C 0x28 0x2B 0x14 0x17 0x8000 0x8000 0x8000
		0x00 0x8D 0x24 0x27 0x14 0x17 0x8000 0x8000 0x8000
		0x00 0x8E 0x20 0x23 0x14 0x17 0x8000 0x8000 0x8000
		0x00 0x8F 0x1C 0x1F 0x14 0x17 0x8000 0x8000 0x8000
		0x00 0x90 0x18 0x1B 0x14 0x17 0x8000 0x8000 0x8000
		0x00 0x91 0x14 0x17 0x14 0x17 0x8000 0x8000 0x8000
		0x00 0x92 0x10 0x13 0x14 0x17 0x8000 0x8000 0x8000
		0x00 0x93 0x0C 0x0F 0x14 0x17 0x8000 0x8000 0x8000
		0x00 0x94 0x08 0x0B 0x14 0x17 0x8000 0x8000 0x8000
		0x00 0x95 0x04 0x07 0x14 0x17 0x8000 0x8000 0x8000
		0x00 0x96 0x00 0x03 0x14 0x17 0x8000 0x8000 0x8000
		0x00 0x97 0x38 0x3B 0x10 0x13 0x8000 0x8000 0x8000
		0x00 0x98 0x34 0x37 0x10 0x13 0x8000 0x8000 0x8000
		0x00 0x99 0x30 0x33 0x10 0x13 0x8000 0x8000 0x8000
		0x00 0x9A 0x2C 0x2F 0x10 0x13 0x8000 0x8000 0x8000
		0x00 0x9B 0x28 0x2B 0x10 0x13 0x8000 0x8000 0x8000
		0x00 0x9C 0x24 0x27 0x10 0x13 0x8000 0x8000 0x8000
		0x00 0x9D 0x20 0x23 0x10 0x13 0x8000 0x8000 0x8000
		0x00 0x9E 0x1C 0x1F 0x10 0x13 0x8000 0x8000 0x8000
		0x00 0x9F 0x18 0x1B 0x10 0x13 0x8000 0x8000 0x8000
		0x00 0xA0 0x14 0x17 0x10 0x13 0x8000 0x8000 0x8000
		0x00 0xA1 0x10 0x13 0x10 0x13 0x8000 0x8000 0x8000
		0x00 0xA2 0x0C 0x0F 0x10 0x13 0x8000 0x8000 0x8000
		0x00 0xA3 0x08 0x0B 0x10 0x13 0x8000 0x8000 0x8000
		0x00 0xA4 0x04 0x07 0x10 0x13 0x8000 0x8000 0x8000
		0x00 0xA5 0x00 0x03 0x10 0x13 0x8000 0x8000 0x8000
		0x00 0xA6 0x38 0x3B 0x0C 0x0F 0x8000 0x8000 0x8000
		0x00 0xA7 0x34 0x37 0x0C 0x0F 0x8000 0x8000 0x8000
		0x00 0xA8 0x30 0x33 0x0C 0x0F 0x8000 0x8000 0x8000
		0x00 0xA9 0x2C 0x2F 0x0C 0x0F 0x8000 0x8000 0x8000
		0x00 0xAA 0x28 0x2B 0x0C 0x0F 0x8000 0x8000 0x8000
		0x00 0xAB 0x24 0x27 0x0C 0x0F 0x8000 0x8000 0x8000
		0x00 0xAC 0x20 0x23 0x0C 0x0F 0x8000 0x8000 0x8000
		0x00 0xAD 0x1C 0x1F 0x0C 0x0F 0x8000 0x8000 0x8000
		0x00 0xAE 0x18 0x1B 0x0C 0x0F 0x8000 0x8000 0x8000
		0x00 0xAF 0x14 0x17 0x0C 0x0F 0x8000 0x8000 0x8000
		0x00 0xB0 0x10 0x13 0x0C 0x0F 0x8000 0x8000 0x8000
		0x00 0xB1 0x0C 0x0F 0x0C 0x0F 0x8000 0x8000 0x8000
		0x00 0xB2 0x08 0x0B 0x0C 0x0F 0x8000 0x8000 0x8000
		0x00 0xB3 0x04 0x07 0x0C 0x0F 0x8000 0x8000 0x8000
		0x00 0xB4 0x00 0x03 0x0C 0x0F 0x8000 0x8000 0x8000
		0x00 0xB5 0x38 0x3B 0x08 0x0B 0x8000 0x8000 0x8000
		0x00 0xB6 0x34 0x37 0x08 0x0B 0x8000 0x8000 0x8000
		0x00 0xB7 0x30 0x33 0x08 0x0B 0x8000 0x8000 0x8000
		0x00 0xB8 0x2C 0x2F 0x08 0x0B 0x8000 0x8000 0x8000
		0x00 0xB9 0x28 0x2B 0x08 0x0B 0x8000 0x8000 0x8000
		0x00 0xBA 0x24 0x27 0x08 0x0B 0x8000 0x8000 0x8000
		0x00 0xBB 0x20 0x23 0x08 0x0B 0x8000 0x8000 0x8000
		0x00 0xBC 0x1C 0x1F 0x08 0x0B 0x8000 0x8000 0x8000
		0x00 0xBD 0x18 0x1B 0x08 0x0B 0x8000 0x8000 0x8000
		0x00 0xBE 0x14 0x17 0x08 0x0B 0x8000 0x8000 0x8000
		0x00 0xBF 0x10 0x13 0x08 0x0B 0x8000 0x8000 0x8000
		0x00 0xC0 0x0C 0x0F 0x08 0x0B 0x8000 0x8000 0x8000
		0x00 0xC1 0x08 0x0B 0x08 0x0B 0x8000 0x8000 0x8000
		0x00 0xC2 0x04 0x07 0x08 0x0B 0x8000 0x8000 0x8000
		0x00 0xC3 0x00 0x03 0x08 0x0B 0x8000 0x8000 0x8000
		0x00 0xC4 0x38 0x3B 0x04 0x07 0x8000 0x8000 0x8000
		0x00 0xC5 0x34 0x37 0x04 0x07 0x8000 0x8000 0x8000
		0x00 0xC6 0x30 0x33 0x04 0x07 0x8000 0x8000 0x8000
		0x00 0xC7 0x2C 0x2F 0x04 0x07 0x8000 0x8000 0x8000
		0x00 0xC8 0x28 0x2B 0x04 0x07 0x8000 0x8000 0x8000
		0x00 0xC9 0x24 0x27 0x04 0x07 0x8000 0x8000 0x8000
		0x00 0xCA 0x20 0x23 0x04 0x07 0x8000 0x8000 0x8000
		0x00 0xCB 0x1C 0x1F 0x04 0x07 0x8000 0x8000 0x8000
		0x00 0xCC 0x18 0x1B 0x04 0x07 0x8000 0x8000 0x8000
		0x00 0xCD 0x14 0x17 0x04 0x07 0x8000 0x8000 0x8000
		0x00 0xCE 0x10 0x13 0x04 0x07 0x8000 0x8000 0x8000
		0x00 0xCF 0x0C 0x0F 0x04 0x07 0x8000 0x8000 0x8000
		0x00 0xD0 0x08 0x0B 0x04 0x07 0x8000 0x8000 0x8000
		0x00 0xD1 0x04 0x07 0x04 0x07 0x8000 0x8000 0x8000
		0x00 0xD2 0x00 0x03 0x04 0x07 0x8000 0x8000 0x8000
		0x00 0xD3 0x38 0x3B 0x00 0x03 0x8000 0x8000 0x8000
		0x00 0xD4 0x34 0x37 0x00 0x03 0x8000 0x8000 0x8000
		0x00 0xD5 0x30 0x33 0x00 0x03 0x8000 0x8000 0x8000
		0x00 0xD6 0x2C 0x2F 0x00 0x03 0x8000 0x8000 0x8000
		0x00 0xD7 0x28 0x2B 0x00 0x03 0x8000 0x8000 0x8000
		0x00 0xD8 0x24 0x27 0x00 0x03 0x8000 0x8000 0x8000
		0x00 0xD9 0x20 0x23 0x00 0x03 0x8000 0x8000 0x8000
		0x00 0xDA 0x1C 0x1F 0x00 0x03 0x8000 0x8000 0x8000
		0x00 0xDB 0x18 0x1B 0x00 0x03 0x8000 0x8000 0x8000
		0x00 0xDC 0x14 0x17 0x00 0x03 0x8000 0x8000 0x8000
		0x00 0xDD 0x10 0x13 0x00 0x03 0x8000 0x8000 0x8000
		0x00 0xDE 0x0C 0x0F 0x00 0x03 0x8000 0x8000 0x8000
		0x00 0xDF 0x08 0x0B 0x00 0x03 0x8000 0x8000 0x8000
		0x00 0xE0 0x04 0x07 0x00 0x03 0x8000 0x8000 0x8000
		0x00 0xE1 0x00 0x03 0x00 0x03 0x8000 0x8000 0x8000
		0xFF 0x00 0x0E 0x38 0x0C 0x2F 0x8000 0x8000 0x8000>;

	somc,mdss-dsi-srgb-pcc-enable;
	somc,mdss-dsi-srgb-pcc-table-size = <226>;
	somc,mdss-dsi-srgb-pcc-table = <
		0x00 0x01 0x38 0x3B 0x38 0x3B 0x8000 0x8000 0x8000
		0x00 0x02 0x34 0x37 0x38 0x3B 0x8000 0x8000 0x8000
		0x00 0x03 0x30 0x33 0x38 0x3B 0x8000 0x8000 0x8000
		0x00 0x04 0x2C 0x2F 0x38 0x3B 0x8000 0x8000 0x8000
		0x00 0x05 0x28 0x2B 0x38 0x3B 0x8000 0x8000 0x8000
		0x00 0x06 0x24 0x27 0x38 0x3B 0x8000 0x8000 0x8000
		0x00 0x07 0x20 0x23 0x38 0x3B 0x8000 0x8000 0x8000
		0x00 0x08 0x1C 0x1F 0x38 0x3B 0x8000 0x8000 0x8000
		0x00 0x09 0x18 0x1B 0x38 0x3B 0x8000 0x8000 0x8000
		0x00 0x0A 0x14 0x17 0x38 0x3B 0x8000 0x8000 0x8000
		0x00 0x0B 0x10 0x13 0x38 0x3B 0x8000 0x8000 0x8000
		0x00 0x0C 0x0C 0x0F 0x38 0x3B 0x8000 0x8000 0x8000
		0x00 0x0D 0x08 0x0B 0x38 0x3B 0x8000 0x8000 0x8000
		0x00 0x0E 0x04 0x07 0x38 0x3B 0x8000 0x8000 0x8000
		0x00 0x0F 0x00 0x03 0x38 0x3B 0x8000 0x8000 0x8000
		0x00 0x10 0x38 0x3B 0x34 0x37 0x8000 0x8000 0x8000
		0x00 0x11 0x34 0x37 0x34 0x37 0x8000 0x8000 0x8000
		0x00 0x12 0x30 0x33 0x34 0x37 0x8000 0x8000 0x8000
		0x00 0x13 0x2C 0x2F 0x34 0x37 0x8000 0x8000 0x8000
		0x00 0x14 0x28 0x2B 0x34 0x37 0x8000 0x8000 0x8000
		0x00 0x15 0x24 0x27 0x34 0x37 0x8000 0x8000 0x8000
		0x00 0x16 0x20 0x23 0x34 0x37 0x8000 0x8000 0x8000
		0x00 0x17 0x1C 0x1F 0x34 0x37 0x8000 0x8000 0x8000
		0x00 0x18 0x18 0x1B 0x34 0x37 0x8000 0x8000 0x8000
		0x00 0x19 0x14 0x17 0x34 0x37 0x8000 0x8000 0x8000
		0x00 0x1A 0x10 0x13 0x34 0x37 0x8000 0x8000 0x8000
		0x00 0x1B 0x0C 0x0F 0x34 0x37 0x8000 0x8000 0x8000
		0x00 0x1C 0x08 0x0B 0x34 0x37 0x8000 0x8000 0x8000
		0x00 0x1D 0x04 0x07 0x34 0x37 0x8000 0x8000 0x8000
		0x00 0x1E 0x00 0x03 0x34 0x37 0x8000 0x8000 0x8000
		0x00 0x1F 0x38 0x3B 0x30 0x33 0x8000 0x8000 0x8000
		0x00 0x20 0x34 0x37 0x30 0x33 0x8000 0x8000 0x8000
		0x00 0x21 0x30 0x33 0x30 0x33 0x8000 0x8000 0x8000
		0x00 0x22 0x2C 0x2F 0x30 0x33 0x8000 0x8000 0x8000
		0x00 0x23 0x28 0x2B 0x30 0x33 0x8000 0x8000 0x8000
		0x00 0x24 0x24 0x27 0x30 0x33 0x8000 0x8000 0x8000
		0x00 0x25 0x20 0x23 0x30 0x33 0x8000 0x8000 0x8000
		0x00 0x26 0x1C 0x1F 0x30 0x33 0x8000 0x8000 0x8000
		0x00 0x27 0x18 0x1B 0x30 0x33 0x8000 0x8000 0x8000
		0x00 0x28 0x14 0x17 0x30 0x33 0x8000 0x8000 0x8000
		0x00 0x29 0x10 0x13 0x30 0x33 0x8000 0x8000 0x8000
		0x00 0x2A 0x0C 0x0F 0x30 0x33 0x8000 0x8000 0x8000
		0x00 0x2B 0x08 0x0B 0x30 0x33 0x8000 0x8000 0x8000
		0x00 0x2C 0x04 0x07 0x30 0x33 0x8000 0x8000 0x8000
		0x00 0x2D 0x00 0x03 0x30 0x33 0x8000 0x8000 0x8000
		0x00 0x2E 0x38 0x3B 0x2C 0x2F 0x8000 0x8000 0x8000
		0x00 0x2F 0x34 0x37 0x2C 0x2F 0x8000 0x8000 0x8000
		0x00 0x30 0x30 0x33 0x2C 0x2F 0x8000 0x8000 0x8000
		0x00 0x31 0x2C 0x2F 0x2C 0x2F 0x8000 0x8000 0x8000
		0x00 0x32 0x28 0x2B 0x2C 0x2F 0x8000 0x8000 0x8000
		0x00 0x33 0x24 0x27 0x2C 0x2F 0x8000 0x8000 0x8000
		0x00 0x34 0x20 0x23 0x2C 0x2F 0x8000 0x8000 0x8000
		0x00 0x35 0x1C 0x1F 0x2C 0x2F 0x8000 0x8000 0x8000
		0x00 0x36 0x18 0x1B 0x2C 0x2F 0x8000 0x8000 0x8000
		0x00 0x37 0x14 0x17 0x2C 0x2F 0x8000 0x8000 0x8000
		0x00 0x38 0x10 0x13 0x2C 0x2F 0x8000 0x8000 0x8000
		0x00 0x39 0x0C 0x0F 0x2C 0x2F 0x8000 0x8000 0x8000
		0x00 0x3A 0x08 0x0B 0x2C 0x2F 0x8000 0x8000 0x8000
		0x00 0x3B 0x04 0x07 0x2C 0x2F 0x8000 0x8000 0x8000
		0x00 0x3C 0x00 0x03 0x2C 0x2F 0x8000 0x8000 0x8000
		0x00 0x3D 0x38 0x3B 0x28 0x2B 0x8000 0x8000 0x8000
		0x00 0x3E 0x34 0x37 0x28 0x2B 0x8000 0x8000 0x8000
		0x00 0x3F 0x30 0x33 0x28 0x2B 0x8000 0x8000 0x8000
		0x00 0x40 0x2C 0x2F 0x28 0x2B 0x8000 0x8000 0x8000
		0x00 0x41 0x28 0x2B 0x28 0x2B 0x8000 0x8000 0x8000
		0x00 0x42 0x24 0x27 0x28 0x2B 0x8000 0x8000 0x8000
		0x00 0x43 0x20 0x23 0x28 0x2B 0x8000 0x8000 0x8000
		0x00 0x44 0x1C 0x1F 0x28 0x2B 0x8000 0x8000 0x8000
		0x00 0x45 0x18 0x1B 0x28 0x2B 0x8000 0x8000 0x8000
		0x00 0x46 0x14 0x17 0x28 0x2B 0x8000 0x8000 0x8000
		0x00 0x47 0x10 0x13 0x28 0x2B 0x8000 0x8000 0x8000
		0x00 0x48 0x0C 0x0F 0x28 0x2B 0x8000 0x8000 0x8000
		0x00 0x49 0x08 0x0B 0x28 0x2B 0x8000 0x8000 0x8000
		0x00 0x4A 0x04 0x07 0x28 0x2B 0x8000 0x8000 0x8000
		0x00 0x4B 0x00 0x03 0x28 0x2B 0x8000 0x8000 0x8000
		0x00 0x4C 0x38 0x3B 0x24 0x27 0x8000 0x8000 0x8000
		0x00 0x4D 0x34 0x37 0x24 0x27 0x8000 0x8000 0x8000
		0x00 0x4E 0x30 0x33 0x24 0x27 0x8000 0x8000 0x8000
		0x00 0x4F 0x2C 0x2F 0x24 0x27 0x8000 0x8000 0x8000
		0x00 0x50 0x28 0x2B 0x24 0x27 0x8000 0x8000 0x8000
		0x00 0x51 0x24 0x27 0x24 0x27 0x8000 0x8000 0x8000
		0x00 0x52 0x20 0x23 0x24 0x27 0x8000 0x8000 0x8000
		0x00 0x53 0x1C 0x1F 0x24 0x27 0x8000 0x8000 0x8000
		0x00 0x54 0x18 0x1B 0x24 0x27 0x8000 0x8000 0x8000
		0x00 0x55 0x14 0x17 0x24 0x27 0x8000 0x8000 0x8000
		0x00 0x56 0x10 0x13 0x24 0x27 0x8000 0x8000 0x8000
		0x00 0x57 0x0C 0x0F 0x24 0x27 0x8000 0x8000 0x8000
		0x00 0x58 0x08 0x0B 0x24 0x27 0x8000 0x8000 0x8000
		0x00 0x59 0x04 0x07 0x24 0x27 0x8000 0x8000 0x8000
		0x00 0x5A 0x00 0x03 0x24 0x27 0x8000 0x8000 0x8000
		0x00 0x5B 0x38 0x3B 0x20 0x23 0x8000 0x8000 0x8000
		0x00 0x5C 0x34 0x37 0x20 0x23 0x8000 0x8000 0x8000
		0x00 0x5D 0x30 0x33 0x20 0x23 0x8000 0x8000 0x8000
		0x00 0x5E 0x2C 0x2F 0x20 0x23 0x8000 0x8000 0x8000
		0x00 0x5F 0x28 0x2B 0x20 0x23 0x8000 0x8000 0x8000
		0x00 0x60 0x24 0x27 0x20 0x23 0x8000 0x8000 0x8000
		0x00 0x61 0x20 0x23 0x20 0x23 0x8000 0x8000 0x8000
		0x00 0x62 0x1C 0x1F 0x20 0x23 0x8000 0x8000 0x8000
		0x00 0x63 0x18 0x1B 0x20 0x23 0x8000 0x8000 0x8000
		0x00 0x64 0x14 0x17 0x20 0x23 0x8000 0x8000 0x8000
		0x00 0x65 0x10 0x13 0x20 0x23 0x8000 0x8000 0x8000
		0x00 0x66 0x0C 0x0F 0x20 0x23 0x8000 0x8000 0x8000
		0x00 0x67 0x08 0x0B 0x20 0x23 0x8000 0x8000 0x8000
		0x00 0x68 0x04 0x07 0x20 0x23 0x8000 0x8000 0x8000
		0x00 0x69 0x00 0x03 0x20 0x23 0x8000 0x8000 0x8000
		0x00 0x6A 0x38 0x3B 0x1C 0x1F 0x8000 0x8000 0x8000
		0x00 0x6B 0x34 0x37 0x1C 0x1F 0x8000 0x8000 0x8000
		0x00 0x6C 0x30 0x33 0x1C 0x1F 0x8000 0x8000 0x8000
		0x00 0x6D 0x2C 0x2F 0x1C 0x1F 0x8000 0x8000 0x8000
		0x00 0x6E 0x28 0x2B 0x1C 0x1F 0x8000 0x8000 0x8000
		0x00 0x6F 0x24 0x27 0x1C 0x1F 0x8000 0x8000 0x8000
		0x00 0x70 0x20 0x23 0x1C 0x1F 0x8000 0x8000 0x8000
		0x00 0x71 0x1C 0x1F 0x1C 0x1F 0x8000 0x8000 0x8000
		0x00 0x72 0x18 0x1B 0x1C 0x1F 0x8000 0x8000 0x8000
		0x00 0x73 0x14 0x17 0x1C 0x1F 0x8000 0x8000 0x8000
		0x00 0x74 0x10 0x13 0x1C 0x1F 0x8000 0x8000 0x8000
		0x00 0x75 0x0C 0x0F 0x1C 0x1F 0x8000 0x8000 0x8000
		0x00 0x76 0x08 0x0B 0x1C 0x1F 0x8000 0x8000 0x8000
		0x00 0x77 0x04 0x07 0x1C 0x1F 0x8000 0x8000 0x8000
		0x00 0x78 0x00 0x03 0x1C 0x1F 0x8000 0x8000 0x8000
		0x00 0x79 0x38 0x3B 0x18 0x1B 0x8000 0x8000 0x8000
		0x00 0x7A 0x34 0x37 0x18 0x1B 0x8000 0x8000 0x8000
		0x00 0x7B 0x30 0x33 0x18 0x1B 0x8000 0x8000 0x8000
		0x00 0x7C 0x2C 0x2F 0x18 0x1B 0x8000 0x8000 0x8000
		0x00 0x7D 0x28 0x2B 0x18 0x1B 0x8000 0x8000 0x8000
		0x00 0x7E 0x24 0x27 0x18 0x1B 0x8000 0x8000 0x8000
		0x00 0x7F 0x20 0x23 0x18 0x1B 0x8000 0x8000 0x8000
		0x00 0x80 0x1C 0x1F 0x18 0x1B 0x8000 0x8000 0x8000
		0x00 0x81 0x18 0x1B 0x18 0x1B 0x8000 0x8000 0x8000
		0x00 0x82 0x14 0x17 0x18 0x1B 0x8000 0x8000 0x8000
		0x00 0x83 0x10 0x13 0x18 0x1B 0x8000 0x8000 0x8000
		0x00 0x84 0x0C 0x0F 0x18 0x1B 0x8000 0x8000 0x8000
		0x00 0x85 0x08 0x0B 0x18 0x1B 0x8000 0x8000 0x8000
		0x00 0x86 0x04 0x07 0x18 0x1B 0x8000 0x8000 0x8000
		0x00 0x87 0x00 0x03 0x18 0x1B 0x8000 0x8000 0x8000
		0x00 0x88 0x38 0x3B 0x14 0x17 0x8000 0x8000 0x8000
		0x00 0x89 0x34 0x37 0x14 0x17 0x8000 0x8000 0x8000
		0x00 0x8A 0x30 0x33 0x14 0x17 0x8000 0x8000 0x8000
		0x00 0x8B 0x2C 0x2F 0x14 0x17 0x8000 0x8000 0x8000
		0x00 0x8C 0x28 0x2B 0x14 0x17 0x8000 0x8000 0x8000
		0x00 0x8D 0x24 0x27 0x14 0x17 0x8000 0x8000 0x8000
		0x00 0x8E 0x20 0x23 0x14 0x17 0x8000 0x8000 0x8000
		0x00 0x8F 0x1C 0x1F 0x14 0x17 0x8000 0x8000 0x8000
		0x00 0x90 0x18 0x1B 0x14 0x17 0x8000 0x8000 0x8000
		0x00 0x91 0x14 0x17 0x14 0x17 0x8000 0x8000 0x8000
		0x00 0x92 0x10 0x13 0x14 0x17 0x8000 0x8000 0x8000
		0x00 0x93 0x0C 0x0F 0x14 0x17 0x8000 0x8000 0x8000
		0x00 0x94 0x08 0x0B 0x14 0x17 0x8000 0x8000 0x8000
		0x00 0x95 0x04 0x07 0x14 0x17 0x8000 0x8000 0x8000
		0x00 0x96 0x00 0x03 0x14 0x17 0x8000 0x8000 0x8000
		0x00 0x97 0x38 0x3B 0x10 0x13 0x8000 0x8000 0x8000
		0x00 0x98 0x34 0x37 0x10 0x13 0x8000 0x8000 0x8000
		0x00 0x99 0x30 0x33 0x10 0x13 0x8000 0x8000 0x8000
		0x00 0x9A 0x2C 0x2F 0x10 0x13 0x8000 0x8000 0x8000
		0x00 0x9B 0x28 0x2B 0x10 0x13 0x8000 0x8000 0x8000
		0x00 0x9C 0x24 0x27 0x10 0x13 0x8000 0x8000 0x8000
		0x00 0x9D 0x20 0x23 0x10 0x13 0x8000 0x8000 0x8000
		0x00 0x9E 0x1C 0x1F 0x10 0x13 0x8000 0x8000 0x8000
		0x00 0x9F 0x18 0x1B 0x10 0x13 0x8000 0x8000 0x8000
		0x00 0xA0 0x14 0x17 0x10 0x13 0x8000 0x8000 0x8000
		0x00 0xA1 0x10 0x13 0x10 0x13 0x8000 0x8000 0x8000
		0x00 0xA2 0x0C 0x0F 0x10 0x13 0x8000 0x8000 0x8000
		0x00 0xA3 0x08 0x0B 0x10 0x13 0x8000 0x8000 0x8000
		0x00 0xA4 0x04 0x07 0x10 0x13 0x8000 0x8000 0x8000
		0x00 0xA5 0x00 0x03 0x10 0x13 0x8000 0x8000 0x8000
		0x00 0xA6 0x38 0x3B 0x0C 0x0F 0x8000 0x8000 0x8000
		0x00 0xA7 0x34 0x37 0x0C 0x0F 0x8000 0x8000 0x8000
		0x00 0xA8 0x30 0x33 0x0C 0x0F 0x8000 0x8000 0x8000
		0x00 0xA9 0x2C 0x2F 0x0C 0x0F 0x8000 0x8000 0x8000
		0x00 0xAA 0x28 0x2B 0x0C 0x0F 0x8000 0x8000 0x8000
		0x00 0xAB 0x24 0x27 0x0C 0x0F 0x8000 0x8000 0x8000
		0x00 0xAC 0x20 0x23 0x0C 0x0F 0x8000 0x8000 0x8000
		0x00 0xAD 0x1C 0x1F 0x0C 0x0F 0x8000 0x8000 0x8000
		0x00 0xAE 0x18 0x1B 0x0C 0x0F 0x8000 0x8000 0x8000
		0x00 0xAF 0x14 0x17 0x0C 0x0F 0x8000 0x8000 0x8000
		0x00 0xB0 0x10 0x13 0x0C 0x0F 0x8000 0x8000 0x8000
		0x00 0xB1 0x0C 0x0F 0x0C 0x0F 0x8000 0x8000 0x8000
		0x00 0xB2 0x08 0x0B 0x0C 0x0F 0x8000 0x8000 0x8000
		0x00 0xB3 0x04 0x07 0x0C 0x0F 0x8000 0x8000 0x8000
		0x00 0xB4 0x00 0x03 0x0C 0x0F 0x8000 0x8000 0x8000
		0x00 0xB5 0x38 0x3B 0x08 0x0B 0x8000 0x8000 0x8000
		0x00 0xB6 0x34 0x37 0x08 0x0B 0x8000 0x8000 0x8000
		0x00 0xB7 0x30 0x33 0x08 0x0B 0x8000 0x8000 0x8000
		0x00 0xB8 0x2C 0x2F 0x08 0x0B 0x8000 0x8000 0x8000
		0x00 0xB9 0x28 0x2B 0x08 0x0B 0x8000 0x8000 0x8000
		0x00 0xBA 0x24 0x27 0x08 0x0B 0x8000 0x8000 0x8000
		0x00 0xBB 0x20 0x23 0x08 0x0B 0x8000 0x8000 0x8000
		0x00 0xBC 0x1C 0x1F 0x08 0x0B 0x8000 0x8000 0x8000
		0x00 0xBD 0x18 0x1B 0x08 0x0B 0x8000 0x8000 0x8000
		0x00 0xBE 0x14 0x17 0x08 0x0B 0x8000 0x8000 0x8000
		0x00 0xBF 0x10 0x13 0x08 0x0B 0x8000 0x8000 0x8000
		0x00 0xC0 0x0C 0x0F 0x08 0x0B 0x8000 0x8000 0x8000
		0x00 0xC1 0x08 0x0B 0x08 0x0B 0x8000 0x8000 0x8000
		0x00 0xC2 0x04 0x07 0x08 0x0B 0x8000 0x8000 0x8000
		0x00 0xC3 0x00 0x03 0x08 0x0B 0x8000 0x8000 0x8000
		0x00 0xC4 0x38 0x3B 0x04 0x07 0x8000 0x8000 0x8000
		0x00 0xC5 0x34 0x37 0x04 0x07 0x8000 0x8000 0x8000
		0x00 0xC6 0x30 0x33 0x04 0x07 0x8000 0x8000 0x8000
		0x00 0xC7 0x2C 0x2F 0x04 0x07 0x8000 0x8000 0x8000
		0x00 0xC8 0x28 0x2B 0x04 0x07 0x8000 0x8000 0x8000
		0x00 0xC9 0x24 0x27 0x04 0x07 0x8000 0x8000 0x8000
		0x00 0xCA 0x20 0x23 0x04 0x07 0x8000 0x8000 0x8000
		0x00 0xCB 0x1C 0x1F 0x04 0x07 0x8000 0x8000 0x8000
		0x00 0xCC 0x18 0x1B 0x04 0x07 0x8000 0x8000 0x8000
		0x00 0xCD 0x14 0x17 0x04 0x07 0x8000 0x8000 0x8000
		0x00 0xCE 0x10 0x13 0x04 0x07 0x8000 0x8000 0x8000
		0x00 0xCF 0x0C 0x0F 0x04 0x07 0x8000 0x8000 0x8000
		0x00 0xD0 0x08 0x0B 0x04 0x07 0x8000 0x8000 0x8000
		0x00 0xD1 0x04 0x07 0x04 0x07 0x8000 0x8000 0x8000
		0x00 0xD2 0x00 0x03 0x04 0x07 0x8000 0x8000 0x8000
		0x00 0xD3 0x38 0x3B 0x00 0x03 0x8000 0x8000 0x8000
		0x00 0xD4 0x34 0x37 0x00 0x03 0x8000 0x8000 0x8000
		0x00 0xD5 0x30 0x33 0x00 0x03 0x8000 0x8000 0x8000
		0x00 0xD6 0x2C 0x2F 0x00 0x03 0x8000 0x8000 0x8000
		0x00 0xD7 0x28 0x2B 0x00 0x03 0x8000 0x8000 0x8000
		0x00 0xD8 0x24 0x27 0x00 0x03 0x8000 0x8000 0x8000
		0x00 0xD9 0x20 0x23 0x00 0x03 0x8000 0x8000 0x8000
		0x00 0xDA 0x1C 0x1F 0x00 0x03 0x8000 0x8000 0x8000
		0x00 0xDB 0x18 0x1B 0x00 0x03 0x8000 0x8000 0x8000
		0x00 0xDC 0x14 0x17 0x00 0x03 0x8000 0x8000 0x8000
		0x00 0xDD 0x10 0x13 0x00 0x03 0x8000 0x8000 0x8000
		0x00 0xDE 0x0C 0x0F 0x00 0x03 0x8000 0x8000 0x8000
		0x00 0xDF 0x08 0x0B 0x00 0x03 0x8000 0x8000 0x8000
		0x00 0xE0 0x04 0x07 0x00 0x03 0x8000 0x8000 0x8000
		0x00 0xE1 0x00 0x03 0x00 0x03 0x8000 0x8000 0x8000
		0xFF 0x00 0x0E 0x38 0x0C 0x2F 0x8000 0x8000 0x8000>;

	somc,mdss-dsi-vivid-pcc-enable;
	somc,mdss-dsi-vivid-pcc-table-size = <226>;
	somc,mdss-dsi-vivid-pcc-table = <
		0x00 0x01 0x38 0x3B 0x38 0x3B 0x8000 0x8000 0x8000
		0x00 0x02 0x34 0x37 0x38 0x3B 0x8000 0x8000 0x8000
		0x00 0x03 0x30 0x33 0x38 0x3B 0x8000 0x8000 0x8000
		0x00 0x04 0x2C 0x2F 0x38 0x3B 0x8000 0x8000 0x8000
		0x00 0x05 0x28 0x2B 0x38 0x3B 0x8000 0x8000 0x8000
		0x00 0x06 0x24 0x27 0x38 0x3B 0x8000 0x8000 0x8000
		0x00 0x07 0x20 0x23 0x38 0x3B 0x8000 0x8000 0x8000
		0x00 0x08 0x1C 0x1F 0x38 0x3B 0x8000 0x8000 0x8000
		0x00 0x09 0x18 0x1B 0x38 0x3B 0x8000 0x8000 0x8000
		0x00 0x0A 0x14 0x17 0x38 0x3B 0x8000 0x8000 0x8000
		0x00 0x0B 0x10 0x13 0x38 0x3B 0x8000 0x8000 0x8000
		0x00 0x0C 0x0C 0x0F 0x38 0x3B 0x8000 0x8000 0x8000
		0x00 0x0D 0x08 0x0B 0x38 0x3B 0x8000 0x8000 0x8000
		0x00 0x0E 0x04 0x07 0x38 0x3B 0x8000 0x8000 0x8000
		0x00 0x0F 0x00 0x03 0x38 0x3B 0x8000 0x8000 0x8000
		0x00 0x10 0x38 0x3B 0x34 0x37 0x8000 0x8000 0x8000
		0x00 0x11 0x34 0x37 0x34 0x37 0x8000 0x8000 0x8000
		0x00 0x12 0x30 0x33 0x34 0x37 0x8000 0x8000 0x8000
		0x00 0x13 0x2C 0x2F 0x34 0x37 0x8000 0x8000 0x8000
		0x00 0x14 0x28 0x2B 0x34 0x37 0x8000 0x8000 0x8000
		0x00 0x15 0x24 0x27 0x34 0x37 0x8000 0x8000 0x8000
		0x00 0x16 0x20 0x23 0x34 0x37 0x8000 0x8000 0x8000
		0x00 0x17 0x1C 0x1F 0x34 0x37 0x8000 0x8000 0x8000
		0x00 0x18 0x18 0x1B 0x34 0x37 0x8000 0x8000 0x8000
		0x00 0x19 0x14 0x17 0x34 0x37 0x8000 0x8000 0x8000
		0x00 0x1A 0x10 0x13 0x34 0x37 0x8000 0x8000 0x8000
		0x00 0x1B 0x0C 0x0F 0x34 0x37 0x8000 0x8000 0x8000
		0x00 0x1C 0x08 0x0B 0x34 0x37 0x8000 0x8000 0x8000
		0x00 0x1D 0x04 0x07 0x34 0x37 0x8000 0x8000 0x8000
		0x00 0x1E 0x00 0x03 0x34 0x37 0x8000 0x8000 0x8000
		0x00 0x1F 0x38 0x3B 0x30 0x33 0x8000 0x8000 0x8000
		0x00 0x20 0x34 0x37 0x30 0x33 0x8000 0x8000 0x8000
		0x00 0x21 0x30 0x33 0x30 0x33 0x8000 0x8000 0x8000
		0x00 0x22 0x2C 0x2F 0x30 0x33 0x8000 0x8000 0x8000
		0x00 0x23 0x28 0x2B 0x30 0x33 0x8000 0x8000 0x8000
		0x00 0x24 0x24 0x27 0x30 0x33 0x8000 0x8000 0x8000
		0x00 0x25 0x20 0x23 0x30 0x33 0x8000 0x8000 0x8000
		0x00 0x26 0x1C 0x1F 0x30 0x33 0x8000 0x8000 0x8000
		0x00 0x27 0x18 0x1B 0x30 0x33 0x8000 0x8000 0x8000
		0x00 0x28 0x14 0x17 0x30 0x33 0x8000 0x8000 0x8000
		0x00 0x29 0x10 0x13 0x30 0x33 0x8000 0x8000 0x8000
		0x00 0x2A 0x0C 0x0F 0x30 0x33 0x8000 0x8000 0x8000
		0x00 0x2B 0x08 0x0B 0x30 0x33 0x8000 0x8000 0x8000
		0x00 0x2C 0x04 0x07 0x30 0x33 0x8000 0x8000 0x8000
		0x00 0x2D 0x00 0x03 0x30 0x33 0x8000 0x8000 0x8000
		0x00 0x2E 0x38 0x3B 0x2C 0x2F 0x8000 0x8000 0x8000
		0x00 0x2F 0x34 0x37 0x2C 0x2F 0x8000 0x8000 0x8000
		0x00 0x30 0x30 0x33 0x2C 0x2F 0x8000 0x8000 0x8000
		0x00 0x31 0x2C 0x2F 0x2C 0x2F 0x8000 0x8000 0x8000
		0x00 0x32 0x28 0x2B 0x2C 0x2F 0x8000 0x8000 0x8000
		0x00 0x33 0x24 0x27 0x2C 0x2F 0x8000 0x8000 0x8000
		0x00 0x34 0x20 0x23 0x2C 0x2F 0x8000 0x8000 0x8000
		0x00 0x35 0x1C 0x1F 0x2C 0x2F 0x8000 0x8000 0x8000
		0x00 0x36 0x18 0x1B 0x2C 0x2F 0x8000 0x8000 0x8000
		0x00 0x37 0x14 0x17 0x2C 0x2F 0x8000 0x8000 0x8000
		0x00 0x38 0x10 0x13 0x2C 0x2F 0x8000 0x8000 0x8000
		0x00 0x39 0x0C 0x0F 0x2C 0x2F 0x8000 0x8000 0x8000
		0x00 0x3A 0x08 0x0B 0x2C 0x2F 0x8000 0x8000 0x8000
		0x00 0x3B 0x04 0x07 0x2C 0x2F 0x8000 0x8000 0x8000
		0x00 0x3C 0x00 0x03 0x2C 0x2F 0x8000 0x8000 0x8000
		0x00 0x3D 0x38 0x3B 0x28 0x2B 0x8000 0x8000 0x8000
		0x00 0x3E 0x34 0x37 0x28 0x2B 0x8000 0x8000 0x8000
		0x00 0x3F 0x30 0x33 0x28 0x2B 0x8000 0x8000 0x8000
		0x00 0x40 0x2C 0x2F 0x28 0x2B 0x8000 0x8000 0x8000
		0x00 0x41 0x28 0x2B 0x28 0x2B 0x8000 0x8000 0x8000
		0x00 0x42 0x24 0x27 0x28 0x2B 0x8000 0x8000 0x8000
		0x00 0x43 0x20 0x23 0x28 0x2B 0x8000 0x8000 0x8000
		0x00 0x44 0x1C 0x1F 0x28 0x2B 0x8000 0x8000 0x8000
		0x00 0x45 0x18 0x1B 0x28 0x2B 0x8000 0x8000 0x8000
		0x00 0x46 0x14 0x17 0x28 0x2B 0x8000 0x8000 0x8000
		0x00 0x47 0x10 0x13 0x28 0x2B 0x8000 0x8000 0x8000
		0x00 0x48 0x0C 0x0F 0x28 0x2B 0x8000 0x8000 0x8000
		0x00 0x49 0x08 0x0B 0x28 0x2B 0x8000 0x8000 0x8000
		0x00 0x4A 0x04 0x07 0x28 0x2B 0x8000 0x8000 0x8000
		0x00 0x4B 0x00 0x03 0x28 0x2B 0x8000 0x8000 0x8000
		0x00 0x4C 0x38 0x3B 0x24 0x27 0x8000 0x8000 0x8000
		0x00 0x4D 0x34 0x37 0x24 0x27 0x8000 0x8000 0x8000
		0x00 0x4E 0x30 0x33 0x24 0x27 0x8000 0x8000 0x8000
		0x00 0x4F 0x2C 0x2F 0x24 0x27 0x8000 0x8000 0x8000
		0x00 0x50 0x28 0x2B 0x24 0x27 0x8000 0x8000 0x8000
		0x00 0x51 0x24 0x27 0x24 0x27 0x8000 0x8000 0x8000
		0x00 0x52 0x20 0x23 0x24 0x27 0x8000 0x8000 0x8000
		0x00 0x53 0x1C 0x1F 0x24 0x27 0x8000 0x8000 0x8000
		0x00 0x54 0x18 0x1B 0x24 0x27 0x8000 0x8000 0x8000
		0x00 0x55 0x14 0x17 0x24 0x27 0x8000 0x8000 0x8000
		0x00 0x56 0x10 0x13 0x24 0x27 0x8000 0x8000 0x8000
		0x00 0x57 0x0C 0x0F 0x24 0x27 0x8000 0x8000 0x8000
		0x00 0x58 0x08 0x0B 0x24 0x27 0x8000 0x8000 0x8000
		0x00 0x59 0x04 0x07 0x24 0x27 0x8000 0x8000 0x8000
		0x00 0x5A 0x00 0x03 0x24 0x27 0x8000 0x8000 0x8000
		0x00 0x5B 0x38 0x3B 0x20 0x23 0x8000 0x8000 0x8000
		0x00 0x5C 0x34 0x37 0x20 0x23 0x8000 0x8000 0x8000
		0x00 0x5D 0x30 0x33 0x20 0x23 0x8000 0x8000 0x8000
		0x00 0x5E 0x2C 0x2F 0x20 0x23 0x8000 0x8000 0x8000
		0x00 0x5F 0x28 0x2B 0x20 0x23 0x8000 0x8000 0x8000
		0x00 0x60 0x24 0x27 0x20 0x23 0x8000 0x8000 0x8000
		0x00 0x61 0x20 0x23 0x20 0x23 0x8000 0x8000 0x8000
		0x00 0x62 0x1C 0x1F 0x20 0x23 0x8000 0x8000 0x8000
		0x00 0x63 0x18 0x1B 0x20 0x23 0x8000 0x8000 0x8000
		0x00 0x64 0x14 0x17 0x20 0x23 0x8000 0x8000 0x8000
		0x00 0x65 0x10 0x13 0x20 0x23 0x8000 0x8000 0x8000
		0x00 0x66 0x0C 0x0F 0x20 0x23 0x8000 0x8000 0x8000
		0x00 0x67 0x08 0x0B 0x20 0x23 0x8000 0x8000 0x8000
		0x00 0x68 0x04 0x07 0x20 0x23 0x8000 0x8000 0x8000
		0x00 0x69 0x00 0x03 0x20 0x23 0x8000 0x8000 0x8000
		0x00 0x6A 0x38 0x3B 0x1C 0x1F 0x8000 0x8000 0x8000
		0x00 0x6B 0x34 0x37 0x1C 0x1F 0x8000 0x8000 0x8000
		0x00 0x6C 0x30 0x33 0x1C 0x1F 0x8000 0x8000 0x8000
		0x00 0x6D 0x2C 0x2F 0x1C 0x1F 0x8000 0x8000 0x8000
		0x00 0x6E 0x28 0x2B 0x1C 0x1F 0x8000 0x8000 0x8000
		0x00 0x6F 0x24 0x27 0x1C 0x1F 0x8000 0x8000 0x8000
		0x00 0x70 0x20 0x23 0x1C 0x1F 0x8000 0x8000 0x8000
		0x00 0x71 0x1C 0x1F 0x1C 0x1F 0x8000 0x8000 0x8000
		0x00 0x72 0x18 0x1B 0x1C 0x1F 0x8000 0x8000 0x8000
		0x00 0x73 0x14 0x17 0x1C 0x1F 0x8000 0x8000 0x8000
		0x00 0x74 0x10 0x13 0x1C 0x1F 0x8000 0x8000 0x8000
		0x00 0x75 0x0C 0x0F 0x1C 0x1F 0x8000 0x8000 0x8000
		0x00 0x76 0x08 0x0B 0x1C 0x1F 0x8000 0x8000 0x8000
		0x00 0x77 0x04 0x07 0x1C 0x1F 0x8000 0x8000 0x8000
		0x00 0x78 0x00 0x03 0x1C 0x1F 0x8000 0x8000 0x8000
		0x00 0x79 0x38 0x3B 0x18 0x1B 0x8000 0x8000 0x8000
		0x00 0x7A 0x34 0x37 0x18 0x1B 0x8000 0x8000 0x8000
		0x00 0x7B 0x30 0x33 0x18 0x1B 0x8000 0x8000 0x8000
		0x00 0x7C 0x2C 0x2F 0x18 0x1B 0x8000 0x8000 0x8000
		0x00 0x7D 0x28 0x2B 0x18 0x1B 0x8000 0x8000 0x8000
		0x00 0x7E 0x24 0x27 0x18 0x1B 0x8000 0x8000 0x8000
		0x00 0x7F 0x20 0x23 0x18 0x1B 0x8000 0x8000 0x8000
		0x00 0x80 0x1C 0x1F 0x18 0x1B 0x8000 0x8000 0x8000
		0x00 0x81 0x18 0x1B 0x18 0x1B 0x8000 0x8000 0x8000
		0x00 0x82 0x14 0x17 0x18 0x1B 0x8000 0x8000 0x8000
		0x00 0x83 0x10 0x13 0x18 0x1B 0x8000 0x8000 0x8000
		0x00 0x84 0x0C 0x0F 0x18 0x1B 0x8000 0x8000 0x8000
		0x00 0x85 0x08 0x0B 0x18 0x1B 0x8000 0x8000 0x8000
		0x00 0x86 0x04 0x07 0x18 0x1B 0x8000 0x8000 0x8000
		0x00 0x87 0x00 0x03 0x18 0x1B 0x8000 0x8000 0x8000
		0x00 0x88 0x38 0x3B 0x14 0x17 0x8000 0x8000 0x8000
		0x00 0x89 0x34 0x37 0x14 0x17 0x8000 0x8000 0x8000
		0x00 0x8A 0x30 0x33 0x14 0x17 0x8000 0x8000 0x8000
		0x00 0x8B 0x2C 0x2F 0x14 0x17 0x8000 0x8000 0x8000
		0x00 0x8C 0x28 0x2B 0x14 0x17 0x8000 0x8000 0x8000
		0x00 0x8D 0x24 0x27 0x14 0x17 0x8000 0x8000 0x8000
		0x00 0x8E 0x20 0x23 0x14 0x17 0x8000 0x8000 0x8000
		0x00 0x8F 0x1C 0x1F 0x14 0x17 0x8000 0x8000 0x8000
		0x00 0x90 0x18 0x1B 0x14 0x17 0x8000 0x8000 0x8000
		0x00 0x91 0x14 0x17 0x14 0x17 0x8000 0x8000 0x8000
		0x00 0x92 0x10 0x13 0x14 0x17 0x8000 0x8000 0x8000
		0x00 0x93 0x0C 0x0F 0x14 0x17 0x8000 0x8000 0x8000
		0x00 0x94 0x08 0x0B 0x14 0x17 0x8000 0x8000 0x8000
		0x00 0x95 0x04 0x07 0x14 0x17 0x8000 0x8000 0x8000
		0x00 0x96 0x00 0x03 0x14 0x17 0x8000 0x8000 0x8000
		0x00 0x97 0x38 0x3B 0x10 0x13 0x8000 0x8000 0x8000
		0x00 0x98 0x34 0x37 0x10 0x13 0x8000 0x8000 0x8000
		0x00 0x99 0x30 0x33 0x10 0x13 0x8000 0x8000 0x8000
		0x00 0x9A 0x2C 0x2F 0x10 0x13 0x8000 0x8000 0x8000
		0x00 0x9B 0x28 0x2B 0x10 0x13 0x8000 0x8000 0x8000
		0x00 0x9C 0x24 0x27 0x10 0x13 0x8000 0x8000 0x8000
		0x00 0x9D 0x20 0x23 0x10 0x13 0x8000 0x8000 0x8000
		0x00 0x9E 0x1C 0x1F 0x10 0x13 0x8000 0x8000 0x8000
		0x00 0x9F 0x18 0x1B 0x10 0x13 0x8000 0x8000 0x8000
		0x00 0xA0 0x14 0x17 0x10 0x13 0x8000 0x8000 0x8000
		0x00 0xA1 0x10 0x13 0x10 0x13 0x8000 0x8000 0x8000
		0x00 0xA2 0x0C 0x0F 0x10 0x13 0x8000 0x8000 0x8000
		0x00 0xA3 0x08 0x0B 0x10 0x13 0x8000 0x8000 0x8000
		0x00 0xA4 0x04 0x07 0x10 0x13 0x8000 0x8000 0x8000
		0x00 0xA5 0x00 0x03 0x10 0x13 0x8000 0x8000 0x8000
		0x00 0xA6 0x38 0x3B 0x0C 0x0F 0x8000 0x8000 0x8000
		0x00 0xA7 0x34 0x37 0x0C 0x0F 0x8000 0x8000 0x8000
		0x00 0xA8 0x30 0x33 0x0C 0x0F 0x8000 0x8000 0x8000
		0x00 0xA9 0x2C 0x2F 0x0C 0x0F 0x8000 0x8000 0x8000
		0x00 0xAA 0x28 0x2B 0x0C 0x0F 0x8000 0x8000 0x8000
		0x00 0xAB 0x24 0x27 0x0C 0x0F 0x8000 0x8000 0x8000
		0x00 0xAC 0x20 0x23 0x0C 0x0F 0x8000 0x8000 0x8000
		0x00 0xAD 0x1C 0x1F 0x0C 0x0F 0x8000 0x8000 0x8000
		0x00 0xAE 0x18 0x1B 0x0C 0x0F 0x8000 0x8000 0x8000
		0x00 0xAF 0x14 0x17 0x0C 0x0F 0x8000 0x8000 0x8000
		0x00 0xB0 0x10 0x13 0x0C 0x0F 0x8000 0x8000 0x8000
		0x00 0xB1 0x0C 0x0F 0x0C 0x0F 0x8000 0x8000 0x8000
		0x00 0xB2 0x08 0x0B 0x0C 0x0F 0x8000 0x8000 0x8000
		0x00 0xB3 0x04 0x07 0x0C 0x0F 0x8000 0x8000 0x8000
		0x00 0xB4 0x00 0x03 0x0C 0x0F 0x8000 0x8000 0x8000
		0x00 0xB5 0x38 0x3B 0x08 0x0B 0x8000 0x8000 0x8000
		0x00 0xB6 0x34 0x37 0x08 0x0B 0x8000 0x8000 0x8000
		0x00 0xB7 0x30 0x33 0x08 0x0B 0x8000 0x8000 0x8000
		0x00 0xB8 0x2C 0x2F 0x08 0x0B 0x8000 0x8000 0x8000
		0x00 0xB9 0x28 0x2B 0x08 0x0B 0x8000 0x8000 0x8000
		0x00 0xBA 0x24 0x27 0x08 0x0B 0x8000 0x8000 0x8000
		0x00 0xBB 0x20 0x23 0x08 0x0B 0x8000 0x8000 0x8000
		0x00 0xBC 0x1C 0x1F 0x08 0x0B 0x8000 0x8000 0x8000
		0x00 0xBD 0x18 0x1B 0x08 0x0B 0x8000 0x8000 0x8000
		0x00 0xBE 0x14 0x17 0x08 0x0B 0x8000 0x8000 0x8000
		0x00 0xBF 0x10 0x13 0x08 0x0B 0x8000 0x8000 0x8000
		0x00 0xC0 0x0C 0x0F 0x08 0x0B 0x8000 0x8000 0x8000
		0x00 0xC1 0x08 0x0B 0x08 0x0B 0x8000 0x8000 0x8000
		0x00 0xC2 0x04 0x07 0x08 0x0B 0x8000 0x8000 0x8000
		0x00 0xC3 0x00 0x03 0x08 0x0B 0x8000 0x8000 0x8000
		0x00 0xC4 0x38 0x3B 0x04 0x07 0x8000 0x8000 0x8000
		0x00 0xC5 0x34 0x37 0x04 0x07 0x8000 0x8000 0x8000
		0x00 0xC6 0x30 0x33 0x04 0x07 0x8000 0x8000 0x8000
		0x00 0xC7 0x2C 0x2F 0x04 0x07 0x8000 0x8000 0x8000
		0x00 0xC8 0x28 0x2B 0x04 0x07 0x8000 0x8000 0x8000
		0x00 0xC9 0x24 0x27 0x04 0x07 0x8000 0x8000 0x8000
		0x00 0xCA 0x20 0x23 0x04 0x07 0x8000 0x8000 0x8000
		0x00 0xCB 0x1C 0x1F 0x04 0x07 0x8000 0x8000 0x8000
		0x00 0xCC 0x18 0x1B 0x04 0x07 0x8000 0x8000 0x8000
		0x00 0xCD 0x14 0x17 0x04 0x07 0x8000 0x8000 0x8000
		0x00 0xCE 0x10 0x13 0x04 0x07 0x8000 0x8000 0x8000
		0x00 0xCF 0x0C 0x0F 0x04 0x07 0x8000 0x8000 0x8000
		0x00 0xD0 0x08 0x0B 0x04 0x07 0x8000 0x8000 0x8000
		0x00 0xD1 0x04 0x07 0x04 0x07 0x8000 0x8000 0x8000
		0x00 0xD2 0x00 0x03 0x04 0x07 0x8000 0x8000 0x8000
		0x00 0xD3 0x38 0x3B 0x00 0x03 0x8000 0x8000 0x8000
		0x00 0xD4 0x34 0x37 0x00 0x03 0x8000 0x8000 0x8000
		0x00 0xD5 0x30 0x33 0x00 0x03 0x8000 0x8000 0x8000
		0x00 0xD6 0x2C 0x2F 0x00 0x03 0x8000 0x8000 0x8000
		0x00 0xD7 0x28 0x2B 0x00 0x03 0x8000 0x8000 0x8000
		0x00 0xD8 0x24 0x27 0x00 0x03 0x8000 0x8000 0x8000
		0x00 0xD9 0x20 0x23 0x00 0x03 0x8000 0x8000 0x8000
		0x00 0xDA 0x1C 0x1F 0x00 0x03 0x8000 0x8000 0x8000
		0x00 0xDB 0x18 0x1B 0x00 0x03 0x8000 0x8000 0x8000
		0x00 0xDC 0x14 0x17 0x00 0x03 0x8000 0x8000 0x8000
		0x00 0xDD 0x10 0x13 0x00 0x03 0x8000 0x8000 0x8000
		0x00 0xDE 0x0C 0x0F 0x00 0x03 0x8000 0x8000 0x8000
		0x00 0xDF 0x08 0x0B 0x00 0x03 0x8000 0x8000 0x8000
		0x00 0xE0 0x04 0x07 0x00 0x03 0x8000 0x8000 0x8000
		0x00 0xE1 0x00 0x03 0x00 0x03 0x8000 0x8000 0x8000
		0xFF 0x00 0x0E 0x38 0x0C 0x2F 0x8000 0x8000 0x8000>;

	somc,mdss-dsi-hdr-pcc-enable;
	somc,mdss-dsi-hdr-pcc-table-size = <226>;
	somc,mdss-dsi-hdr-pcc-table = <
		0x00 0x01 0x38 0x3B 0x38 0x3B 0x8000 0x8000 0x8000
		0x00 0x02 0x34 0x37 0x38 0x3B 0x8000 0x8000 0x8000
		0x00 0x03 0x30 0x33 0x38 0x3B 0x8000 0x8000 0x8000
		0x00 0x04 0x2C 0x2F 0x38 0x3B 0x8000 0x8000 0x8000
		0x00 0x05 0x28 0x2B 0x38 0x3B 0x8000 0x8000 0x8000
		0x00 0x06 0x24 0x27 0x38 0x3B 0x8000 0x8000 0x8000
		0x00 0x07 0x20 0x23 0x38 0x3B 0x8000 0x8000 0x8000
		0x00 0x08 0x1C 0x1F 0x38 0x3B 0x8000 0x8000 0x8000
		0x00 0x09 0x18 0x1B 0x38 0x3B 0x8000 0x8000 0x8000
		0x00 0x0A 0x14 0x17 0x38 0x3B 0x8000 0x8000 0x8000
		0x00 0x0B 0x10 0x13 0x38 0x3B 0x8000 0x8000 0x8000
		0x00 0x0C 0x0C 0x0F 0x38 0x3B 0x8000 0x8000 0x8000
		0x00 0x0D 0x08 0x0B 0x38 0x3B 0x8000 0x8000 0x8000
		0x00 0x0E 0x04 0x07 0x38 0x3B 0x8000 0x8000 0x8000
		0x00 0x0F 0x00 0x03 0x38 0x3B 0x8000 0x8000 0x8000
		0x00 0x10 0x38 0x3B 0x34 0x37 0x8000 0x8000 0x8000
		0x00 0x11 0x34 0x37 0x34 0x37 0x8000 0x8000 0x8000
		0x00 0x12 0x30 0x33 0x34 0x37 0x8000 0x8000 0x8000
		0x00 0x13 0x2C 0x2F 0x34 0x37 0x8000 0x8000 0x8000
		0x00 0x14 0x28 0x2B 0x34 0x37 0x8000 0x8000 0x8000
		0x00 0x15 0x24 0x27 0x34 0x37 0x8000 0x8000 0x8000
		0x00 0x16 0x20 0x23 0x34 0x37 0x8000 0x8000 0x8000
		0x00 0x17 0x1C 0x1F 0x34 0x37 0x8000 0x8000 0x8000
		0x00 0x18 0x18 0x1B 0x34 0x37 0x8000 0x8000 0x8000
		0x00 0x19 0x14 0x17 0x34 0x37 0x8000 0x8000 0x8000
		0x00 0x1A 0x10 0x13 0x34 0x37 0x8000 0x8000 0x8000
		0x00 0x1B 0x0C 0x0F 0x34 0x37 0x8000 0x8000 0x8000
		0x00 0x1C 0x08 0x0B 0x34 0x37 0x8000 0x8000 0x8000
		0x00 0x1D 0x04 0x07 0x34 0x37 0x8000 0x8000 0x8000
		0x00 0x1E 0x00 0x03 0x34 0x37 0x8000 0x8000 0x8000
		0x00 0x1F 0x38 0x3B 0x30 0x33 0x8000 0x8000 0x8000
		0x00 0x20 0x34 0x37 0x30 0x33 0x8000 0x8000 0x8000
		0x00 0x21 0x30 0x33 0x30 0x33 0x8000 0x8000 0x8000
		0x00 0x22 0x2C 0x2F 0x30 0x33 0x8000 0x8000 0x8000
		0x00 0x23 0x28 0x2B 0x30 0x33 0x8000 0x8000 0x8000
		0x00 0x24 0x24 0x27 0x30 0x33 0x8000 0x8000 0x8000
		0x00 0x25 0x20 0x23 0x30 0x33 0x8000 0x8000 0x8000
		0x00 0x26 0x1C 0x1F 0x30 0x33 0x8000 0x8000 0x8000
		0x00 0x27 0x18 0x1B 0x30 0x33 0x8000 0x8000 0x8000
		0x00 0x28 0x14 0x17 0x30 0x33 0x8000 0x8000 0x8000
		0x00 0x29 0x10 0x13 0x30 0x33 0x8000 0x8000 0x8000
		0x00 0x2A 0x0C 0x0F 0x30 0x33 0x8000 0x8000 0x8000
		0x00 0x2B 0x08 0x0B 0x30 0x33 0x8000 0x8000 0x8000
		0x00 0x2C 0x04 0x07 0x30 0x33 0x8000 0x8000 0x8000
		0x00 0x2D 0x00 0x03 0x30 0x33 0x8000 0x8000 0x8000
		0x00 0x2E 0x38 0x3B 0x2C 0x2F 0x8000 0x8000 0x8000
		0x00 0x2F 0x34 0x37 0x2C 0x2F 0x8000 0x8000 0x8000
		0x00 0x30 0x30 0x33 0x2C 0x2F 0x8000 0x8000 0x8000
		0x00 0x31 0x2C 0x2F 0x2C 0x2F 0x8000 0x8000 0x8000
		0x00 0x32 0x28 0x2B 0x2C 0x2F 0x8000 0x8000 0x8000
		0x00 0x33 0x24 0x27 0x2C 0x2F 0x8000 0x8000 0x8000
		0x00 0x34 0x20 0x23 0x2C 0x2F 0x8000 0x8000 0x8000
		0x00 0x35 0x1C 0x1F 0x2C 0x2F 0x8000 0x8000 0x8000
		0x00 0x36 0x18 0x1B 0x2C 0x2F 0x8000 0x8000 0x8000
		0x00 0x37 0x14 0x17 0x2C 0x2F 0x8000 0x8000 0x8000
		0x00 0x38 0x10 0x13 0x2C 0x2F 0x8000 0x8000 0x8000
		0x00 0x39 0x0C 0x0F 0x2C 0x2F 0x8000 0x8000 0x8000
		0x00 0x3A 0x08 0x0B 0x2C 0x2F 0x8000 0x8000 0x8000
		0x00 0x3B 0x04 0x07 0x2C 0x2F 0x8000 0x8000 0x8000
		0x00 0x3C 0x00 0x03 0x2C 0x2F 0x8000 0x8000 0x8000
		0x00 0x3D 0x38 0x3B 0x28 0x2B 0x8000 0x8000 0x8000
		0x00 0x3E 0x34 0x37 0x28 0x2B 0x8000 0x8000 0x8000
		0x00 0x3F 0x30 0x33 0x28 0x2B 0x8000 0x8000 0x8000
		0x00 0x40 0x2C 0x2F 0x28 0x2B 0x8000 0x8000 0x8000
		0x00 0x41 0x28 0x2B 0x28 0x2B 0x8000 0x8000 0x8000
		0x00 0x42 0x24 0x27 0x28 0x2B 0x8000 0x8000 0x8000
		0x00 0x43 0x20 0x23 0x28 0x2B 0x8000 0x8000 0x8000
		0x00 0x44 0x1C 0x1F 0x28 0x2B 0x8000 0x8000 0x8000
		0x00 0x45 0x18 0x1B 0x28 0x2B 0x8000 0x8000 0x8000
		0x00 0x46 0x14 0x17 0x28 0x2B 0x8000 0x8000 0x8000
		0x00 0x47 0x10 0x13 0x28 0x2B 0x8000 0x8000 0x8000
		0x00 0x48 0x0C 0x0F 0x28 0x2B 0x8000 0x8000 0x8000
		0x00 0x49 0x08 0x0B 0x28 0x2B 0x8000 0x8000 0x8000
		0x00 0x4A 0x04 0x07 0x28 0x2B 0x8000 0x8000 0x8000
		0x00 0x4B 0x00 0x03 0x28 0x2B 0x8000 0x8000 0x8000
		0x00 0x4C 0x38 0x3B 0x24 0x27 0x8000 0x8000 0x8000
		0x00 0x4D 0x34 0x37 0x24 0x27 0x8000 0x8000 0x8000
		0x00 0x4E 0x30 0x33 0x24 0x27 0x8000 0x8000 0x8000
		0x00 0x4F 0x2C 0x2F 0x24 0x27 0x8000 0x8000 0x8000
		0x00 0x50 0x28 0x2B 0x24 0x27 0x8000 0x8000 0x8000
		0x00 0x51 0x24 0x27 0x24 0x27 0x8000 0x8000 0x8000
		0x00 0x52 0x20 0x23 0x24 0x27 0x8000 0x8000 0x8000
		0x00 0x53 0x1C 0x1F 0x24 0x27 0x8000 0x8000 0x8000
		0x00 0x54 0x18 0x1B 0x24 0x27 0x8000 0x8000 0x8000
		0x00 0x55 0x14 0x17 0x24 0x27 0x8000 0x8000 0x8000
		0x00 0x56 0x10 0x13 0x24 0x27 0x8000 0x8000 0x8000
		0x00 0x57 0x0C 0x0F 0x24 0x27 0x8000 0x8000 0x8000
		0x00 0x58 0x08 0x0B 0x24 0x27 0x8000 0x8000 0x8000
		0x00 0x59 0x04 0x07 0x24 0x27 0x8000 0x8000 0x8000
		0x00 0x5A 0x00 0x03 0x24 0x27 0x8000 0x8000 0x8000
		0x00 0x5B 0x38 0x3B 0x20 0x23 0x8000 0x8000 0x8000
		0x00 0x5C 0x34 0x37 0x20 0x23 0x8000 0x8000 0x8000
		0x00 0x5D 0x30 0x33 0x20 0x23 0x8000 0x8000 0x8000
		0x00 0x5E 0x2C 0x2F 0x20 0x23 0x8000 0x8000 0x8000
		0x00 0x5F 0x28 0x2B 0x20 0x23 0x8000 0x8000 0x8000
		0x00 0x60 0x24 0x27 0x20 0x23 0x8000 0x8000 0x8000
		0x00 0x61 0x20 0x23 0x20 0x23 0x8000 0x8000 0x8000
		0x00 0x62 0x1C 0x1F 0x20 0x23 0x8000 0x8000 0x8000
		0x00 0x63 0x18 0x1B 0x20 0x23 0x8000 0x8000 0x8000
		0x00 0x64 0x14 0x17 0x20 0x23 0x8000 0x8000 0x8000
		0x00 0x65 0x10 0x13 0x20 0x23 0x8000 0x8000 0x8000
		0x00 0x66 0x0C 0x0F 0x20 0x23 0x8000 0x8000 0x8000
		0x00 0x67 0x08 0x0B 0x20 0x23 0x8000 0x8000 0x8000
		0x00 0x68 0x04 0x07 0x20 0x23 0x8000 0x8000 0x8000
		0x00 0x69 0x00 0x03 0x20 0x23 0x8000 0x8000 0x8000
		0x00 0x6A 0x38 0x3B 0x1C 0x1F 0x8000 0x8000 0x8000
		0x00 0x6B 0x34 0x37 0x1C 0x1F 0x8000 0x8000 0x8000
		0x00 0x6C 0x30 0x33 0x1C 0x1F 0x8000 0x8000 0x8000
		0x00 0x6D 0x2C 0x2F 0x1C 0x1F 0x8000 0x8000 0x8000
		0x00 0x6E 0x28 0x2B 0x1C 0x1F 0x8000 0x8000 0x8000
		0x00 0x6F 0x24 0x27 0x1C 0x1F 0x8000 0x8000 0x8000
		0x00 0x70 0x20 0x23 0x1C 0x1F 0x8000 0x8000 0x8000
		0x00 0x71 0x1C 0x1F 0x1C 0x1F 0x8000 0x8000 0x8000
		0x00 0x72 0x18 0x1B 0x1C 0x1F 0x8000 0x8000 0x8000
		0x00 0x73 0x14 0x17 0x1C 0x1F 0x8000 0x8000 0x8000
		0x00 0x74 0x10 0x13 0x1C 0x1F 0x8000 0x8000 0x8000
		0x00 0x75 0x0C 0x0F 0x1C 0x1F 0x8000 0x8000 0x8000
		0x00 0x76 0x08 0x0B 0x1C 0x1F 0x8000 0x8000 0x8000
		0x00 0x77 0x04 0x07 0x1C 0x1F 0x8000 0x8000 0x8000
		0x00 0x78 0x00 0x03 0x1C 0x1F 0x8000 0x8000 0x8000
		0x00 0x79 0x38 0x3B 0x18 0x1B 0x8000 0x8000 0x8000
		0x00 0x7A 0x34 0x37 0x18 0x1B 0x8000 0x8000 0x8000
		0x00 0x7B 0x30 0x33 0x18 0x1B 0x8000 0x8000 0x8000
		0x00 0x7C 0x2C 0x2F 0x18 0x1B 0x8000 0x8000 0x8000
		0x00 0x7D 0x28 0x2B 0x18 0x1B 0x8000 0x8000 0x8000
		0x00 0x7E 0x24 0x27 0x18 0x1B 0x8000 0x8000 0x8000
		0x00 0x7F 0x20 0x23 0x18 0x1B 0x8000 0x8000 0x8000
		0x00 0x80 0x1C 0x1F 0x18 0x1B 0x8000 0x8000 0x8000
		0x00 0x81 0x18 0x1B 0x18 0x1B 0x8000 0x8000 0x8000
		0x00 0x82 0x14 0x17 0x18 0x1B 0x8000 0x8000 0x8000
		0x00 0x83 0x10 0x13 0x18 0x1B 0x8000 0x8000 0x8000
		0x00 0x84 0x0C 0x0F 0x18 0x1B 0x8000 0x8000 0x8000
		0x00 0x85 0x08 0x0B 0x18 0x1B 0x8000 0x8000 0x8000
		0x00 0x86 0x04 0x07 0x18 0x1B 0x8000 0x8000 0x8000
		0x00 0x87 0x00 0x03 0x18 0x1B 0x8000 0x8000 0x8000
		0x00 0x88 0x38 0x3B 0x14 0x17 0x8000 0x8000 0x8000
		0x00 0x89 0x34 0x37 0x14 0x17 0x8000 0x8000 0x8000
		0x00 0x8A 0x30 0x33 0x14 0x17 0x8000 0x8000 0x8000
		0x00 0x8B 0x2C 0x2F 0x14 0x17 0x8000 0x8000 0x8000
		0x00 0x8C 0x28 0x2B 0x14 0x17 0x8000 0x8000 0x8000
		0x00 0x8D 0x24 0x27 0x14 0x17 0x8000 0x8000 0x8000
		0x00 0x8E 0x20 0x23 0x14 0x17 0x8000 0x8000 0x8000
		0x00 0x8F 0x1C 0x1F 0x14 0x17 0x8000 0x8000 0x8000
		0x00 0x90 0x18 0x1B 0x14 0x17 0x8000 0x8000 0x8000
		0x00 0x91 0x14 0x17 0x14 0x17 0x8000 0x8000 0x8000
		0x00 0x92 0x10 0x13 0x14 0x17 0x8000 0x8000 0x8000
		0x00 0x93 0x0C 0x0F 0x14 0x17 0x8000 0x8000 0x8000
		0x00 0x94 0x08 0x0B 0x14 0x17 0x8000 0x8000 0x8000
		0x00 0x95 0x04 0x07 0x14 0x17 0x8000 0x8000 0x8000
		0x00 0x96 0x00 0x03 0x14 0x17 0x8000 0x8000 0x8000
		0x00 0x97 0x38 0x3B 0x10 0x13 0x8000 0x8000 0x8000
		0x00 0x98 0x34 0x37 0x10 0x13 0x8000 0x8000 0x8000
		0x00 0x99 0x30 0x33 0x10 0x13 0x8000 0x8000 0x8000
		0x00 0x9A 0x2C 0x2F 0x10 0x13 0x8000 0x8000 0x8000
		0x00 0x9B 0x28 0x2B 0x10 0x13 0x8000 0x8000 0x8000
		0x00 0x9C 0x24 0x27 0x10 0x13 0x8000 0x8000 0x8000
		0x00 0x9D 0x20 0x23 0x10 0x13 0x8000 0x8000 0x8000
		0x00 0x9E 0x1C 0x1F 0x10 0x13 0x8000 0x8000 0x8000
		0x00 0x9F 0x18 0x1B 0x10 0x13 0x8000 0x8000 0x8000
		0x00 0xA0 0x14 0x17 0x10 0x13 0x8000 0x8000 0x8000
		0x00 0xA1 0x10 0x13 0x10 0x13 0x8000 0x8000 0x8000
		0x00 0xA2 0x0C 0x0F 0x10 0x13 0x8000 0x8000 0x8000
		0x00 0xA3 0x08 0x0B 0x10 0x13 0x8000 0x8000 0x8000
		0x00 0xA4 0x04 0x07 0x10 0x13 0x8000 0x8000 0x8000
		0x00 0xA5 0x00 0x03 0x10 0x13 0x8000 0x8000 0x8000
		0x00 0xA6 0x38 0x3B 0x0C 0x0F 0x8000 0x8000 0x8000
		0x00 0xA7 0x34 0x37 0x0C 0x0F 0x8000 0x8000 0x8000
		0x00 0xA8 0x30 0x33 0x0C 0x0F 0x8000 0x8000 0x8000
		0x00 0xA9 0x2C 0x2F 0x0C 0x0F 0x8000 0x8000 0x8000
		0x00 0xAA 0x28 0x2B 0x0C 0x0F 0x8000 0x8000 0x8000
		0x00 0xAB 0x24 0x27 0x0C 0x0F 0x8000 0x8000 0x8000
		0x00 0xAC 0x20 0x23 0x0C 0x0F 0x8000 0x8000 0x8000
		0x00 0xAD 0x1C 0x1F 0x0C 0x0F 0x8000 0x8000 0x8000
		0x00 0xAE 0x18 0x1B 0x0C 0x0F 0x8000 0x8000 0x8000
		0x00 0xAF 0x14 0x17 0x0C 0x0F 0x8000 0x8000 0x8000
		0x00 0xB0 0x10 0x13 0x0C 0x0F 0x8000 0x8000 0x8000
		0x00 0xB1 0x0C 0x0F 0x0C 0x0F 0x8000 0x8000 0x8000
		0x00 0xB2 0x08 0x0B 0x0C 0x0F 0x8000 0x8000 0x8000
		0x00 0xB3 0x04 0x07 0x0C 0x0F 0x8000 0x8000 0x8000
		0x00 0xB4 0x00 0x03 0x0C 0x0F 0x8000 0x8000 0x8000
		0x00 0xB5 0x38 0x3B 0x08 0x0B 0x8000 0x8000 0x8000
		0x00 0xB6 0x34 0x37 0x08 0x0B 0x8000 0x8000 0x8000
		0x00 0xB7 0x30 0x33 0x08 0x0B 0x8000 0x8000 0x8000
		0x00 0xB8 0x2C 0x2F 0x08 0x0B 0x8000 0x8000 0x8000
		0x00 0xB9 0x28 0x2B 0x08 0x0B 0x8000 0x8000 0x8000
		0x00 0xBA 0x24 0x27 0x08 0x0B 0x8000 0x8000 0x8000
		0x00 0xBB 0x20 0x23 0x08 0x0B 0x8000 0x8000 0x8000
		0x00 0xBC 0x1C 0x1F 0x08 0x0B 0x8000 0x8000 0x8000
		0x00 0xBD 0x18 0x1B 0x08 0x0B 0x8000 0x8000 0x8000
		0x00 0xBE 0x14 0x17 0x08 0x0B 0x8000 0x8000 0x8000
		0x00 0xBF 0x10 0x13 0x08 0x0B 0x8000 0x8000 0x8000
		0x00 0xC0 0x0C 0x0F 0x08 0x0B 0x8000 0x8000 0x8000
		0x00 0xC1 0x08 0x0B 0x08 0x0B 0x8000 0x8000 0x8000
		0x00 0xC2 0x04 0x07 0x08 0x0B 0x8000 0x8000 0x8000
		0x00 0xC3 0x00 0x03 0x08 0x0B 0x8000 0x8000 0x8000
		0x00 0xC4 0x38 0x3B 0x04 0x07 0x8000 0x8000 0x8000
		0x00 0xC5 0x34 0x37 0x04 0x07 0x8000 0x8000 0x8000
		0x00 0xC6 0x30 0x33 0x04 0x07 0x8000 0x8000 0x8000
		0x00 0xC7 0x2C 0x2F 0x04 0x07 0x8000 0x8000 0x8000
		0x00 0xC8 0x28 0x2B 0x04 0x07 0x8000 0x8000 0x8000
		0x00 0xC9 0x24 0x27 0x04 0x07 0x8000 0x8000 0x8000
		0x00 0xCA 0x20 0x23 0x04 0x07 0x8000 0x8000 0x8000
		0x00 0xCB 0x1C 0x1F 0x04 0x07 0x8000 0x8000 0x8000
		0x00 0xCC 0x18 0x1B 0x04 0x07 0x8000 0x8000 0x8000
		0x00 0xCD 0x14 0x17 0x04 0x07 0x8000 0x8000 0x8000
		0x00 0xCE 0x10 0x13 0x04 0x07 0x8000 0x8000 0x8000
		0x00 0xCF 0x0C 0x0F 0x04 0x07 0x8000 0x8000 0x8000
		0x00 0xD0 0x08 0x0B 0x04 0x07 0x8000 0x8000 0x8000
		0x00 0xD1 0x04 0x07 0x04 0x07 0x8000 0x8000 0x8000
		0x00 0xD2 0x00 0x03 0x04 0x07 0x8000 0x8000 0x8000
		0x00 0xD3 0x38 0x3B 0x00 0x03 0x8000 0x8000 0x8000
		0x00 0xD4 0x34 0x37 0x00 0x03 0x8000 0x8000 0x8000
		0x00 0xD5 0x30 0x33 0x00 0x03 0x8000 0x8000 0x8000
		0x00 0xD6 0x2C 0x2F 0x00 0x03 0x8000 0x8000 0x8000
		0x00 0xD7 0x28 0x2B 0x00 0x03 0x8000 0x8000 0x8000
		0x00 0xD8 0x24 0x27 0x00 0x03 0x8000 0x8000 0x8000
		0x00 0xD9 0x20 0x23 0x00 0x03 0x8000 0x8000 0x8000
		0x00 0xDA 0x1C 0x1F 0x00 0x03 0x8000 0x8000 0x8000
		0x00 0xDB 0x18 0x1B 0x00 0x03 0x8000 0x8000 0x8000
		0x00 0xDC 0x14 0x17 0x00 0x03 0x8000 0x8000 0x8000
		0x00 0xDD 0x10 0x13 0x00 0x03 0x8000 0x8000 0x8000
		0x00 0xDE 0x0C 0x0F 0x00 0x03 0x8000 0x8000 0x8000
		0x00 0xDF 0x08 0x0B 0x00 0x03 0x8000 0x8000 0x8000
		0x00 0xE0 0x04 0x07 0x00 0x03 0x8000 0x8000 0x8000
		0x00 0xE1 0x00 0x03 0x00 0x03 0x8000 0x8000 0x8000
		0xFF 0x00 0x0E 0x38 0x0C 0x2F 0x8000 0x8000 0x8000>;
};
