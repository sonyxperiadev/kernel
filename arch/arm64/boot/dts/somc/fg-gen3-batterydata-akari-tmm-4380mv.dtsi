// SPDX-License-Identifier: GPL-2.0-only
/*
 * Copyright (c) 2017, The Linux Foundation. All rights reserved.
 */

qcom,akari_tmm_4380mv {
	qcom, = <24>;
	somc,initial-capacity-uah = <3217000>;
	qcom,max-voltage-uv = <4380000>;
	qcom,fg-cc-cv-threshold-mv = <4370>;
	qcom,fastchg-current-ma = <2275>;
	qcom,batt-id-kohm = <330>;
	qcom,battery-beta = <4050>;
	qcom,battery-type = "1310-1782-0";
	qcom,checksum = <0xC77F>;
	qcom,gui-version = "PMI8998GUI - 2.0.0.58";
	qcom,fg-profile-data = [
		 63 1F CC 05
		 40 0A 17 FD
		 AC 1C 98 01
		 07 F4 4E F4
		 6B 18 96 22
		 23 3C 00 52
		 51 00 00 00
		 0F 00 00 00
		 00 00 E5 C2
		 C1 D5 AD CA
		 2B 00 08 00
		 E5 DC 13 DD
		 D1 05 30 01
		 D9 05 6C 03
		 0F EC B1 33
		 22 06 09 20
		 27 00 14 00
		 43 1B 51 02
		 B1 FC 83 FA
		 7F 1C 41 03
		 0D 0C CB 0B
		 D4 18 99 22
		 F7 45 3C 52
		 8E 00 00 00
		 0C 00 00 00
		 00 00 B8 D5
		 9F B4 44 CB
		 24 00 00 00
		 3F EA 13 DD
		 10 06 F7 F3
		 82 06 AA 02
		 7C E2 A5 13
		 AB 33 CC FF
		 07 10 00 00
		 91 0C 14 46
		 24 00 40 00
		 AC 01 0A FA
		 FF 00 00 00
		 00 00 00 00
		 00 00 00 00
		 00 00 00 00
		 00 00 00 00
		 00 00 00 00
		 00 00 00 00
		 00 00 00 00
		 00 00 00 00
		 00 00 00 00
		 00 00 00 00
		 00 00 00 00
		 00 00 00 00
		 00 00 00 00
		 00 00 00 00
		 00 00 00 00
		 00 00 00 00
		 00 00 00 00
		 00 00 00 00
	];
};
