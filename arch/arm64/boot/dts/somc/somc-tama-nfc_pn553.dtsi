// SPDX-License-Identifier: GPL-2.0-only
/*
 * Copyright (c) 2017, The Linux Foundation. All rights reserved.
 */

&qupv3_se10_i2c {
	nfc@28 {
		compatible = "nxp,pn553";
		reg = <0x28>;
		interrupt-parent = <&tlmm>;
		interrupts = <63 0x1>;
		nxp,irq_gpio = <&tlmm 63 0x00>;
		nxp,dwld_en = <&tlmm 62 0x00>;
		nxp,ven = <&tlmm 12 0x01>;
		qcom,clk-src = "BBCLK3";
		qcom,clk-gpio = <&pm8998_gpios 21 0x00>;
		clock-names = "nfc_clk";
		clocks = <&clock_rpmh RPMH_LN_BB_CLK3>;
	};
};

&soc {
	nfc,pm-ops {
		compatible = "sony,pn553-pm-ops";
	};
};
