/dts-v1/;
/plugin/;

#include "../qcom/lahaina-mtp-v2.dtsi"
#include "lahaina-sagami-pdx215_generic.dtsi"

/ {
	model = "Sony Mobile Communications. PDX-215 CrossFlash(LAHAINA)";
	compatible = "somc,pdx215-generic", "qcom,lahaina", "qcom,mtp";
	qcom,board-id = <0x20808 0>;
};
