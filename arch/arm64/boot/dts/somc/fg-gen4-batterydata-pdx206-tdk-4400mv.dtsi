/* Copyright (c) 2019, The Linux Foundation. All rights reserved.
 *
 * This program is free software; you can redistribute it and/or modify
 * it under the terms of the GNU General Public License version 2 and
 * only version 2 as published by the Free Software Foundation.
 *
 * This program is distributed in the hope that it will be useful,
 * but WITHOUT ANY WARRANTY; without even the implied warranty of
 * MERCHANTABILITY or FITNESS FOR A PARTICULAR PURPOSE.  See the
 * GNU General Public License for more details.
 */

qcom,pdx206_tdk_4400mv {
	/* Added or Modified by SOMC */
	qcom,battery-type = "1319-9998";
	qcom,fastchg-current-ma = <3850>;
	qcom,jeita-hard-thresholds = <0x5314 0x181d>;
	somc,initial-capacity-uah = <4021000>;
	somc,step-cfg = <
		(-2550) 50    0 4500    0 4400 1
		   50  120    0 4500  750 4400 2
		  120  200    0 4100 2300 4400 3
		  120  200 4100 4200 1900 4400 3
		  120  200 4200 4300 1500 4400 3
		  120  200 4300 4500 1150 4400 3
		  200  450    0 4150 3850 4400 3
		  200  450 4150 4200 2850 4400 3
		  200  450 4200 4300 1900 4400 3
		  200  450 4300 4500 1150 4400 3
		  450  550    0 4500 1150 4200 4
		  550 2550    0 4500    0 4200 5
	>;
	somc,step-cell-impedance-mohm = <15>;

	/* Prepared by Qualcomm */
	qcom,profile-revision = <24>;
	/* #4335141_SoMC_MyronTDK_3976mAh_averaged_MasterSlave_Jan10th2020*/
	qcom,max-voltage-uv = <4400000>;
	qcom,fg-cc-cv-threshold-mv = <4390>;
	qcom,nom-batt-capacity-mah = <3976>;
	qcom,batt-id-kohm = <15>;
	qcom,battery-beta = <4250>;
	qcom,therm-room-temp = <100000>;
	/*qcom,battery-type = "4335141_somc_myrontdk_3976mah_averaged_masterslave_jan10th2020";*/
	qcom,therm-coefficients = <0x2318 0xd0c 0xdaf7 0xc556 0x848d>;
	qcom,therm-center-offset = <0x70>;
	qcom,therm-pull-up = <100>;
	qcom,rslow-normal-coeffs = <0xdb 0xfa 0x48 0x13>;
	qcom,rslow-low-coeffs = <0xf3 0x0d 0x25 0x12>;
	qcom,checksum = <0x04FB>;
	qcom,gui-version = "PM855GUI - 1.0.0.13";
	qcom,fg-profile-data = [
		 09 00 3E 00
		 C1 D4 66 DA
		 CA D5 00 00
		 E7 BC F7 8A
		 FB 87 94 8B
		 3F 9D 68 80
		 20 00 DB FA
		 48 13 D7 FD
		 0F E5 CE 07
		 32 00 5B 00
		 A3 ED 27 D3
		 84 0A 35 E5
		 49 C5 01 12
		 E3 01 A9 D2
		 60 00 4B 00
		 4C 00 48 00
		 28 00 2F 00
		 37 00 3C 00
		 40 00 41 00
		 40 00 60 00
		 35 00 41 00
		 48 00 44 00
		 3D 00 90 00
		 5F 64 4E 00
		 44 00 40 08
		 60 F8 4C 00
		 47 00 6C 10
		 55 10 48 00
		 99 28 69 48
		 56 60 4A 0C
		 48 00 D8 00
		 7B 1F BC 0D
		 2B 02 A7 05
		 80 1C 4A 0B
		 A3 0D 91 22
		 27 18 31 42
		 50 55 49 02
		 67 11 78 1F
		 CF 05 33 0A
		 AE 06 E2 1C
		 FC 01 B5 05
		 90 02 76 18
		 3F 23 0C 45
		 B1 53 77 11
		 4C 1F FD E5
		 1B C2 B8 96
		 DC 1C A2 B9
		 F2 04 8A BB
		 3A 18 48 93
		 16 85 8C 9B
		 80 98 09 80
		 BA EB BF 04
		 59 FC E2 03
		 00 00 83 DC
		 49 E2 F0 FF
		 23 BB 04 AD
		 18 10 19 F0
		 94 C5 93 03
		 17 05 9F 00
		 CE 07 32 00
		 6A 01 76 02
		 F8 05 1F 02
		 07 05 03 05
		 A0 03 86 02
		 14 04 44 00
		 3D 00 4C 00
		 50 64 54 00
		 52 00 52 08
		 54 F8 52 00
		 55 00 68 08
		 34 08 42 00
		 55 28 52 48
		 5E 58 6F 0D
		 48 00 59 00
		 5D 08 61 00
		 54 00 42 00
		 4B 08 56 08
		 4E 00 62 28
		 7A 48 46 60
		 59 0D 61 00
		 61 00 49 08
		 D8 F8 5D 20
		 57 05 52 0A
		 27 0D 09 1D
		 AB 22 A2 44
		 55 5B 94 18
		 11 02 A4 05
		 B7 03 78 0F
		 3F 0A 38 20
		 14 05 C2 02
		 1B 06 D9 1C
		 C7 02 55 04
		 E3 03 85 18
		 16 02 87 05
		 06 02 71 00
		 53 1F FF 05
		 2B 02 39 05
		 DB 1C 59 02
		 0F 05 4F 03
		 A7 18 67 03
		 9F 04 51 02
		 6D 00 0D 01
		 C0 00 FA 00
		 B5 0F 00 00
	];
};
