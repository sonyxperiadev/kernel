// SPDX-License-Identifier: GPL-2.0-only
/*
 * Copyright (c) 2017, The Linux Foundation. All rights reserved.
 */

qcom,apollo_tmm_4340mv {
	qcom, = <24>;
	somc,initial-capacity-uah = <2899000>;
	qcom,max-voltage-uv = <4335000>;
	qcom,fg-cc-cv-threshold-mv = <4325>;
	qcom,fastchg-current-ma = <2760>;
	qcom,batt-id-kohm = <330>;
	qcom,battery-beta = <4050>;
	qcom,battery-type = "1310-1071-1";
	qcom,checksum = <0x3D53>;
	qcom,gui-version = "PMI8998GUI - 2.0.0.58";
	qcom,fg-profile-data = [
		 66 1F DD 05
		 1A 0A B1 06
		 BD 1C 46 01
		 9B EB 1F 05
		 35 18 A1 22
		 28 3C ED 4B
		 51 00 00 00
		 0F 00 00 00
		 00 00 0C C3
		 E5 D5 89 BB
		 29 00 08 00
		 C4 DC 13 DD
		 10 06 B9 F3
		 55 FC 5B 03
		 71 EC 45 33
		 1E 06 09 20
		 27 00 14 00
		 63 1F 41 FC
		 B8 03 E3 FD
		 B3 1C B7 FB
		 97 D5 64 0D
		 D1 18 66 22
		 9B 3C 3D 4B
		 57 00 00 00
		 18 00 00 00
		 00 00 DF D5
		 2E C2 EB C3
		 26 00 00 00
		 46 EA 13 DD
		 16 06 E7 00
		 49 06 66 02
		 19 E4 87 1A
		 BD 33 CC FF
		 07 10 00 00
		 EF 0A 5C 45
		 26 00 40 00
		 A3 01 0A FA
		 FF 00 00 00
		 00 00 00 00
		 00 00 00 00
		 00 00 00 00
		 00 00 00 00
		 00 00 00 00
		 00 00 00 00
		 00 00 00 00
		 00 00 00 00
		 00 00 00 00
		 00 00 00 00
		 00 00 00 00
		 00 00 00 00
		 00 00 00 00
		 00 00 00 00
		 00 00 00 00
		 00 00 00 00
		 00 00 00 00
		 00 00 00 00
	];
};
