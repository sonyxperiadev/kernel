/* Copyright (c) 2019, The Linux Foundation. All rights reserved.
 *
 * This program is free software; you can redistribute it and/or modify
 * it under the terms of the GNU General Public License version 2 and
 * only version 2 as published by the Free Software Foundation.
 *
 * This program is distributed in the hope that it will be useful,
 * but WITHOUT ANY WARRANTY; without even the implied warranty of
 * MERCHANTABILITY or FITNESS FOR A PARTICULAR PURPOSE.  See the
 * GNU General Public License for more details.
 */

/dts-v1/;

#include "../qcom/kona.dtsi"
#include "../qcom/kona-mtp.dtsi"
#include "kona-edo-pdx206_generic.dtsi"

/ {
	model = "Sony Mobile Communications. PDX-206(KONA v1)";
	compatible = "somc,pdx206-generic", "qcom,kona", "qcom,mtp";
	qcom,board-id = <0x10008 0>;
};
