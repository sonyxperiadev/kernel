// SPDX-License-Identifier: GPL-2.0-only
/*
 * Copyright (c) 2017, The Linux Foundation. All rights reserved.
 */

/dts-v1/;
/plugin/;

#include <dt-bindings/clock/qcom,gcc-sdm845.h>
#include <dt-bindings/clock/qcom,camcc-sdm845.h>
#include <dt-bindings/clock/qcom,dispcc-sdm845.h>
#include <dt-bindings/clock/qcom,rpmh.h>
#include <dt-bindings/interrupt-controller/arm-gic.h>

#include "../qcom/sdm845-sde-display.dtsi"
#include "../qcom/sdm845-mtp.dtsi"
#include "../qcom/sdm845-audio-overlay.dtsi"
#include "sdm845-tama-akatsuki_generic.dtsi"

/ {
	model = "Sony Mobile Communications. Akatsuki(SDM845 v2)";
	compatible = "somc,akatsuki-row", "qcom,sdm845", "qcom,mtp";
	qcom,msm-id = <321 0x20000>;
	qcom,board-id = <8 0>;
};
