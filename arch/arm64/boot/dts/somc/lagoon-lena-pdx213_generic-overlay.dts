/dts-v1/;
/plugin/;

#include <dt-bindings/interrupt-controller/arm-gic.h>
#include "../qcom/lagoon-qrd.dtsi"
#include "lagoon-lena-pdx213_generic.dtsi"

/ {
	model = "Sony Mobile Communications. PDX213(LAGOON v1)";
	compatible = "somc,pdx213", "qcom,lagoon", "qcom,qrd";
	qcom,msm-id = <434 0x10000>, <459 0x10000>;
	qcom,board-id = <0x1000B 0>;
};
