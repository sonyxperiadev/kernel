#include "dsi-panel-samsung-amoled-fhd-cmd-zambezi.dtsi"

&dsi_samsung_amoled_cmd {
	qcom,panel-supply-entries = <&dsi_panel_pwr_supply_avdd>;
	qcom,mdss-dsi-bl-inverted-dbv;
	qcom,mdss-dsi-bl-pmic-control-type = "bl_ctrl_dcs";
	qcom,mdss-dsi-bl-min-level = <1>;
	qcom,mdss-dsi-bl-max-level = <2047>;
	qcom,mdss-brightness-max-level = <2047>;
	qcom,platform-te-gpio = <&tlmm 23 0>;
	qcom,platform-reset-gpio = <&pmr735a_gpios 2 0>;
	somc,disp-err-flag-gpio = <&tlmm 97 0>;

	//qcom,dsi-supported-dfps-list = <60 55 48>;
	//qcom,mdss-dsi-pan-enable-dynamic-fps;
	//qcom,mdss-dsi-pan-fps-update = "dfps_immediate_porch_mode_vfp";
	qcom,dsi-select-clocks = "mux_byte_clk0", "mux_pixel_clk0",
				"src_byte_clk0", "src_pixel_clk0",
				"shadow_byte_clk0", "shadow_pixel_clk0";
	//qcom,dsi-dyn-clk-enable;
	//qcom,dsi-dyn-clk-list = <952174080 948206688 956141472>;
	//qcom,dsi-dyn-clk-type = "constant-fps-adjust-vfp";
	qcom,mdss-dsi-display-timings {
		timing@0 {
			qcom,mdss-dsi-panel-phy-timings = [00 22 09 09 19 23 09 09 09 02 04 00 1c 0e];
			qcom,display-topology = <1 0 1>;  //no dsc
			qcom,default-topology-index = <0>;
		};
	};
};

&sde_dsi {
	pinctrl-1 = <&sde_te_suspend>;

	qcom,dsi-default-panel = <&dsi_samsung_amoled_cmd>;
};
