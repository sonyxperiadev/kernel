/* arch/arm64/boot/dts/somc/usb-dp-edo-pdx206.dtsi
 *
 * This program is free software; you can redistribute it and/or modify
 * it under the terms of the GNU General Public License version 2 and
 * only version 2 as published by the Free Software Foundation.
 *
 * This program is distributed in the hope that it will be useful,
 * but WITHOUT ANY WARRANTY; without even the implied warranty of
 * MERCHANTABILITY or FITNESS FOR A PARTICULAR PURPOSE.  See the
 * GNU General Public License for more details.
 */

&usb_qmp_dp_phy {
	extcon = <&pm8150b_pdphy>;
};

&sde_dp {
	qcom,aux-en-gpio = <&tlmm 73 0>;
	qcom,aux-sel-gpio = <&tlmm 72 0>;
	qcom,dp-gpio-aux-switch;
};

&dwc0 {
	maximum-speed = "super-speed";
};

/* Primary USB port related High Speed PHY */
&usb2_phy0 {
	qcom,param-override-seq =
		<0x87 0x70
		0x2d 0x74>;
};
