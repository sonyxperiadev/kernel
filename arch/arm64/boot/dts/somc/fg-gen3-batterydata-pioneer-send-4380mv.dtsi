// SPDX-License-Identifier: GPL-2.0-only
/*
 * Copyright (c) 2016-2017, 2021, The Linux Foundation. All rights reserved.
 */

qcom,pioneer_send_4380mv {
	qcom, = <24>;
	somc,initial-capacity-uah = <3300000>;
	qcom,max-voltage-uv = <4380000>;
	qcom,nom-batt-capacity-mah = <3200>;
	qcom,fg-cc-cv-threshold-mv = <4370>;
	qcom,fastchg-current-ma = <2400>;
	qcom,batt-id-kohm = <330>;
	qcom,battery-beta = <4050>;
	qcom,battery-type = "1309-2675";
	qcom,checksum = <0xD96F>;
	qcom,gui-version = "PM660GUI - 0.0.0.44";

	qcom,fg-profile-data = [
		86 1F 99 05
		70 0A 5F 06
		A8 1C 61 FB
		67 FD 6F F5
		7B 18 DD 22
		9F 45 C7 52
		58 00 00 00
		0D 00 00 00
		00 00 6F C2
		AA D5 BA CA
		25 00 08 00
		D5 DC B5 DD
		EB 05 37 FA
		F5 05 1C 0A
		71 E3 60 33
		1F 06 09 20
		27 00 14 00
		97 1F CD 05
		3C 0A 98 06
		96 1C CB 02
		3F 0D DD 03
		AB 18 C8 22
		BC 45 91 52
		5B 00 00 00
		0C 00 00 00
		00 00 33 CC
		4E BA C8 CA
		20 00 00 00
		E2 E3 B5 DD
		25 FC 01 FA
		5C 06 22 03
		C6 D3 C8 13
		AA 33 CC FF
		07 10 00 00
		34 0D 66 46
		20 00 40 00
		AE 01 0A FA
		FF 00 00 00
		00 00 00 00
		00 00 00 00
		00 00 00 00
		00 00 00 00
		00 00 00 00
		00 00 00 00
		00 00 00 00
		00 00 00 00
		00 00 00 00
		00 00 00 00
		00 00 00 00
		00 00 00 00
		00 00 00 00
		00 00 00 00
		00 00 00 00
		00 00 00 00
		00 00 00 00
		00 00 00 00
	];

	somc,step-cfg = <
		(-2550) 50 0 4500    0 4200 1
		   50  100 0 4500  650 4200 2
		  100  250 0 4500 1600 4380 3
		  250  450 0 4500 2400 4380 3
		  450  550 0 4500  650 4200 4
		  550 2550 0 4500    0 4200 5
	>;
};
