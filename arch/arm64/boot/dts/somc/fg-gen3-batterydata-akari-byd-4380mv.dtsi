// SPDX-License-Identifier: GPL-2.0-only
/*
 * Copyright (c) 2017, The Linux Foundation. All rights reserved.
 */

qcom,akari_byd_4380mv {
	qcom, = <24>;
	somc,initial-capacity-uah = <3056000>;
	qcom,max-voltage-uv = <4380000>;
	qcom,fg-cc-cv-threshold-mv = <4370>;
	qcom,fastchg-current-ma = <2275>;
	qcom,batt-id-kohm = <33>;
	qcom,battery-beta = <4050>;
	qcom,battery-type = "1312-9463-0";
	qcom,checksum = <0xACAA>;
	qcom,gui-version = "PMI8998GUI - 2.0.0.58";
	qcom,fg-profile-data = [
		 D0 1F 45 05
		 B5 0A 11 06
		 74 1D E5 F5
		 A2 0B 22 15
		 EE 18 9D 22
		 F6 45 29 52
		 5C 00 00 00
		 0F 00 00 00
		 00 00 02 C5
		 23 C4 0C C3
		 1A 00 08 00
		 3D DB E5 E4
		 7D 06 E5 00
		 BC 00 D4 12
		 0B F5 9D 33
		 1E 06 09 20
		 27 00 14 00
		 1D 20 2B 05
		 BA 0A 25 FC
		 58 1D F3 EB
		 D0 03 EF 15
		 2E 19 DF 22
		 75 45 10 53
		 5B 00 00 00
		 0D 00 00 00
		 00 00 19 CD
		 83 BA AA AA
		 16 00 00 00
		 4D EA E5 E4
		 BD FD 79 F2
		 32 F5 11 03
		 CD EB E8 1A
		 B6 33 CC FF
		 07 10 00 00
		 F0 0B 14 46
		 16 00 40 00
		 9D 01 0A FA
		 FF 00 00 00
		 00 00 00 00
		 00 00 00 00
		 00 00 00 00
		 00 00 00 00
		 00 00 00 00
		 00 00 00 00
		 00 00 00 00
		 00 00 00 00
		 00 00 00 00
		 00 00 00 00
		 00 00 00 00
		 00 00 00 00
		 00 00 00 00
		 00 00 00 00
		 00 00 00 00
		 00 00 00 00
		 00 00 00 00
		 00 00 00 00
	];
};
