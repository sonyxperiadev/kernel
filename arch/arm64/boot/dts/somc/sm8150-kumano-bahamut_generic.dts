// SPDX-License-Identifier: GPL-2.0-only
/*
 * Copyright (c) 2017-2018, The Linux Foundation. All rights reserved.
 */

/dts-v1/;

#include "../qcom/sm8150.dtsi"
#include "../qcom/sm8150-mtp.dtsi"
#include "sm8150-kumano-bahamut_generic.dtsi"

/ {
	model = "Sony Mobile Communications Inc., Bahamut(SM8150 v1)";
	compatible = "somc,bahamut-generic", "qcom,sm8150", "qcom,mtp";
	qcom,board-id = <8 0>;
};
