// SPDX-License-Identifier: GPL-2.0-only
/*
 * Copyright (c) 2015-2017, The Linux Foundation. All rights reserved.
 */

&mdss_mdp {
	/* OLED */
	dsi_5: somc,5_panel {
		qcom,mdss-dsi-panel-name = "5";
		qcom,mdss-dsi-panel-type = "dsi_cmd_mode";

		qcom,dsi-ctrl-num = <0>;
		qcom,dsi-phy-num = <0>;

		qcom,mdss-dsi-bpp = <24>;
		qcom,mdss-pan-physical-width-dimension = <68>;
		qcom,mdss-pan-physical-height-dimension = <136>;
		qcom,mdss-dsi-virtual-channel-id = <0>;
		qcom,mdss-dsi-stream = <0>;
		qcom,mdss-dsi-underflow-color = <0x0>;
		qcom,mdss-dsi-border-color = <0>;
		qcom,mdss-dsi-traffic-mode = "non_burst_sync_event";
		qcom,mdss-dsi-bllp-eof-power-mode;
		qcom,mdss-dsi-bllp-power-mode;
		qcom,mdss-dsi-dma-trigger = "trigger_sw";
		qcom,mdss-dsi-mdp-trigger = "none";
		qcom,mdss-dsi-tx-eot-append;
		qcom,mdss-dsi-te-pin-select = <1>;
		qcom,mdss-dsi-wr-mem-start = <0x2c>;
		qcom,mdss-dsi-wr-mem-continue = <0x3c>;
		qcom,mdss-dsi-te-dcs-command = <1>;
		qcom,mdss-dsi-te-check-enable;
		qcom,mdss-dsi-te-using-te-pin;
		qcom,mdss-dsi-lane-0-state;
		qcom,mdss-dsi-lane-1-state;
		qcom,mdss-dsi-lane-2-state;
		qcom,mdss-dsi-lane-3-state;
		qcom,mdss-dsi-t-clk-post = <0x0E>;
		qcom,mdss-dsi-t-clk-pre = <0x33>;
		qcom,ulps-enabled;
		qcom,mdss-dsi-lp11-init;
		qcom,mdss-dsi-bl-min-level = <1>;
		qcom,mdss-dsi-bl-max-level = <1023>;
		qcom,mdss-brightness-max-level = <1023>;
		qcom,mdss-dsi-bl-pmic-control-type = "bl_ctrl_dcs";
		qcom,mdss-dsi-reset-sequence = <1 10>;
		somc,mdss-dsi-touch-reset-sequence = <1 0>;
		somc,pw-on-rst-seq = "before_power_on";
		somc,dsi-panel-type = "oled";
		somc,mdss-dsi-master;
		somc,pw-off-rst-b-seq = <0 0>;
		somc,pw-wait-after-on-vdd = <0>;
		somc,pw-wait-after-on-vddio = <0>;
		somc,pw-wait-after-off-vdd = <0>;
		somc,pw-wait-after-off-vddio = <0>;
		somc,pw-wait-after-on-touch-avdd = <0>;
		somc,pw-wait-after-on-touch-vddio = <0>;
		somc,pw-wait-after-on-touch-reset = <1>;
		somc,pw-wait-after-on-touch-int-n = <10>;
		somc,pw-wait-after-off-touch-avdd = <0>;
		somc,pw-wait-after-off-touch-vddio = <0>;
		somc,pw-wait-after-off-touch-reset = <10>;
		somc,pw-wait-after-off-touch-int-n = <0>;
		somc,pw-wait-after-off-lp11 = <10>;
		somc,pw-down-period = <300>;
		somc,lcd-id-adc = <801000 917000>;
		somc,qpnp-lab-limit-maximum-current = <200>;
		somc,qpnp-ibb-limit-maximum-current = <800>;
		somc,qpnp-lab-max-precharge-time = <300>;
		somc,qpnp-lab-soft-start = <800>;
		somc,qpnp-lab-pull-down-enable;
		somc,qpnp-lab-full-pull-down;
		somc,qpnp-ibb-pull-down-enable;
		somc,qpnp-ibb-full-pull-down;

		qcom,mdss-dsi-panel-hdr-enabled;
		qcom,mdss-dsi-panel-hdr-color-primaries = <14500 15500 32000 17000 15500 30000 8000 3000>;
		qcom,mdss-dsi-panel-peak-brightness = <4200000>;
		qcom,mdss-dsi-panel-blackness-level = <3230>;
		somc,area_count_table_size = <20>;
		somc,area_count_table = <0 38 75 112 149 186 224 261
					298 335 372 447 521 596
					670 744 819 893 968 1023>;

		qcom,mdss-dsi-display-timings {
			timing@0 {
				qcom,mdss-dsi-panel-width = <1440>;
				qcom,mdss-dsi-panel-height = <2880>;
				qcom,mdss-dsi-h-back-porch = <8>;
				qcom,mdss-dsi-h-pulse-width = <8>;
				qcom,mdss-dsi-h-front-porch = <312>;
				qcom,mdss-dsi-v-back-porch = <8>;
				qcom,mdss-dsi-v-pulse-width = <8>;
				qcom,mdss-dsi-v-front-porch = <16>;
				qcom,mdss-dsi-panel-framerate = <60>;
				qcom,mdss-dsi-panel-jitter = <0x5 0x1>;
				qcom,mdss-dsi-h-sync-skew = <0>;
				qcom,mdss-dsi-h-left-border = <0>;
				qcom,mdss-dsi-h-right-border = <0>;
				qcom,mdss-dsi-v-top-border = <0>;
				qcom,mdss-dsi-v-bottom-border = <0>;
				qcom,mdss-dsi-h-sync-pulse = <1>;
				qcom,mdss-dsi-on-command = [
						39 01 00 00 00 00 03 7F 5A 5A
						39 01 00 00 00 00 03 F0 5A 5A
						39 01 00 00 00 00 03 F1 5A 5A
						39 01 00 00 00 00 03 F2 5A 5A
						15 01 00 00 00 00 02 02 01
						15 01 00 00 00 00 02 59 01
						15 01 00 00 00 00 02 53 20
						39 01 00 00 00 00 06 57 20 80 DE 60 00
						39 01 00 00 00 00 05 2A 00 00 05 9F
						39 01 00 00 00 00 05 2B 00 00 0B 3F
						15 01 00 00 00 00 02 55 00
						15 01 00 00 00 00 02 35 00
						39 01 00 00 00 00 03 7F 5A 5A
						39 01 00 00 00 00 03 F0 5A 5A
						39 01 00 00 00 00 03 F1 5A 5A
						39 01 00 00 00 00 03 F2 5A 5A
						39 01 00 00 00 00 02 B0 03
						39 01 00 00 00 00 02 F6 04
						39 01 00 00 00 00 02 B0 05
						39 01 00 00 00 00 04 F6 01 7F 00
						05 01 00 00 78 00 01 11
						39 01 00 00 00 00 06 E3 AC 19 34 14 7D];
				qcom,mdss-dsi-post-panel-on-command = [
						05 01 00 00 00 00 01 29];
				qcom,mdss-dsi-off-command = [
						05 01 00 00 14 00 01 28
						05 01 00 00 64 00 01 10];
				somc,mdss-dsi-aod-on-command = [
						39 01 00 00 00 00 03 7F 5A 5A
						39 01 00 00 00 00 03 F0 5A 5A
						39 01 00 00 00 00 03 F1 5A 5A
						39 01 00 00 00 00 03 F2 5A 5A
						05 01 00 00 00 00 01 28
						15 01 00 00 00 00 02 55 00
						15 01 00 00 00 00 02 B0 06
						39 01 00 00 00 00 05 C2 23 00 09 69
						39 01 00 00 00 00 03 51 00 03
						15 01 00 00 00 00 02 B0 0F
						15 01 00 00 64 00 02 E1 C0
						05 01 00 00 00 00 01 39
						05 01 00 00 00 00 01 29];
				somc,mdss-dsi-aod-low-command = [
						39 01 00 00 00 00 03 51 00 02
						];
				somc,mdss-dsi-aod-high-command = [
						39 01 00 00 00 00 03 51 00 03
						];
				somc,mdss-dsi-aod-off-command = [
						39 01 00 00 00 00 03 7F 5A 5A
						39 01 00 00 00 00 03 F0 5A 5A
						39 01 00 00 00 00 03 F1 5A 5A
						39 01 00 00 00 00 03 F2 5A 5A
						05 01 00 00 00 00 01 28
						15 01 00 00 00 00 02 B0 06
						39 01 00 00 00 00 05 C2 23 00 12 65
						15 01 00 00 00 00 02 B0 0F
						15 01 00 00 00 00 02 E1 C0
						05 01 00 00 64 00 01 38
						05 01 00 00 00 00 01 29];
				somc,mdss-dsi-vr-on-command = [
						05 01 00 00 00 00 01 28
						39 01 00 00 00 00 03 7F 5A 5A
						39 01 00 00 00 00 03 F0 5A 5A
						39 01 00 00 00 00 03 F1 5A 5A
						39 01 00 00 00 00 03 F2 5A 5A
						15 01 00 00 00 00 02 BF B0
						39 01 00 00 00 00 03 51 00 01
						05 01 00 00 00 00 01 29];
				somc,mdss-dsi-vr-off-command = [
						05 01 00 00 00 00 01 28
						39 01 00 00 00 00 03 7F 5A 5A
						39 01 00 00 00 00 03 F0 5A 5A
						39 01 00 00 00 00 03 F1 5A 5A
						39 01 00 00 00 00 03 F2 5A 5A
						15 01 00 00 00 00 02 BF B3
						05 01 00 00 00 00 01 29];
				somc,mdss-dsi-display-off-command = [
						05 01 00 00 00 00 01 28];
				somc,mdss-dsi-display-on-command = [
						05 01 00 00 00 00 01 29];
				qcom,mdss-dsi-on-command-state = "dsi_lp_mode";
				qcom,mdss-dsi-off-command-state = "dsi_hs_mode";
				somc,mdss-dsi-aod-on-command-state = "dsi_lp_mode";
				somc,mdss-dsi-aod-low-command-state = "dsi_lp_mode";
				somc,mdss-dsi-aod-high-command-state = "dsi_lp_mode";
				somc,mdss-dsi-aod-off-command-state = "dsi_lp_mode";
				somc,mdss-dsi-vr-on-command-state = "dsi_lp_mode";
				somc,mdss-dsi-vr-off-command-state = "dsi_lp_mode";
				somc,mdss-dsi-display-off-command-state = "dsi_lp_mode";
				somc,mdss-dsi-display-on-command-state = "dsi_lp_mode";
				qcom,mdss-dsi-panel-timings = [00 21 08 08 25 23 08 08 06 03 04 00];
				qcom,compression-mode = "dsc";
				qcom,mdss-dsc-slice-height = <32>;
				qcom,mdss-dsc-slice-width = <720>;
				qcom,mdss-dsc-slice-per-pkt = <1>;
				qcom,mdss-dsc-bit-per-component = <8>;
				qcom,mdss-dsc-bit-per-pixel = <8>;
				qcom,mdss-dsc-encoders = <2>;
				qcom,mdss-dsc-block-prediction-enable;

				qcom,mdss-dsi-panel-clockrate = <964260000>;
			};
		};
	};
};

#include "dsi-panel-akatsuki-id5_pcc.dtsi"
