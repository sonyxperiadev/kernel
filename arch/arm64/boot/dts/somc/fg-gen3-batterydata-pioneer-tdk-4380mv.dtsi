// SPDX-License-Identifier: GPL-2.0-only
/*
 * Copyright (c) 2016-2017, 2021, The Linux Foundation. All rights reserved.
 */

qcom,pioneer_tdk_4380mv {
	qcom, = <24>;
	somc,initial-capacity-uah = <3300000>;
	qcom,max-voltage-uv = <4380000>;
	qcom,nom-batt-capacity-mah = <3200>;
	qcom,fg-cc-cv-threshold-mv = <4370>;
	qcom,fastchg-current-ma = <2400>;
	qcom,batt-id-kohm = <15>;
	qcom,battery-beta = <4050>;
	qcom,battery-type = "1309-2682";
	qcom,checksum = <0x4593>;
	qcom,gui-version = "PM660GUI - 0.0.0.43";

	qcom,fg-profile-data = [
		5C 1F D5 05
		51 0A CF FC
		87 1D 16 07
		81 12 EB 1D
		A0 18 F4 22
		8F 45 BD 52
		56 00 00 00
		0F 00 00 00
		00 00 36 C5
		88 CD 86 CA
		1D 00 08 00
		82 DB 99 E4
		2B FD A3 F2
		3B FB 45 13
		50 05 6E 2B
		1B 06 09 20
		27 00 14 00
		A5 1F C6 05
		43 0A 13 FD
		6D 1D B9 E2
		04 0B D8 14
		69 19 B3 22
		AA 45 B9 52
		55 00 00 00
		0E 00 00 00
		00 00 F8 CC
		C4 B2 62 C2
		18 00 00 00
		87 EA 99 E4
		E0 06 B3 EB
		DB EB B9 0A
		63 D4 D9 1A
		A7 33 CC FF
		07 10 00 00
		17 0D 66 46
		18 00 40 00
		C9 01 0A FA
		FF 00 00 00
		00 00 00 00
		00 00 00 00
		00 00 00 00
		00 00 00 00
		00 00 00 00
		00 00 00 00
		00 00 00 00
		00 00 00 00
		00 00 00 00
		00 00 00 00
		00 00 00 00
		00 00 00 00
		00 00 00 00
		00 00 00 00
		00 00 00 00
		00 00 00 00
		00 00 00 00
		00 00 00 00
	];

	somc,step-cfg = <
		(-2550) 50 0 4500    0 4200 1
		   50  100 0 4500  650 4200 2
		  100  250 0 4500 1600 4380 3
		  250  450 0 4500 2400 4380 3
		  450  550 0 4500  650 4200 4
		  550 2550 0 4500    0 4200 5
	>;
};
