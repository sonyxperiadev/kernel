#include "blair-murray-common.dtsi"
#include "blair-murray-camera.dtsi"
#include "blair-fingerprint.dtsi"

&soc {
};

#include "charger-murray-common.dtsi"
#include "charger-murray-sm5038.dtsi"
#include "sec_touchscreen_pdx225.dtsi"
#include "somc-murray-display.dtsi"
#include "somc-murray-display-pdx225.dtsi"
#include "somc-murray-nfc.dtsi"
