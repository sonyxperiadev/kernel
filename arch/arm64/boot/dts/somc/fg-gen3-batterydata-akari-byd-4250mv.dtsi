// SPDX-License-Identifier: GPL-2.0-only
/*
 * Copyright (c) 2017, The Linux Foundation. All rights reserved.
 */

qcom,akari_byd_4250mv {
	qcom, = <24>;
	somc,initial-capacity-uah = <3056000>;
	qcom,max-voltage-uv = <4245000>;
	qcom,fg-cc-cv-threshold-mv = <4235>;
	qcom,fastchg-current-ma = <2275>;
	qcom,batt-id-kohm = <33>;
	qcom,battery-beta = <4050>;
	qcom,battery-type = "1312-9463-3";
	qcom,checksum = <0x13B5>;
	qcom,gui-version = "PMI8998GUI - 2.0.0.58";
	qcom,fg-profile-data = [
		 B8 20 86 04
		 E8 0A EC 05
		 2B 1D AB 00
		 E5 F2 84 06
		 58 19 56 22
		 75 3C EF 4B
		 6A 00 00 00
		 0D 00 00 00
		 00 00 FC 07
		 D7 CD 58 CA
		 19 00 08 00
		 E5 C2 01 DC
		 81 FC 41 FA
		 01 F3 3B 13
		 29 07 12 32
		 2A 06 09 20
		 27 00 14 00
		 06 21 6D 04
		 F0 0A E3 05
		 2E 1D 1E 01
		 BB E5 27 FD
		 17 19 CA 22
		 85 45 29 53
		 70 00 00 00
		 0E 00 00 00
		 00 00 F3 D5
		 76 9A 68 C3
		 16 00 00 00
		 D2 E3 01 DC
		 BD FD 9F 00
		 B9 FD 9F 02
		 A2 04 92 1A
		 AD 33 CC FF
		 07 10 00 00
		 A5 0A EB 43
		 16 00 40 00
		 A8 01 0A FA
		 FF 00 00 00
		 00 00 00 00
		 00 00 00 00
		 00 00 00 00
		 00 00 00 00
		 00 00 00 00
		 00 00 00 00
		 00 00 00 00
		 00 00 00 00
		 00 00 00 00
		 00 00 00 00
		 00 00 00 00
		 00 00 00 00
		 00 00 00 00
		 00 00 00 00
		 00 00 00 00
		 00 00 00 00
		 00 00 00 00
		 00 00 00 00
	];
};
