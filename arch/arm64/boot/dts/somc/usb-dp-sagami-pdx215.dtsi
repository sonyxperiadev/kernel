/* somc/usb-dp-sagami-pdx215.dtsi
 *
 * This program is free software; you can redistribute it and/or modify
 * it under the terms of the GNU General Public License version 2 and
 * only version 2 as published by the Free Software Foundation.
 *
 * This program is distributed in the hope that it will be useful,
 * but WITHOUT ANY WARRANTY; without even the implied warranty of
 * MERCHANTABILITY or FITNESS FOR A PARTICULAR PURPOSE.  See the
 * GNU General Public License for more details.
 */

/* Primary USB maximum-speed */
&usb0 {
	dwc3@a600000 {
		maximum-speed = "super-speed";
	};
};

/* Primary USB port related High Speed PHY */
&usb2_phy0 {
	qcom,param-override-seq =
		<0xe6 0x6c	/* override_x0 */
		 0x0f 0x70	/* override_x1 */
		 0x14 0x74>;	/* override x2 */
};

/* Primary USB port related QMP USB DP Combo PHY */
/* here */
