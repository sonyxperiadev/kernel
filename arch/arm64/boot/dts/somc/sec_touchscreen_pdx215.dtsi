/* arch/arm64/boot/dts/vendor/somc/sec_touchscreen_pdx215.dtsi*
 * This program is free software; you can redistribute it and/or modify
 * it under the terms of the GNU General Public License version 2 and
 * only version 2 as published by the Free Software Foundation.
 *
 * This program is distributed in the hope that it will be useful,
 * but WITHOUT ANY WARRANTY; without even the implied warranty of
 * MERCHANTABILITY or FITNESS FOR A PARTICULAR PURPOSE.  See the
 * GNU General Public License for more details.
 */

&qupv3_se4_i2c {
	touchscreen@48 {
		sec,max_coords = <1644 3840>;
		sec,firmware_name = "touch_module_id_0x28.img";
		sec,device_id = /bits/ 8 <0xAC 0x37 0x92>;

		/* feature */
		sec,wireless_charging_supported = <1>;
		sec,rejection_area_portrait = <40 240 90 300>;
		sec,rejection_area_landscape = <240 30 300 90>;
	};
};

