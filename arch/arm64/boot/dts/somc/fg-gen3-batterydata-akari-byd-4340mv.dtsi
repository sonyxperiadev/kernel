// SPDX-License-Identifier: GPL-2.0-only
/*
 * Copyright (c) 2017, The Linux Foundation. All rights reserved.
 */

qcom,akari_byd_4340mv {
	qcom, = <24>;
	somc,initial-capacity-uah = <3056000>;
	qcom,max-voltage-uv = <4335000>;
	qcom,fg-cc-cv-threshold-mv = <4325>;
	qcom,fastchg-current-ma = <2275>;
	qcom,batt-id-kohm = <33>;
	qcom,battery-beta = <4050>;
	qcom,battery-type = "1312-9463-1";
	qcom,checksum = <0xEE1D>;
	qcom,gui-version = "PMI8998GUI - 2.0.0.58";
	qcom,fg-profile-data = [
		 00 20 20 05
		 B6 0A 1F FC
		 51 1D 71 DB
		 C4 03 FF 0C
		 D0 18 C0 22
		 C1 45 8D 52
		 63 00 00 00
		 0E 00 00 00
		 00 00 57 C4
		 B3 C4 17 CA
		 1A 00 08 00
		 59 DA 5B E5
		 EF FC EE 00
		 A6 00 C0 12
		 9A F5 97 32
		 22 06 09 20
		 27 00 14 00
		 2E 20 31 05
		 98 0A 6B FC
		 3B 1D EF F3
		 09 FA 4D 04
		 05 19 F1 22
		 68 45 22 53
		 60 00 00 00
		 0E 00 00 00
		 00 00 F9 07
		 90 B2 BD BB
		 16 00 00 00
		 0F EA 5B E5
		 F1 06 53 F2
		 BE F4 D3 02
		 71 05 6E 1A
		 A4 33 CC FF
		 07 10 00 00
		 8D 0B 5C 45
		 16 00 40 00
		 A3 01 0A FA
		 FF 00 00 00
		 00 00 00 00
		 00 00 00 00
		 00 00 00 00
		 00 00 00 00
		 00 00 00 00
		 00 00 00 00
		 00 00 00 00
		 00 00 00 00
		 00 00 00 00
		 00 00 00 00
		 00 00 00 00
		 00 00 00 00
		 00 00 00 00
		 00 00 00 00
		 00 00 00 00
		 00 00 00 00
		 00 00 00 00
		 00 00 00 00
	];
};
