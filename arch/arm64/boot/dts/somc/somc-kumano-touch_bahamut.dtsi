// SPDX-License-Identifier: GPL-2.0-only
/*
 * Copyright (c) 2017-2018, The Linux Foundation. All rights reserved.
 */

&qupv3_se10_i2c {
	touchscreen@48 {
		/* override parameter */
		sec,max_coords = <1080 2520>;
		sec,cover_mode_supported = <0>;
		sec,rejection_area_portrait = <25 150 60 200>;
		sec,rejection_area_landscape = <150 20 200 60>;
	};
};
