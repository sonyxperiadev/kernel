// SPDX-License-Identifier: GPL-2.0-only
/*
 * Copyright (c) 2018, The Linux Foundation. All rights reserved.
 */

qcom,griffin_tmm_4300mv {
	/* Added or Modified by SOMC */
	qcom,battery-type = "1315-7599";
	qcom,fastchg-current-ma = <3000>;
	somc,initial-capacity-uah = <3310000>;
	somc,step-cfg = <
		(-2550) 50    0 4500    0 4300 1
		   50  100    0 4500  950 4300 2
		  100  450    0 4250 3000 4300 3
		  100  450 4250 4300 1600 4300 3
		  100  450 4300 4500  950 4300 3
		  450  550    0 4500  950 4200 4
		  550 2550    0 4500    0 4200 5
	>;
	somc,step-cell-impedance-mohm = <20>;

	/* Prepared by Qualcomm */
	qcom,profile-revision = <24>;
	/* #3708408_SoMC_Yoda_3009mAh_averaged_MasterSlave_Nov6th2018*/
	qcom,max-voltage-uv = <4300000>;
	qcom,fg-cc-cv-threshold-mv = <4290>;
	qcom,nom-batt-capacity-mah = <3009>;
	qcom,batt-id-kohm = <330>;
	qcom,battery-beta = <4250>;
	qcom,therm-room-temp = <100000>;
	/* qcom,battery-type = "3708408_somc_yoda_3009mah_averaged_masterslave_nov6th2018"; */
	qcom,therm-coefficients = <0x2318 0xd0c 0xdaf7 0xc556 0x848d>;
	qcom,therm-center-offset = <0x70>;
	qcom,therm-pull-up = <100>;
	qcom,rslow-normal-coeffs = <0x5b 0x05 0x0a 0x0a>;
	qcom,rslow-low-coeffs = <0x71 0x05 0x50 0x0a>;
	qcom,checksum = <0x3930>;
	qcom,gui-version = "PM855GUI - 1.0.0.10";
	qcom,fg-profile-data = [
		 A9 1F 53 00
		 F8 E4 C7 EA
		 EC E4 00 00
		 89 C5 06 9A
		 DA 87 D6 AA
		 11 A4 50 87
		 26 FC 5B 05
		 0A 0A 87 04
		 96 02 CE 1F
		 32 0A 6F EB
		 9F EC 67 DA
		 06 02 F9 D5
		 FD C5 A4 0B
		 CF DA DC CA
		 60 00 41 FC
		 42 FD 42 F4
		 41 33 3C 10
		 3A 0B 3E 00
		 43 01 3D 00
		 35 00 60 00
		 3E 00 47 00
		 4A 00 4B 00
		 40 00 45 00
		 63 64 51 00
		 45 F8 39 00
		 60 F0 4F 00
		 4E 00 4F 08
		 63 08 51 00
		 5C 20 7E 40
		 67 50 59 14
		 50 00 D8 00
		 5C 1F 09 0C
		 84 FB C1 04
		 14 1C 34 0B
		 4C 0C 6F 23
		 8E 17 D9 3A
		 E8 4D 29 02
		 79 16 88 1F
		 D5 05 03 0A
		 A3 05 86 1C
		 5D FA 77 05
		 74 02 15 18
		 92 22 71 3C
		 6D 4B 7F 16
		 6B 21 00 EC
		 31 D3 CE D5
		 9C 1C 89 03
		 27 05 BB C2
		 0F 18 8A 92
		 87 84 48 A3
		 A0 98 09 80
		 5F 02 F7 05
		 E9 02 FA 07
		 00 00 D5 ED
		 2B F3 E5 07
		 F4 DD 97 BD
		 CE F8 23 00
		 F1 D5 DA 01
		 6C 05 AB 01
		 CE 01 32 00
		 81 01 86 02
		 8F 05 C2 00
		 05 02 91 03
		 11 02 75 00
		 26 04 52 00
		 32 00 3E 00
		 45 64 4F 00
		 53 00 52 00
		 52 F0 52 00
		 52 08 4A 10
		 4B 10 35 00
		 40 28 42 48
		 48 60 4E 0B
		 4E 00 44 00
		 4A 08 54 00
		 4C 00 41 00
		 34 08 41 08
		 47 00 4F 20
		 5E 40 59 50
		 4C 12 52 00
		 5B 00 4E 08
		 D8 F8 9F 1F
		 4C 06 0D 0B
		 DA 0C DB 1B
		 B2 22 50 3C
		 87 4B C5 17
		 66 02 BB 04
		 26 03 66 15
		 3F 0A C3 20
		 A7 04 DC 02
		 FF 05 87 1C
		 01 03 82 04
		 3C 03 7B 18
		 D1 02 B4 05
		 A0 02 80 00
		 9B 1F CD 05
		 23 02 33 05
		 8B 1C A8 02
		 00 05 EC 02
		 90 18 71 02
		 7D 04 89 03
		 79 00 6C 01
		 C0 00 FA 00
		 1D 0C 00 00
	];
};
