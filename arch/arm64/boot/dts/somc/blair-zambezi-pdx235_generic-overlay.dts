/dts-v1/;
/plugin/;

#include "../qcom/blair-qrd.dtsi"
#include "../qcom/holi-qrd-pm7250b.dtsi"
#include "blair-zambezi-pdx235_generic.dtsi"

/ {
	model = "Sony Mobile Communications. PDX235(BLAIR v1)";
	compatible = "somc,pdx235", "qcom,blair", "qcom,qrd";
	qcom,board-id = <0x1000B 0>;
	qcom,pmic-id-size = <4>;
	qcom,pmic-id = <0x2D 0x0 0x2E 0x0>;
};

&pm7250b_charger {
	dpdm-supply = <&usb2_phy0>;
};
