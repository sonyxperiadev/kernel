// SPDX-License-Identifier: GPL-2.0-only
/*
 * Copyright (c) 2019, The Linux Foundation. All rights reserved.
 */

&usb0 {
	dwc3@4e00000 {
		/delete-property/ snps,has-lpm-erratum;
		usb-phy = <&qusb_phy0>, <&usb_nop_phy>;
		maximum-speed = "high-speed";
	};

	ssphy@1615000 {
		status = "disabled";
	};
};


&qusb_phy0 {
	qcom,qusb-phy-init-seq = <0xf8 0x80
				0xb3 0x84
				0x81 0x88
				0xc7 0x8c
				0x30 0x08
				0x79 0x0c
				0x21 0x10
				0x14 0x9c
				0x80 0x04
				0x9f 0x1c
				0x00 0x18>;
};
