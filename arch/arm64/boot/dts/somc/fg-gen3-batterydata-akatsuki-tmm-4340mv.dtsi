// SPDX-License-Identifier: GPL-2.0-only
/*
 * Copyright (c) 2018, The Linux Foundation. All rights reserved.
 */

qcom,akatsuki_tmm_4340mv {
	qcom, = <24>;
	somc,initial-capacity-uah = <3325000>;
	qcom,max-voltage-uv = <4335000>;
	qcom,fg-cc-cv-threshold-mv = <4325>;
	qcom,fastchg-current-ma = <2400>;
	qcom,batt-id-kohm = <330>;
	qcom,battery-beta = <4050>;
	qcom,battery-type = "1312-6095-1";
	qcom,checksum = <0xA464>;
	qcom,gui-version = "PMI8998GUI - 2.0.0.58";
	qcom,fg-profile-data = [
		 9D 1F B6 05
		 2A 0A 5B FD
		 90 1C 3B 02
		 B2 0D 49 0A
		 08 18 9D 22
		 5E 3C 80 4B
		 81 00 00 00
		 16 00 00 00
		 00 00 2D B3
		 61 CD F2 C2
		 29 00 08 00
		 C5 D5 F5 07
		 D6 05 1D 01
		 C4 06 7F 0A
		 82 05 A2 32
		 1C 06 09 20
		 27 00 14 00
		 BE 1F B1 05
		 39 0A 1D FD
		 7B 1C 3B 03
		 F9 15 03 12
		 7B 18 BB 22
		 D8 45 66 52
		 71 00 00 00
		 13 00 00 00
		 00 00 B6 CD
		 F5 CA C3 CD
		 23 00 00 00
		 E2 DB F5 07
		 FA 05 03 01
		 21 07 61 0A
		 DD F5 21 12
		 99 33 CC FF
		 07 10 00 00
		 74 0C 5C 45
		 23 00 40 00
		 A4 01 0A FA
		 FF 00 00 00
		 00 00 00 00
		 00 00 00 00
		 00 00 00 00
		 00 00 00 00
		 00 00 00 00
		 00 00 00 00
		 00 00 00 00
		 00 00 00 00
		 00 00 00 00
		 00 00 00 00
		 00 00 00 00
		 00 00 00 00
		 00 00 00 00
		 00 00 00 00
		 00 00 00 00
		 00 00 00 00
		 00 00 00 00
		 00 00 00 00
	];
};
