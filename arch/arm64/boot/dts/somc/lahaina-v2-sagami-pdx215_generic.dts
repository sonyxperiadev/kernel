/dts-v1/;

#include "../qcom/lahaina-v2.dtsi"
#include "../qcom/lahaina-mtp-v2.dtsi"
#include "lahaina-sagami-pdx215_generic.dtsi"

/ {
	model = "Sony Mobile Communications. PDX-215(LAHAINA v2)";
	compatible = "somc,pdx215-generic", "qcom,lahaina", "qcom,mtp";
	qcom,board-id = <0x20008 0>;
};
