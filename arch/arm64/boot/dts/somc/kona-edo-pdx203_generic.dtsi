/* arch/arm64/boot/dts/vendor/somc/kona-edo-pdx203_generic.dtsi
 *
 * This program is free software; you can redistribute it and/or modify
 * it under the terms of the GNU General Public License version 2 and
 * only version 2 as published by the Free Software Foundation.
 *
 * This program is distributed in the hope that it will be useful,
 * but WITHOUT ANY WARRANTY; without even the implied warranty of
 * MERCHANTABILITY or FITNESS FOR A PARTICULAR PURPOSE.  See the
 * GNU General Public License for more details.
 */

#include "kona-edo-pdx203_common.dtsi"

&soc {
};

#include "somc-edo-display.dtsi"
#include "somc-edo-display-pdx203.dtsi"
#include "somc-edo-nfc_pn557.dtsi"
