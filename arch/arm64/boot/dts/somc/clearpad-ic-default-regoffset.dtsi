// SPDX-License-Identifier: GPL-2.0-only
/*
 * Copyright (c) 2015-2017, The Linux Foundation. All rights reserved.
 */

&synaptics_clearpad {
	somc,clearpad-f01-rmi-cmd00		= <0x00>;
	somc,clearpad-f01-rmi-ctrl00		= <0x00>;
	somc,clearpad-f01-rmi-ctrl01		= <0x01>;
	somc,clearpad-f01-rmi-data00		= <0x00>;
	somc,clearpad-f01-rmi-data01		= <0x01>;
	somc,clearpad-f01-rmi-query11		= <0x0B>;

	somc,clearpad-f34-flash-ctrl00		= <0x00>;
	somc,clearpad-f34-flash-data00		= <0x00>;
	somc,clearpad-f34-flash-data01		= <0x01>;
	somc,clearpad-f34-flash-data02		= <0x02>;
	somc,clearpad-f34-flash-data03		= <0x03>;
	somc,clearpad-f34-flash-data04		= <0x04>;
	somc,clearpad-f34-flash-data05		= <0x05>;
	somc,clearpad-f34-flash-query00		= <0x00>;
	somc,clearpad-f34-flash-query01		= <0x01>;
	somc,clearpad-f34-flash-query03		= <0x03>;
};

#include "clearpad-ic-s332u-regoffset.dtsi"
#include "clearpad-ic-s3330-regoffset.dtsi"
#include "clearpad-ic-s3500-regoffset.dtsi"
#include "clearpad-ic-td4353-regoffset.dtsi"
