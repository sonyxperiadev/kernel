// SPDX-License-Identifier: GPL-2.0-only
/*
 * Copyright (c) 2016, The Linux Foundation. All rights reserved.
 */

/dts-v1/;

#include "../qcom/sdm845-v2.1.dtsi"
#include "../qcom/sdm845-sde-display.dtsi"
#include "../qcom/sdm845-mtp.dtsi"
#include "sdm845-tama-apollo_generic.dtsi"

/ {
	model = "Sony Mobile Communications. Apollo(SDM845 v2.1)";
	compatible = "somc,apollo-row", "qcom,sdm845", "qcom,mtp";
	qcom,board-id = <8 0>;
};
