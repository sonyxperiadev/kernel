// SPDX-License-Identifier: GPL-2.0-only
/*
 * Copyright (c) 2019, The Linux Foundation. All rights reserved.
 */

/dts-v1/;

#include "../qcom/trinket.dtsi"
#include "../qcom/trinket-idp.dtsi"
#include "trinket-seine-pdx201_generic.dtsi"

/ {
	model = "Sony Mobile Communications Inc., PDX-201(TRINKET)";
	compatible = "somc,pdx201-generic", "qcom,trinket", "qcom,idp";
	qcom,board-id = <34 0>;
};
