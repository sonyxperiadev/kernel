#include "blair-zambezi-common.dtsi"
#include "blair-zambezi-camera.dtsi"
#include "blair-fingerprint.dtsi"

&soc {
};

#include "charger-zambezi-common.dtsi"
#include "charger-zambezi-pdx235.dtsi"
#include "somc-zambezi-display.dtsi"
#include "somc-zambezi-display-pdx235.dtsi"
#include "somc-zambezi-nfc.dtsi"
