#include <dt-bindings/pinctrl/qcom,pmic-gpio.h>
#include <dt-bindings/gpio/gpio.h>
#include <dt-bindings/input/input.h>

&soc {
	somc_pinctrl: somc_pinctrl {
		compatible = "somc-pinctrl";
		pinctrl-names = "platform_common_default",
				"product_common_default",
				"variant_default";
		pinctrl-0 = <&sm_gpio_0 &sm_gpio_1 &sm_gpio_2 &sm_gpio_3 &sm_gpio_6 &sm_gpio_7
			     &sm_gpio_8 &sm_gpio_9 &sm_gpio_10 &sm_gpio_11 &sm_gpio_12
			     &sm_gpio_13 &sm_gpio_14 &sm_gpio_15 &sm_gpio_16 &sm_gpio_17
			     &sm_gpio_20 &sm_gpio_21 /*&sm_gpio_22 &sm_gpio_23 &sm_gpio_24*/
			     &sm_gpio_25 &sm_gpio_26 &sm_gpio_27 &sm_gpio_28 &sm_gpio_29
			     &sm_gpio_30 &sm_gpio_31 &sm_gpio_32 &sm_gpio_33 &sm_gpio_34
			     &sm_gpio_35 &sm_gpio_36 &sm_gpio_37 &sm_gpio_38 &sm_gpio_39
			     &sm_gpio_40 &sm_gpio_41 &sm_gpio_42 &sm_gpio_43 &sm_gpio_48
			     &sm_gpio_49 &sm_gpio_50 &sm_gpio_51 &sm_gpio_52 &sm_gpio_53
			     &sm_gpio_54 &sm_gpio_55 &sm_gpio_56 &sm_gpio_57 &sm_gpio_58
			     &sm_gpio_59 &sm_gpio_60 &sm_gpio_61 &sm_gpio_62 &sm_gpio_63
			     &sm_gpio_66 &sm_gpio_67 &sm_gpio_72 &sm_gpio_73 &sm_gpio_74
			     &sm_gpio_75 &sm_gpio_76 &sm_gpio_77 &sm_gpio_78 &sm_gpio_79
			     &sm_gpio_80 /*&sm_gpio_82*/ &sm_gpio_83 &sm_gpio_84 &sm_gpio_85
			     &sm_gpio_86 &sm_gpio_87 &sm_gpio_89 &sm_gpio_90 &sm_gpio_91
			     &sm_gpio_92 &sm_gpio_97 &sm_gpio_98 &sm_gpio_99_suspend &sm_gpio_100
			     &sm_gpio_101 &sm_gpio_102 &sm_gpio_103 &sm_gpio_104 &sm_gpio_105
			     &sm_gpio_106 &sm_gpio_107 &sm_gpio_108 &sm_gpio_109 &sm_gpio_110
			     &sm_gpio_111 &sm_gpio_112 &sm_gpio_113 &sm_gpio_114 &sm_gpio_115
			     &sm_gpio_116 &sm_gpio_117 &sm_gpio_119 &sm_gpio_120 &sm_gpio_121
			     &sm_gpio_122 &sm_gpio_123 &sm_gpio_124 &sm_gpio_125 &sm_gpio_126
			     &sm_gpio_127 &sm_gpio_128 &sm_gpio_131 &sm_gpio_132 /*&sm_gpio_154*/
			     &sm_gpio_155 &sm_gpio_156 &sm_gpio_157 &sm_gpio_158 &sm_gpio_162
			     &sm_gpio_163 &sm_gpio_164 &sm_gpio_165 &sm_gpio_166 &sm_gpio_167
			     &sm_gpio_183 &sm_gpio_184 &sm_gpio_185 &sm_gpio_186 &sm_gpio_195
			     &sm_gpio_196 &sm_gpio_197 &sm_gpio_198>;

		/* If product common default setting is needed,
		fill pinctrl-1 value in <product>_common.dtsi */
		pinctrl-1 = <>;

		/* If variant specific default setting is needed,
		fill pinctrl-2 value in <variant>.dtsi */
		pinctrl-2 = <>;
	};

	somc_pinctrl_pmic: somc_pinctrl_pmic {
		compatible = "somc-pinctrl-pmic";
		pinctrl-names = "platform_common_default",
				"product_common_default",
				"variant_default";

		pinctrl-0 = <&pmk8350_gpio_1 &pmk8350_gpio_2 /*&pmk8350_gpio_3*/ &pm8350_gpio_1 &pm8350_gpio_2
			     &pm8350_gpio_4 &pm8350_gpio_5 &pm8350_gpio_6 &pm8350_gpio_8 /*&pm8350_gpio_9*/
			     &pm8350b_gpio_1 &pm8350b_gpio_2 &pm8350b_gpio_3 &pm8350b_gpio_4 /*&pm8350b_gpio_5*/
			     &pm8350b_gpio_6 &pm8350b_gpio_7 /*&pm8350b_gpio_8*/ &pm8350c_gpio_1 &pm8350c_gpio_2
			     &pm8350c_gpio_3 &pm8350c_gpio_5 &pm8350c_gpio_6 &pm8350c_gpio_7 &pm8350c_gpio_8
			     &pm8350c_gpio_9>;

		/* If product common PMIC default setting is needed,
		fill pinctrl-1 value in <product>_common.dtsi */
		pinctrl-1 = <>;

		/* If variant specific PMIC default setting is needed,
		fill pinctrl-2 value in <variant>.dtsi */
		pinctrl-2 = <>;
	};

	egistec_vcc_pm8350_gpio_6: egistec-vcc-pm8350-gpio-6 {
		compatible = "regulator-fixed";
		regulator-name = "egistec-vcc-pm8350-gpio-6";
		regulator-min-microvolt = <3800000>;
		regulator-max-microvolt = <3800000>;
		startup-delay-us = <2000>;
		enable-active-high;
		gpio = <&pm8350_gpios 6 0>;

		/*
		 * Use a "parent" supply just to be able to turn on this VCC gpio and
		 * the pm8350c BoB (switched on by GPIO 6) regulator */
		vin-supply = <&pm8350c_bob>;
	};

	et6xx: et6xx {
		compatible = "egistec,et580";

		et51x,gpio_irq = <&tlmm 38 0x0>;
		et51x,no-low-voltage-probe;
		et51x,vana-voltage = <3800000>;
		vdd_ana-supply = <&egistec_vcc_pm8350_gpio_6>;

		pinctrl-names = "et51x_reset_reset",
				"et51x_reset_active",
				"et51x_irq_active";
		pinctrl-0 = <&EGIS_RST_sleep>;
		pinctrl-1 = <&EGIS_RST_active>;
		pinctrl-2 = <&sm_gpio_38_input_no_pull>;
		status = "ok";
	};

	/* Disable extcon_usb1 */
	extcon_usb1 {
		status = "disabled";
	};

	last_logs@ffbc0000 {
		compatible = "rd_last_logs";
		label = "last_logs";
		memory-region = "log";
	};

	reboot_reason {
		qcom,use_custom_reasons;
	};

	restart-reason {
		none {
			cmd = "none";
			reg-val = <0x00 0x00000000>;
		};

		unknown {
			cmd = "unknown";
			reg-val = <0x01 0x77665501>;
		};

		recovery {
			cmd = "recovery";
			reg-val = <0x02 0x77665500>;
			reboot-cmd;
		};

		bootloader {
			cmd = "bootloader";
			reg-val = <0x03 0x77665500>;
			reboot-cmd;
		};

		rtc {
			cmd = "rtc";
			reg-val = <0x04 0x77665500>;
			reboot-cmd;
		};

		dm-verity-device-corrupted {
			cmd = "dm-verity device corrupted";
			reg-val = <0x05 0x77665508>;
			reboot-cmd;
		};

		dm-verity-enforcing {
			cmd = "dm-verity enforcing";
			reg-val = <0x06 0x77665509>;
			reboot-cmd;
		};

		keys-clear {
			cmd = "keys clear";
			reg-val = <0x07 0x7766550A>;
			reboot-cmd;
		};

		panic {
			cmd = "panic";
			reg-val = <0x40 0xC0DEDEAD>;
		};

		oem-N {
			cmd = "oem-4E";
			reg-val = <0x61 0x6F656D4E>;
			reboot-cmd;
		};

		oem-S {
			cmd = "oem-53";
			reg-val = <0x60 0x6F656D53>;
			reboot-cmd;
		};

		oem-P {
			cmd = "oem-50";
			reg-val = <0x51 0x6F656D50>;
			reboot-cmd;
		};
	};

	sony_ext_uim_ctrl {
		compatible = "sony,ext-uim-ctrl";
		uim2_detect_en_gpio = <&tlmm 132 GPIO_ACTIVE_HIGH>;
	};

	bu520x1nvx {
		compatible = "rohm,bu520x1nvx";

		acc_cover {
			label = "lid";
			gpios = <&tlmm 80 0x1>;
			lid-pin = <1>;
			open-debounce-interval = <120>;
			close-debounce-interval = <300>;
		};
	};

	rgbcir_vreg: rgbcir_vreg {
		compatible = "regulator-fixed";
		regulator-name = "rgbcir_vreg";
		startup-delay-us = <0>;
		enable-active-high;
		gpio = <&pm8350c_gpios 6 0>;
	};
};

&tlmm {
	EGIS_RST_active: EGIS_RST_active {
		mux {
			pins = "gpio39";
			function = "gpio";
		};

		config {
			pins = "gpio39";
			drive-strength = <2>;
			bias-disable;
			output-high;
		};
	};

	EGIS_RST_sleep: EGIS_RST_sleep {
		mux {
			pins = "gpio39";
			function = "gpio";
		};

		config {
			pins = "gpio39";
			drive-strength = <2>;
			bias-disable;
			output-low;
		};
	};
};

&pm8350_gpios {
	EGIS_VCC_active: EGIS_VCC_active {
		pins = "gpio6";
		function = "normal";
		output-high;
		bias-disable;
		power-source = <0>;
	};

	EGIS_VCC_sleep: EGIS_VCC_sleep {
		pins = "gpio6";
		function = "normal";
		output-low;
		bias-disable;
		power-source = <0>;
	};
};

&wil6210 {
	status = "disabled";
};

&qupv3_se2_i2c {
	pinctrl-0 = <&sm_gpio_12 &sm_gpio_13>;
	pinctrl-1 = <&sm_gpio_12_suspend &sm_gpio_13_suspend>;
	status = "okay";
	qcom,clk-freq-out = <400000>;
		rtc6226@64 {
			compatible = "richwave,rtc6226";
			reg = <0x64>;
			fmint-gpio = <&tlmm 50 0>;
			vdd-supply = <&L7E>;
			rtc6226,vdd-supply-voltage = <2800000 2800000>;
			rtc6226,vdd-load = <30000>;
			vio-supply = <&S10B>;
			rtc6226,vio-supply-voltage = <1800000 1800000 >;
		};
};

&qupv3_se4_i2c {
	pinctrl-0 = <&sm_gpio_20 &sm_gpio_21>;
	pinctrl-1 = <&sm_gpio_20_suspend &sm_gpio_21_suspend>;
	qcom,clk-freq-out = <400000>;
	status = "okay";
};

&qupv3_se11_i2c {
	pinctrl-0 = <&sm_gpio_48 &sm_gpio_49>;
	pinctrl-1 = <&sm_gpio_48_suspend &sm_gpio_49_suspend>;
	qcom,clk-freq-out = <1000000>;
	status = "okay";

	cs35l41_l: L-cs35l41@40 {
		compatible = "cirrus,cs35l41";
		reg = <0x40>;
		interrupt-parent = <&tlmm>;
		interrupts = <36 IRQ_TYPE_LEVEL_LOW>;
		reset-gpios = <&tlmm 37 GPIO_ACTIVE_HIGH>;
		pinctrl-names = "default";
		pinctrl-0 = <&sm_gpio_36>, <&sm_gpio_37>;
		cirrus,boost-peak-milliamp = <4000>;
		cirrus,boost-ind-nanohenry = <1000>;
		cirrus,boost-cap-microfarad = <15>;
		cirrus,asp-sdout-hiz = <3>;
		cirrus,gpio-config2 {
			cirrus,gpio-src-select = <0x2>;
			cirrus,gpio-output-enable;
		};
	};

	cs35l41_r: R-cs35l41@41 {
		compatible = "cirrus,cs35l41";
		reg = <0x41>;
		interrupt-parent = <&tlmm>;
		interrupts = <36 IRQ_TYPE_LEVEL_LOW>;
		reset-gpios = <&tlmm 37 GPIO_ACTIVE_HIGH>;
		cirrus,right-channel-amp;
		cirrus,boost-peak-milliamp = <4000>;
		cirrus,boost-ind-nanohenry = <1000>;
		cirrus,boost-cap-microfarad = <15>;
		cirrus,asp-sdout-hiz = <3>;
		cirrus,gpio-config2 {
			cirrus,gpio-src-select = <0x2>;
			cirrus,gpio-output-enable;
		};
	};
};

&dai_mi2s5 {
	qcom,msm-mi2s-rx-lines = <1>;
	qcom,msm-mi2s-tx-lines = <2>;
};

&lpi_tlmm {
	somc_cdc_dmic01_clk_active: somc_dmic01_clk_active {
		mux {
			pins = "gpio6";
			function = "func1";
		};

		config {
			pins = "gpio6";
			drive-strength = <2>;
			output-high;
		};
	};

	somc_cdc_dmic01_clk_sleep: somc_dmic01_clk_sleep {
		mux {
			pins = "gpio6";
			function = "func1";
		};

		config {
			pins = "gpio6";
			drive-strength = <2>;
			bias-disable;
			output-low;
		};
	};

	somc_cdc_dmic01_data_active: somc_dmic01_data_active {
		mux {
			pins = "gpio7";
			function = "func1";
		};

		config {
			pins = "gpio7";
			drive-strength = <2>;
			input-enable;
		};
	};

	somc_cdc_dmic01_data_sleep: somc_dmic01_data_sleep {
		mux {
			pins = "gpio7";
			function = "func1";
		};

		config {
			pins = "gpio7";
			drive-strength = <2>;
			pull-down;
			input-enable;
		};
	};

	somc_cdc_dmic23_clk_active: somc_dmic23_clk_active {
		mux {
			pins = "gpio8";
			function = "func1";
		};

		config {
			pins = "gpio8";
			drive-strength = <2>;
			output-high;
		};
	};

	somc_cdc_dmic23_clk_sleep: somc_dmic23_clk_sleep {
		mux {
			pins = "gpio8";
			function = "func1";
		};

		config {
			pins = "gpio8";
			drive-strength = <2>;
			bias-disable;
			output-low;
		};
	};

	somc_cdc_dmic23_data_active: somc_dmic23_data_active {
		mux {
			pins = "gpio9";
			function = "func1";
		};

		config {
			pins = "gpio9";
			drive-strength = <2>;
			input-enable;
		};
	};

	somc_cdc_dmic23_data_sleep: somc_dmic23_data_sleep {
		mux {
			pins = "gpio9";
			function = "func1";
		};

		config {
			pins = "gpio9";
			drive-strength = <2>;
			pull-down;
			input-enable;
		};
	};
	somc_lpi_i2s2_sck_sleep: somc_lpi_i2s2_sck_sleep {
		mux {
			pins = "gpio10";
			function = "func1";
		};

		config {
			pins = "gpio10";
			drive-strength = <2>;   /* 2 mA */
			bias-pull-down;         /* PULL DOWN */
			input-enable;
		};
	};

	somc_lpi_i2s2_sck_active: somc_lpi_i2s2_sck_active {
		mux {
			pins = "gpio10";
			function = "func1";
		};

		config {
			pins = "gpio10";
			drive-strength = <2>;   /* 2 mA */
			bias-disable;           /* NO PULL */
			output-high;
		};
	};

	somc_lpi_i2s2_ws_sleep: somc_lpi_i2s2_ws_sleep {
		mux {
			pins = "gpio11";
			function = "func1";
		};

		config {
			pins = "gpio11";
			drive-strength = <2>;   /* 2 mA */
			bias-pull-down;         /* PULL DOWN */
			input-enable;
		};
	};

	somc_lpi_i2s2_ws_active: somc_lpi_i2s2_ws_active {
		mux {
			pins = "gpio11";
			function = "func1";
		};

		config {
			pins = "gpio11";
			drive-strength = <2>;   /* 2 mA */
			bias-disable;           /* NO PULL */
			output-high;
		};
	};

	somc_lpi_i2s2_sd0_sleep: somc_lpi_i2s2_sd0_sleep {
		mux {
			pins = "gpio12";
			function = "func2";
		};

		config {
			pins = "gpio12";
			drive-strength = <2>;   /* 2 mA */
			bias-pull-down;         /* PULL DOWN */
			input-enable;
		};
	};

	somc_lpi_i2s2_sd0_active: somc_lpi_i2s2_sd0_active {
		mux {
			pins = "gpio12";
			function = "func2";
		};

		config {
			pins = "gpio12";
			drive-strength = <2>;   /* 2 mA */
			bias-disable;           /* NO PULL */
			output-high;
		};
	};

	somc_lpi_i2s2_sd1_sleep: somc_lpi_i2s2_sd1_sleep {
		mux {
			pins = "gpio13";
			function = "func2";
		};

		config {
			pins = "gpio13";
			drive-strength = <2>;   /* 2 mA */
			bias-pull-down;         /* PULL DOWN */
			input-enable;
		};
	};

	somc_lpi_i2s2_sd1_active: somc_lpi_i2s2_sd1_active {
		mux {
			pins = "gpio13";
			function = "func2";
		};

		config {
			pins = "gpio13";
			drive-strength = <2>;   /* 2 mA */
			bias-disable;           /* NO PULL */
			output-high;
		};
	};
};

&tx_swr_clk_active {
	config {
		drive-strength = <2>;
	};
};

&tx_swr_data0_active {
	config {
		drive-strength = <2>;
	};
};

&tx_swr_data1_active {
	config {
		drive-strength = <2>;
	};
};

&tx_swr_data2_active {
	config {
		drive-strength = <2>;
	};
};

&q6core {
	cdc_sen_mi2s_gpios: msm_cdc_pinctrl_sen {
		compatible = "qcom,msm-cdc-pinctrl";
		pinctrl-names = "aud_active", "aud_sleep";
		pinctrl-0 = <&somc_lpi_i2s2_sck_active &somc_lpi_i2s2_ws_active
			 &somc_lpi_i2s2_sd0_active &somc_lpi_i2s2_sd1_active>;
		pinctrl-1 = <&somc_lpi_i2s2_sck_sleep &somc_lpi_i2s2_ws_sleep
			 &somc_lpi_i2s2_sd0_sleep &somc_lpi_i2s2_sd1_sleep>;
		qcom,lpi-gpios;
	};
};

&cdc_dmic01_gpios {
		pinctrl-0 = <&somc_cdc_dmic01_clk_active &somc_cdc_dmic01_data_active>;
		pinctrl-1 = <&somc_cdc_dmic01_clk_sleep &somc_cdc_dmic01_data_sleep>;
	};

&cdc_dmic23_gpios {
		pinctrl-0 = <&somc_cdc_dmic23_clk_active &somc_cdc_dmic23_data_active>;
		pinctrl-1 = <&somc_cdc_dmic23_clk_sleep &somc_cdc_dmic23_data_sleep>;
	};

&lahaina_snd {
	qcom,audio-routing =
		"AMIC1", "Analog Mic1",
		"Analog Mic1", "MIC BIAS1",
		"AMIC2", "Analog Mic2",
		"Analog Mic2", "MIC BIAS2",
		"AMIC3", "Analog Mic3",
		"Analog Mic3", "MIC BIAS3",
		"AMIC4", "Analog Mic4",
		"Analog Mic4", "MIC BIAS3",
		"AMIC5", "Analog Mic5",
		"Analog Mic5", "MIC BIAS4",
		"TX DMIC0", "Digital Mic0",
		"TX DMIC0", "MIC BIAS3",
		"TX DMIC1", "Digital Mic1",
		"TX DMIC1", "MIC BIAS3",
		"TX DMIC2", "Digital Mic2",
		"TX DMIC2", "MIC BIAS1",
		"TX DMIC3", "Digital Mic3",
		"TX DMIC3", "MIC BIAS1",
		"TX DMIC4", "Digital Mic4",
		"TX DMIC4", "MIC BIAS4",
		"TX DMIC5", "Digital Mic5",
		"TX DMIC5", "MIC BIAS4",
		"IN1_HPHL", "HPHL_OUT",
		"IN2_HPHR", "HPHR_OUT",
		"IN3_AUX", "AUX_OUT",
		"RX_TX DEC0_INP", "TX DEC0 MUX",
		"RX_TX DEC1_INP", "TX DEC1 MUX",
		"RX_TX DEC2_INP", "TX DEC2 MUX",
		"RX_TX DEC3_INP", "TX DEC3 MUX",
		"TX SWR_INPUT", "WCD_TX_OUTPUT",
		"VA SWR_INPUT", "VA_SWR_CLK",
		"VA SWR_INPUT", "WCD_TX_OUTPUT",
		"VA_AIF1 CAP", "VA_SWR_CLK",
		"VA_AIF2 CAP", "VA_SWR_CLK",
		"VA_AIF3 CAP", "VA_SWR_CLK",
		"VA DMIC0", "Digital Mic0",
		"VA DMIC1", "Digital Mic1",
		"VA DMIC2", "Digital Mic2",
		"VA DMIC3", "Digital Mic3",
		"VA DMIC4", "Digital Mic4",
		"VA DMIC5", "Digital Mic5",
		"VA DMIC0", "VA MIC BIAS3",
		"VA DMIC1", "VA MIC BIAS3",
		"VA DMIC2", "VA MIC BIAS1",
		"VA DMIC3", "VA MIC BIAS1",
		"VA DMIC4", "VA MIC BIAS4",
		"VA DMIC5", "VA MIC BIAS4";
	asoc-codec  = <&stub_codec>, <&bolero>,
		      <&wcd938x_codec>,
		      <&cs35l41_l>, <&cs35l41_r>,
		      <&cs40l25a>,
		      <&ext_disp_audio_codec>;
	asoc-codec-names = "msm-stub-codec.1", "bolero_codec",
			   "wcd938x_codec",
			   "cs35l41.3-0040", "cs35l41.3-0041",
			   "cs40l2x-codec",
			   "msm-ext-disp-audio-codec-rx";
	qcom,pri-mi2s-gpios = <&cdc_pri_mi2s_gpios>;
	qcom,sen-mi2s-gpios = <&cdc_sen_mi2s_gpios>;
	qcom,wsa-max-devs = <0>;
	/delete-property/ qcom,tert-mi2s-gpios;
};

&bolero {
	qcom,num-macros = <3>;
};

&wsa_macro {
	status = "disabled";
};

&wsa_spkr_en1 {
	status = "disabled";
};

&wsa_spkr_en2 {
	status = "disabled";
};

&wsa_swr_gpios {
	status = "disabled";
};

&swr1 {
	qcom,swr-num-dev = <1>;
};

&swr_haptics {
	status = "disabled";
};

&swr2 {
	qcom,swr-num-dev = <1>;
	qcom,swr-phy-dev-addr = <0x0D 0x01170223>;
};

&swr_dmic_01 {
	status = "disabled";
};

&swr_dmic_02 {
	status = "disabled";
};

&swr_dmic_03 {
	status = "disabled";
};

&swr_dmic_04 {
	status = "disabled";
};


&qupv3_se12_i2c {
	pinctrl-0 = <&sm_gpio_52 &sm_gpio_53>;
	pinctrl-1 = <&sm_gpio_52_suspend &sm_gpio_53_suspend>;
	status = "okay";
	tcs3490:tcs3490@72 {
		compatible = "ams,tcs3490";
		reg = <0x72>;
		interrupt-parent = <&tlmm>;
		interrupts = <99 0x0>;
		rgbcir_vio-supply = <&L7I>;
		rgbcir_gpio_vdd-supply = <&rgbcir_vreg>;
		pinctrl-names = "rgbcir_irq_active", "rgbcir_irq_suspend";
		pinctrl-0 = <&sm_gpio_99>;
		pinctrl-1 = <&sm_gpio_99_suspend>;
		ams,rgbcir-vdd-supply = <0>;
		ams,rgbcir-gpio-vdd = <1>;
		ams,rgbcir-vio-supply = <1>;
	};
};

&qupv3_se13_i2c {
	pinctrl-0 = <&sm_gpio_0 &sm_gpio_1>;
	pinctrl-1 = <&sm_gpio_0_suspend &sm_gpio_1_suspend>;
	status = "okay";
	pm8008i@8 {
		pinctrl-0 = <&sm_gpio_6>;
	};
	pm8008i@9 {
		qcom,pm8008i-regulator {
			vdd_l1_l2-supply = <&BOB>;
			vdd_l5-supply = <&BOB>;

			regulator@4600 {
				regulator-min-microvolt = <1800000>;
			};
		};
	};
	pm8008j@c {
		pinctrl-0 = <&sm_gpio_167>;
	};
	pm8008j@d {
		qcom,pm8008j-regulator {
			vdd_l3_l4-supply = <&BOB>;

			regulator@4000 {
				regulator-max-microvolt = <1200000>;
			};

			regulator@4200 {
				regulator-max-microvolt = <2800000>;
			};

			regulator@4300 {
				regulator-max-microvolt = <2800000>;
			};

			regulator@4600 {
				regulator-min-microvolt = <1800000>;
			};
		};
	};
};

&qupv3_se15_i2c {
	pinctrl-0 = <&sm_gpio_60 &sm_gpio_61>;
	pinctrl-1 = <&sm_gpio_60_suspend &sm_gpio_61_suspend>;
	qcom,clk-freq-out = <400000>;
	status = "okay";
};

&qupv3_se17_i2c {
	pinctrl-0 = <&sm_gpio_72 &sm_gpio_73>;
	pinctrl-1 = <&sm_gpio_72_suspend &sm_gpio_73_suspend>;
	qcom,clk-freq-out = <1000000>;
	status = "okay";

	cs40l25a: cs40l25a@40 {
		compatible = "cirrus,cs40l25a";
		reg = <0x40>;
		reset-gpios = <&tlmm 3 GPIO_ACTIVE_HIGH>;
		interrupt-parent = <&tlmm>;
		interrupts = <51 IRQ_TYPE_LEVEL_LOW>;
		cirrus,boost-ind-nanohenry = <1000>;
		cirrus,boost-cap-microfarad = <15>;
		cirrus,boost-ipk-milliamp = <4000>;
		cirrus,hiber-enable;
		cirrus,fw-id-remap = <0x1400D0>;
		cirrus,f0-default = <2293760>;
		cirrus,f0-min = <1310720>;
		cirrus,f0-max = <3276800>;
		cirrus,redc-default = <223787>;
		cirrus,redc-min = <111893>;
		cirrus,redc-max = <447574>;
		cirrus,auto-recovery;
	};
};

&dai_mi2s0 {
	qcom,msm-mi2s-rx-lines = <1>;
	qcom,msm-mi2s-tx-lines = <0>;
};

&tlmm {
	somc_pri_mi2s_sck_sleep: somc_pri_mi2s_sck_sleep {
		mux {
			pins = "gpio125";
			function = "gpio";
		};

		config {
			pins = "gpio125";
			drive-strength = <2>;   /* 2 mA */
			bias-pull-down;         /* PULL DOWN */
			input-enable;
		};
	};

	somc_pri_mi2s_sck_active: somc_pri_mi2s_sck_active {
		mux {
			pins = "gpio125";
			function = "mi2s0_sck";
		};

		config {
			pins = "gpio125";
			drive-strength = <2>;   /* 2 mA */
			bias-disable;           /* NO PULL */
			output-high;
		};
	};

	somc_pri_mi2s_ws_sleep: somc_pri_mi2s_ws_sleep {
		mux {
			pins = "gpio128";
			function = "gpio";
		};

		config {
			pins = "gpio128";
			drive-strength = <2>;   /* 2 mA */
			bias-pull-down;         /* PULL DOWN */
			input-enable;
		};
	};

	somc_pri_mi2s_ws_active: somc_pri_mi2s_ws_active {
		mux {
			pins = "gpio128";
			function = "mi2s0_ws";
		};

		config {
			pins = "gpio128";
			drive-strength = <2>;   /* 2 mA */
			bias-disable;           /* NO PULL */
			output-high;
		};
	};

	somc_pri_mi2s_sd0_sleep: somc_pri_mi2s_sd0_sleep {
		mux {
			pins = "gpio126";
			function = "gpio";
		};

		config {
			pins = "gpio126";
			drive-strength = <2>;   /* 2 mA */
			bias-pull-down;         /* PULL DOWN */
			input-enable;
		};
	};

	somc_pri_mi2s_sd0_active: somc_pri_mi2s_sd0_active {
		mux {
			pins = "gpio126";
			function = "mi2s0_data0";
		};

		config {
			pins = "gpio126";
			drive-strength = <2>;   /* 2 mA */
			bias-disable;           /* NO PULL */
			output-high;
		};
	};
};

&q6core {
	cdc_pri_mi2s_gpios: msm_cdc_pinctrl_pri {
		compatible = "qcom,msm-cdc-pinctrl";
		pinctrl-names = "aud_active", "aud_sleep";
		pinctrl-0 = <&somc_pri_mi2s_sck_active &somc_pri_mi2s_ws_active
			 &somc_pri_mi2s_sd0_active>;
		pinctrl-1 = <&somc_pri_mi2s_sck_sleep &somc_pri_mi2s_ws_sleep
			 &somc_pri_mi2s_sd0_sleep>;
	};
};

/* Regulator config */
&pm8350c_bob {
	regulator-min-microvolt = <3400000>;
	qcom,init-voltage = <3400000>;
	status = "okay";
};

&wcd938x_codec {
	qcom,cdc-vdd-mic-bias-voltage = <3400000 3960000>;
};

&pm8350c_l2 {
	qcom,regulator-type = <0>;      /* LDO */
	regulator-min-microvolt = <1800000>;
	regulator-max-microvolt = <1800000>;
	qcom,init-voltage = <1800000>;
	status = "okay";
};

&pm8350c_l3 {
	qcom,regulator-type = <0>;
	regulator-min-microvolt = <3300000>;
	regulator-max-microvolt = <3300000>;
	qcom,init-voltage = <3300000>;
	status = "okay";
};

&pmk8350_gpios {

	/* GPIO_1: NC */
	pmk8350_gpio_1: pmk8350_gpio_1 {
		pins = "gpio1";
		function = "normal";
		bias-high-impedance; /* DISABLE GPIO_1 */
	};

	/* GPIO_2: NC */
	pmk8350_gpio_2: pmk8350_gpio_2 {
		pins = "gpio2";
		function = "normal";
		bias-high-impedance; /* DISABLE GPIO_2 */
	};

	/* GPIO_3: VOL_DOWN_N */
	pmk8350_gpio_3: pmk8350_gpio_3 {
		pins = "gpio3";
		function = "normal";
		input-enable;
		bias-pull-up;
		power-source = <0>;
	};

	/* GPIO_4: PMK8350_OPTION */
	/* Follow QC */

};

&pm8350_gpios {

	/* GPIO_1: ASSIGN1_THERM */
	pm8350_gpio_1: pm8350_gpio_1 {
		pins = "gpio1";
		function = "normal";
		bias-high-impedance; /* DISABLE GPIO_1 Analog PIN*/
	};

	/* GPIO_2: LCD_ID */
	pm8350_gpio_2: pm8350_gpio_2 {
		pins = "gpio2";
		function = "normal";
		bias-high-impedance; /* DISABLE GPIO_2 Analog PIN*/
	};

	/* GPIO_3: SDR_MMW_THERM */
	/* Follow QC */

	/* GPIO_4: RF_ID */
	pm8350_gpio_4: pm8350_gpio_4 {
		pins = "gpio4";
		function = "normal";
		bias-high-impedance; /* DISABLE GPIO_4 Analog PIN*/
	};

	/* GPIO_5: NC */
	pm8350_gpio_5: pm8350_gpio_5 {
		pins = "gpio5";
		function = "normal";
		bias-high-impedance; /* DISABLE GPIO_5 */
	};

	/* GPIO_6: FP_LDO_EN */
	pm8350_gpio_6: pm8350_gpio_6 {
		pins = "gpio6";
		function = "normal";
		output-low;
		drive-push-pull;
		qcom,drive-strength = <PMIC_GPIO_STRENGTH_LOW>;
		power-source = <1>;
	};

	/* GPIO_7: SP_ARI_PWR_ALARM */
	/* Follow QC */

	/* GPIO_8: NC */
	pm8350_gpio_8: pm8350_gpio_8 {
		pins = "gpio8";
		function = "normal";
		bias-high-impedance; /* DISABLE GPIO_8 */
	};

	/* GPIO_9: G_ASSIST_N */
	pm8350_gpio_9: pm8350_gpio_9 {
		pins = "gpio9";
		function = "normal";
		input-enable;
		bias-pull-up;
		power-source = <1>;
	};

	/* GPIO_10: PM8350_OPTION */
	/* Follow QC */

};

&pm8350b_gpios {

	/* GPIO_1: NC */
	pm8350b_gpio_1: pm8350b_gpio_1 {
		pins = "gpio1";
		function = "normal";
		bias-high-impedance; /* DISABLE GPIO_1 */
	};

	/* GPIO_2: NC */
	pm8350b_gpio_2: pm8350b_gpio_2 {
		pins = "gpio2";
		function = "normal";
		bias-high-impedance; /* DISABLE GPIO_2*/
	};

	/* GPIO_3: NC */
	pm8350b_gpio_3: pm8350b_gpio_3 {
		pins = "gpio3";
		function = "normal";
		bias-high-impedance; /* DISABLE GPIO_3 */
	};

	/* GPIO_4: NC */
	pm8350b_gpio_4: pm8350b_gpio_4 {
		pins = "gpio4";
		function = "normal";
		bias-high-impedance; /* DISABLE GPIO_4 */
	};

	/* GPIO_5: SNAPSHOT_N */
	pm8350b_gpio_5: pm8350b_gpio_5 {
		pins = "gpio5";
		function = "normal";
		input-enable;
		bias-pull-up;
		power-source = <0>;
	};

	/* GPIO_6: NC */
	pm8350b_gpio_6: pm8350b_gpio_6 {
		pins = "gpio6";
		function = "normal";
		bias-high-impedance; /* DISABLE GPIO_6 */
	};

	/* GPIO_7: NC */
	pm8350b_gpio_7: pm8350b_gpio_7 {
		pins = "gpio7";
		function = "normal";
		bias-high-impedance; /* DISABLE GPIO_7 */
	};

	/* GPIO_8: FOCUS_N */
	pm8350b_gpio_8: pm8350b_gpio_8 {
		pins = "gpio8";
		function = "normal";
		input-enable;
		bias-pull-up;
		power-source = <0>;
	};
};

&pm8350c_gpios {

	/* GPIO_1: FL_STROBE_TRIG_WIDE */
	pm8350c_gpio_1: pm8350c_gpio_1 {
		pins = "gpio1";
		function = "normal";
		input-enable;
		bias-pull-down;
		power-source = <0>;
	};

	/* GPIO_2: FL_STROBE_TRIG_TELE */
	pm8350c_gpio_2: pm8350c_gpio_2 {
		pins = "gpio2";
		function = "normal";
		input-enable;
		bias-pull-down;
		power-source = <0>;
	};

	/* GPIO_3: NC */
	pm8350c_gpio_3: pm8350c_gpio_3 {
		pins = "gpio3";
		function = "normal";
		bias-high-impedance; /* DISABLE GPIO_3 */
	};

	/* GPIO_4: NC */
	/* Don't set here */

	/* GPIO_5: NC */
	pm8350c_gpio_5: pm8350c_gpio_5 {
		pins = "gpio5";
		function = "normal";
		bias-high-impedance; /* DISABLE GPIO_5 */
	};

	/* GPIO_6: RGBC_IR_PWR_EN */
	pm8350c_gpio_6: pm8350c_gpio_6 {
		pins = "gpio6";
		function = "normal";
		output-low;
		drive-push-pull;
		qcom,drive-strength = <PMIC_GPIO_STRENGTH_LOW>;
		power-source = <1>;
	};

	/* GPIO_7: NC */
	pm8350c_gpio_7: pm8350c_gpio_7 {
		pins = "gpio7";
		function = "normal";
		bias-high-impedance; /* DISABLE GPIO_7 */
	};

	/* GPIO_8: NC */
	pm8350c_gpio_8: pm8350c_gpio_8 {
		pins = "gpio8";
		function = "normal";
		bias-high-impedance; /* DISABLE GPIO_8 */
	};

	/* GPIO_9: WIDEC_PWR_EN */
	pm8350c_gpio_9: pm8350c_gpio_9 {
		pins = "gpio9";
		function = "normal";
		output-low;
		drive-push-pull;
		qcom,drive-strength = <PMIC_GPIO_STRENGTH_LOW>;
		power-source = <1>;
	};
};

/* Disable extcon_usb1 and usb1 */
&usb1 {
	extcon = <0>;
	status = "disabled";
};

/* Primary USB maximum-speed */
&usb0 {
	dwc3@a600000 {
		maximum-speed = "super-speed";
	};
};

&pcie1 {
	status = "disabled";
};

&tlmm {
	somc_ts_int_active: somc_ts_int_active {
		mux {
			pin = "gpio23";
			function = "gpio";
		};

		config {
			pins = "gpio23";
			driver-strength = <2>;
			bias-disable;
			input-enable;
		};
	};

	somc_ts_int_suspend: somc_ts_int_suspend {
		mux {
			pin = "gpio23";
			function = "gpio";
		};

		config {
			pins = "gpio23";
			driver-strength = <2>;
			bias-disable;
			input-enable;
		};
	};
	/* GPIO_23, TS_INT_N */
	sm_gpio_23: sm_gpio_23 {
		mux {
			pin = "gpio23";
			function = "gpio";
		};

		config {
			pins = "gpio23";
			driver-strength = <2>;
			bias-disable;
			input-enable;
		};
	};
};

&tlmm {

	/* GPIO_0 : APPS_I2C_0_SDA */
	sm_gpio_0: sm_gpio_0 {
		mux {
			pins = "gpio0";
			function = "qup13";
		};

		config {
			pins = "gpio0";
			drive-strength = <2>;
			bias-disable;
		};
	};

	/* GPIO_0 : APPS_I2C_0_SDA (Suspend) */
	sm_gpio_0_suspend: sm_gpio_0_suspend {
		mux {
			pins = "gpio0";
			function = "gpio";
		};

		config {
			pins = "gpio0";
			drive-strength = <2>;
			bias-disable;
			input-enable;
		};
	};

	/* GPIO_1 : APPS_I2C_0_SCL */
	sm_gpio_1: sm_gpio_1 {
		mux {
			pins = "gpio1";
			function = "qup13";
		};

		config {
			pins = "gpio1";
			drive-strength = <2>;
			bias-disable;
		};
	};

	/* GPIO_1 : APPS_I2C_0_SCL (Suspend) */
	sm_gpio_1_suspend: sm_gpio_1_suspend {
		mux {
			pins = "gpio1";
			function = "gpio";
		};

		config {
			pins = "gpio1";
			drive-strength = <2>;
			bias-disable;
			input-enable;
		};
	};

	/* GPIO_2 : UWIDEC_PWR_EN */
	sm_gpio_2: sm_gpio_2 {
		mux {
			pins = "gpio2";
			function = "gpio";
		};

		config {
			pins = "gpio2";
			drive-strength = <2>;
			bias-disable;
			output-low;
		};
	};

	/* GPIO_3 : HAP_RST_N */
	sm_gpio_3: sm_gpio_3 {
		mux {
			pins = "gpio3";
			function = "gpio";
		};

		config {
			pins = "gpio3";
			drive-strength = <2>;
			bias-disable;
			output-low;
		};
	};

	/* GPIO_4 : NC */
	/* Don't set here */

	/* GPIO_5 : NC */
	/* Don't set here */

	/* GPIO_6 : PM8008_1_RESET_N */
	sm_gpio_6: sm_gpio_6 {
		mux {
			pins = "gpio6";
			function = "gpio";
		};

		config {
			pins = "gpio6";
			drive-strength = <2>;
			bias-disable;
			output-high;
		};
	};

	/* GPIO_7 : NC */
	sm_gpio_7: sm_gpio_7 {
		mux {
			pins = "gpio7";
			function = "gpio";
		};

		config {
			pins = "gpio7";
			drive-strength = <2>;
			bias-pull-down;
			input-enable;
		};
	};

	/* GPIO_8 : OIS_TELE_I2C_SDA */
	sm_gpio_8: sm_gpio_8 {
		mux {
			pins = "gpio8";
			function = "qup1";
		};

		config {
			pins = "gpio8";
			drive-strength = <2>;
			bias-disable;
		};
	};

	/* GPIO_8 : OIS_TELE_I2C_SDA (Suspend) */
	sm_gpio_8_suspend: sm_gpio_8_suspend {
		mux {
			pins = "gpio8";
			function = "qup1";
		};

		config {
			pins = "gpio8";
			drive-strength = <2>;
			bias-pull-down;
		};
	};

	/* GPIO_9 : OIS_TELE_I2C_SCL */
	sm_gpio_9: sm_gpio_9 {
		mux {
			pins = "gpio9";
			function = "qup1";
		};

		config {
			pins = "gpio9";
			drive-strength = <2>;
			bias-disable;
		};
	};

	/* GPIO_9 : OIS_TELE_I2C_SCL (Suspend) */
	sm_gpio_9_suspend: sm_gpio_9_suspend {
		mux {
			pins = "gpio9";
			function = "qup1";
		};

		config {
			pins = "gpio9";
			drive-strength = <2>;
			bias-pull-down;
		};
	};

	/* GPIO_10 : NC */
	sm_gpio_10: sm_gpio_10 {
		mux {
			pins = "gpio10";
			function = "gpio";
		};

		config {
			pins = "gpio10";
			drive-strength = <2>;
			bias-pull-down;
			input-enable;
		};
	};

	/* GPIO_11 : NC */
	sm_gpio_11: sm_gpio_11 {
		mux {
			pins = "gpio11";
			function = "gpio";
		};

		config {
			pins = "gpio11";
			drive-strength = <2>;
			bias-pull-down;
			input-enable;
		};
	};

	/* GPIO_12 : APPS_I2C_1_SDA */
	sm_gpio_12: sm_gpio_12 {
		mux {
			pins = "gpio12";
			function = "qup2";
		};

		config {
			pins = "gpio12";
			drive-strength = <2>;
			bias-disable;
		};
	};

	/* GPIO_12 : APPS_I2C_1_SDA (Suspend) */
	sm_gpio_12_suspend: sm_gpio_12_suspend {
		mux {
			pins = "gpio12";
			function = "gpio";
		};

		config {
			pins = "gpio12";
			drive-strength = <2>;
			bias-disable;
			input-enable;
		};
	};


	/* GPIO_13 : APPS_I2C_1_SCL */
	sm_gpio_13: sm_gpio_13 {
		mux {
			pins = "gpio13";
			function = "qup2";
		};

		config {
			pins = "gpio13";
			drive-strength = <2>;
			bias-disable;
		};
	};

	/* GPIO_13 : APPS_I2C_1_SCL (Suspend) */
	sm_gpio_13_suspend: sm_gpio_13_suspend {
		mux {
			pins = "gpio13";
			function = "gpio";
		};

		config {
			pins = "gpio13";
			drive-strength = <2>;
			bias-disable;
			input-enable;
		};
	};

	/* GPIO_14 : NC */
	sm_gpio_14: sm_gpio_14 {
		mux {
			pins = "gpio14";
			function = "gpio";
		};

		config {
			pins = "gpio14";
			drive-strength = <2>;
			bias-pull-down;
			input-enable;
		};
	};

	/* GPIO_15 : NC */
	sm_gpio_15: sm_gpio_15 {
		mux {
			pins = "gpio15";
			function = "gpio";
		};

		config {
			pins = "gpio15";
			drive-strength = <2>;
			bias-pull-down;
			input-enable;
		};
	};

	/* GPIO_16 : CAM1_RESET_N */
	sm_gpio_16: sm_gpio_16 {
		mux {
			pins = "gpio16";
			function = "gpio";
		};

		config {
			pins = "gpio16";
			drive-strength = <2>;
			bias-disable;
			output-low;
		};
	};

	/* GPIO_17 : LEO_CAM0_RESET_N */
	sm_gpio_17: sm_gpio_17 {
		mux {
			pins = "gpio17";
			function = "gpio";
		};

		config {
			pins = "gpio17";
			drive-strength = <2>;
			bias-disable;
			output-low;
		};
	};

	/* GPIO_18 : DEBUG_UART_TX */
	/* Follow QC */

	/* GPIO_19 : DEBUG_UART_RX */
	/* Follow QC */

	/* GPIO_20 : TS_I2C_SDA */
	sm_gpio_20: sm_gpio_20 {
		mux {
			pins = "gpio20";
			function = "qup4";
		};

		config {
			pins = "gpio20";
			drive-strength = <2>;
			bias-disable;
		};
	};

	/* GPIO_20 : TS_I2C_SDA (Suspend) */
	sm_gpio_20_suspend: sm_gpio_20_suspend {
		mux {
			pins = "gpio20";
			function = "gpio";
		};

		config {
			pins = "gpio20";
			drive-strength = <2>;
			bias-disable;
			input-enable;
		};
	};

	/* GPIO_21 : TS_I2C_SCL */
	sm_gpio_21: sm_gpio_21 {
		mux {
			pins = "gpio21";
			function = "qup4";
		};

		config {
			pins = "gpio21";
			drive-strength = <2>;
			bias-disable;
		};
	};

	/* GPIO_21 : TS_I2C_SCL (Suspend) */
	sm_gpio_21_suspend: sm_gpio_21_suspend {
		mux {
			pins = "gpio21";
			function = "gpio";
		};

		config {
			pins = "gpio21";
			drive-strength = <2>;
			bias-disable;
			input-enable;
		};
	};

	/* GPIO_22 : TS_RESET_N */
	sm_gpio_22: sm_gpio_22 {
		mux {
			pins = "gpio22";
			function = "gpio";
		};

		config {
			pins = "gpio22";
			drive-strength = <2>;
			output-low;
		};
	};

	/* GPIO_24 : DISP_RESET_N */
	sm_gpio_24: sm_gpio_24 {
		mux {
			pins = "gpio24";
			function = "gpio";
		};

		config {
			pins = "gpio24";
			drive-strength = <2>;
			bias-disable;
		};
	};

	/* GPIO_25 : SW_SERVICE */
	sm_gpio_25: sm_gpio_25 {
		mux {
			pins = "gpio25";
			function = "gpio";
		};

		config {
			pins = "gpio25";
			drive-strength = <2>;
			bias-pull-up;
			input-enable;
		};
	};

	/* GPIO_26 : DISP_ERR_FG */
	sm_gpio_26: sm_gpio_26 {
		mux {
			pins = "gpio26";
			function = "gpio";
		};

		config {
			pins = "gpio26";
			drive-strength = <2>;
			bias-pull-down;
			input-enable;
		};
	};

	/* GPIO_27 : TX_GTR_THRES_IN */
	sm_gpio_27: sm_gpio_27 {
		mux {
			pins = "gpio27";
			function = "gpio";
		};

		config {
			pins = "gpio27";
			drive-strength = <2>;
			bias-pull-down;
			input-enable;
		};
	};

	/* GPIO_28 : NC */
	sm_gpio_28: sm_gpio_28 {
		mux {
			pins = "gpio28";
			function = "gpio";
		};

		config {
			pins = "gpio28";
			drive-strength = <2>;
			bias-pull-down;
			input-enable;
		};
	};

	/* GPIO_29 : NC */
	sm_gpio_29: sm_gpio_29 {
		mux {
			pins = "gpio29";
			function = "gpio";
		};

		config {
			pins = "gpio29";
			drive-strength = <2>;
			bias-pull-down;
			input-enable;
		};
	};

	/* GPIO_30 : NC */
	sm_gpio_30: sm_gpio_30 {
		mux {
			pins = "gpio30";
			function = "gpio";
		};

		config {
			pins = "gpio30";
			drive-strength = <2>;
			bias-pull-down;
			input-enable;
		};
	};

	/* GPIO_31 : NC */
	sm_gpio_31: sm_gpio_31 {
		mux {
			pins = "gpio31";
			function = "gpio";
		};

		config {
			pins = "gpio31";
			drive-strength = <2>;
			bias-pull-down;
			input-enable;
		};
	};

	/* GPIO_32 : NC */
	sm_gpio_32: sm_gpio_32 {
		mux {
			pins = "gpio32";
			function = "gpio";
		};

		config {
			pins = "gpio32";
			drive-strength = <2>;
			bias-pull-down;
			input-enable;
		};
	};

	/* GPIO_33 : NC */
	sm_gpio_33: sm_gpio_33 {
		mux {
			pins = "gpio33";
			function = "gpio";
		};

		config {
			pins = "gpio33";
			drive-strength = <2>;
			bias-pull-down;
			input-enable;
		};
	};

	/* GPIO_34 : NC */
	sm_gpio_34: sm_gpio_34 {
		mux {
			pins = "gpio34";
			function = "gpio";
		};

		config {
			pins = "gpio34";
			drive-strength = <2>;
			bias-pull-down;
			input-enable;
		};
	};

	/* GPIO_35 : NC */
	sm_gpio_35: sm_gpio_35 {
		mux {
			pins = "gpio35";
			function = "gpio";
		};

		config {
			pins = "gpio35";
			drive-strength = <2>;
			bias-pull-down;
			input-enable;
		};
	};

	/* GPIO_36 : SPK_AMP_INT_N */
	sm_gpio_36: sm_gpio_36 {
		mux {
			pins = "gpio36";
			function = "gpio";
		};

		config {
			pins = "gpio36";
			drive-strength = <2>;
			bias-disable;
			input-enable;
		};
	};

	/* GPIO_37 : SPK_AMP_RESET_N */
	sm_gpio_37: sm_gpio_37 {
		mux {
			pins = "gpio37";
			function = "gpio";
		};

		config {
			pins = "gpio37";
			drive-strength = <2>;
			bias-disable;
			output-low;
		};
	};

	/* GPIO_38 : FP_INT_N */
	sm_gpio_38: sm_gpio_38 {
		mux {
			pins = "gpio38";
			function = "gpio";
		};

		config {
			pins = "gpio38";
			drive-strength = <2>;
			bias-disable;
			output-low;
		};
	};

	sm_gpio_38_input_no_pull: sm_gpio_38_input_no_pull {
		mux {
			pins = "gpio38";
			function = "gpio";
		};

		config {
			pins = "gpio38";
			drive-strength = <2>;
			bias-disable;
			input-enable;
		};
	};

	/* GPIO_39 : FP_RESET_N */
	sm_gpio_39: sm_gpio_39 {
		mux {
			pins = "gpio39";
			function = "gpio";
		};

		config {
			pins = "gpio39";
			drive-strength = <2>;
			bias-disable;
			output-low;
		};
	};

	/* GPIO_40 : NC */
	sm_gpio_40: sm_gpio_40 {
		mux {
			pins = "gpio40";
			function = "gpio";
		};

		config {
			pins = "gpio40";
			drive-strength = <2>;
			bias-pull-down;
			input-enable;
		};
	};

	/* GPIO_41 : NC */
	sm_gpio_41: sm_gpio_41 {
		mux {
			pins = "gpio41";
			function = "gpio";
		};

		config {
			pins = "gpio41";
			drive-strength = <2>;
			bias-pull-down;
			input-enable;
		};
	};

	/* GPIO_42 : DEBUG_GPIO0 */
	sm_gpio_42: sm_gpio_42 {
		mux {
			pins = "gpio42";
			function = "gpio";
		};

		config {
			pins = "gpio42";
			drive-strength = <2>;
			bias-pull-down;
			input-enable;
		};
	};

	/* GPIO_43 : FORCE_USB_BOOT */
	sm_gpio_43: sm_gpio_43 {
		mux {
			pins = "gpio43";
			function = "gpio";
		};

		config {
			pins = "gpio43";
			drive-strength = <2>;
			bias-pull-down;
			input-enable;
		};
	};

	/* GPIO_44 : FP_SPI_MISO */
	/* Don't set here */

	/* GPIO_45 : FP_SPI_MOSI */
	/* Don't set here */

	/* GPIO_46 : FP_SPI_CLK */
	/* Don't set here */

	/* GPIO_47 : FP_SPI_CS_N */
	/* Don't set here */

	/* GPIO_48 : SPK_AMP_I2C_SDA */
	sm_gpio_48: sm_gpio_48 {
		mux {
			pins = "gpio48";
			function = "qup11";
		};

		config {
			pins = "gpio48";
			drive-strength = <2>;
			bias-disable;
		};
	};

	/* GPIO_48 : SPK_AMP_I2C_SDA (Suspend) */
	sm_gpio_48_suspend: sm_gpio_48_suspend {
		mux {
			pins = "gpio48";
			function = "gpio";
		};

		config {
			pins = "gpio48";
			drive-strength = <2>;
			bias-disable;
			input-enable;
		};
	};

	/* GPIO_49 : SPK_AMP_I2C_SCL */
	sm_gpio_49: sm_gpio_49 {
		mux {
			pins = "gpio49";
			function = "qup11";
		};

		config {
			pins = "gpio49";
			drive-strength = <2>;
			bias-disable;
		};
	};

	/* GPIO_49 : SPK_AMP_I2C_SCL (Suspend) */
	sm_gpio_49_suspend: sm_gpio_49_suspend {
		mux {
			pins = "gpio49";
			function = "gpio";
		};

		config {
			pins = "gpio49";
			drive-strength = <2>;
			bias-disable;
			input-enable;
		};
	};

	/* GPIO_50 : NC */
	sm_gpio_50: sm_gpio_50 {
		mux {
			pins = "gpio50";
			function = "gpio";
		};

		config {
			pins = "gpio50";
			drive-strength = <2>;
			bias-pull-down;
			input-enable;
		};
	};

	/* GPIO_51 : HAP_INT_N */
	sm_gpio_51: sm_gpio_51 {
		mux {
			pins = "gpio51";
			function = "gpio";
		};

		config {
			pins = "gpio51";
			drive-strength = <2>;
			bias-disable;
			input-enable;
		};
	};

	/* GPIO_52 : CAMSENSOR_I2C_SDA */
	sm_gpio_52: sm_gpio_52 {
		mux {
			pins = "gpio52";
			function = "qup12";
		};

		config {
			pins = "gpio52";
			drive-strength = <2>;
			bias-disable;
		};
	};

	/* GPIO_52 : CAMSENSOR_I2C_SDA (Suspend) */
	sm_gpio_52_suspend: sm_gpio_52_suspend {
		mux {
			pins = "gpio52";
			function = "gpio";
		};

		config {
			pins = "gpio52";
			drive-strength = <2>;
			bias-pull-down;
			input-enable;
		};
	};

	/* GPIO_53 : CAMSENSOR_I2C_SCL */
	sm_gpio_53: sm_gpio_53 {
		mux {
			pins = "gpio53";
			function = "qup12";
		};

		config {
			pins = "gpio53";
			drive-strength = <2>;
			bias-disable;
		};
	};

	/* GPIO_53 : CAMSENSOR_I2C_SCL (Suspend) */
	sm_gpio_53_suspend: sm_gpio_53_suspend {
		mux {
			pins = "gpio53";
			function = "gpio";
		};

		config {
			pins = "gpio53";
			drive-strength = <2>;
			bias-pull-down;
			input-enable;
		};
	};

	/* GPIO_54 : SBU_SW_OE */
	sm_gpio_54: sm_gpio_54 {
		mux {
			pins = "gpio54";
			function = "gpio";
		};

		config {
			pins = "gpio54";
			drive-strength = <2>;
			bias-disable;
			output-low;
		};
	};

	/* GPIO_55 : SBU_SW_SEL */
	sm_gpio_55: sm_gpio_55 {
		mux {
			pins = "gpio55";
			function = "gpio";
		};

		config {
			pins = "gpio55";
			drive-strength = <2>;
			bias-disable;
			output-low;
		};
	};

	/* GPIO_56 : NFC_ESE_SPI_MISO */
	sm_gpio_56: sm_gpio_56 {
		mux {
			pins = "gpio56";
			function = "qup14";
		};

		config {
			pins = "gpio56";
			drive-strength = <2>;
			bias-pull-up;
			input-enable;
		};
	};

	/* GPIO_56 : NFC_ESE_SPI_MISO (Suspend) */
	sm_gpio_56_suspend: sm_gpio_56_suspend {
		mux {
			pins = "gpio56";
			function = "qup14";
		};

		config {
			pins = "gpio56";
			drive-strength = <2>;
			bias-pull-up;
			input-enable;
		};
	};

	/* GPIO_57 : NFC_ESE_SPI_MOSI */
	sm_gpio_57: sm_gpio_57 {
		mux {
			pins = "gpio57";
			function = "qup14";
		};

		config {
			pins = "gpio57";
			drive-strength = <6>;
			bias-disable;
			output-high;
		};
	};

	/* GPIO_57 : NFC_ESE_SPI_MOSI (Suspend)*/
	sm_gpio_57_suspend: sm_gpio_57_suspend {
		mux {
			pins = "gpio57";
			function = "qup14";
		};

		config {
			pins = "gpio57";
			drive-strength = <6>;
			bias-disable;
			output-high;
		};
	};

	/* GPIO_58 : NFC_ESE_SPI_CLK */
	sm_gpio_58: sm_gpio_58 {
		mux {
			pins = "gpio58";
			function = "qup14";
		};

		config {
			pins = "gpio58";
			drive-strength = <6>;
			bias-disable;
			output-high;
		};
	};

	/* GPIO_58 : NFC_ESE_SPI_CLK (Suspend) */
	sm_gpio_58_suspend: sm_gpio_58_suspend {
		mux {
			pins = "gpio58";
			function = "qup14";
		};

		config {
			pins = "gpio58";
			drive-strength = <6>;
			bias-disable;
			output-high;
		};
	};

	/* GPIO_59 : NFC_ESE_SPI_CS */
	sm_gpio_59: sm_gpio_59 {
		mux {
			pins = "gpio59";
			function = "qup14";
		};

		config {
			pins = "gpio59";
			drive-strength = <2>;
			bias-disable;
			output-high;
		};
	};

	/* GPIO_59 : NFC_ESE_SPI_CS (Suspend)*/
	sm_gpio_59_suspend: sm_gpio_59_suspend {
		mux {
			pins = "gpio59";
			function = "qup14";
		};

		config {
			pins = "gpio59";
			drive-strength = <2>;
			bias-disable;
			output-high;
		};
	};

	/* GPIO_60 : NFC_I2C_SDA */
	sm_gpio_60: sm_gpio_60 {
		mux {
			pins = "gpio60";
			function = "qup15";
		};

		config {
			pins = "gpio60";
			drive-strength = <2>;
			bias-disable;
		};
	};

	/* GPIO_60 : NFC_I2C_SDA (Suspend) */
	sm_gpio_60_suspend: sm_gpio_60_suspend {
		mux {
			pins = "gpio60";
			function = "gpio";
		};

		config {
			pins = "gpio60";
			drive-strength = <2>;
			bias-disable;
			input-enable;
		};
	};

	/* GPIO_61 : NFC_I2C_SCL */
	sm_gpio_61: sm_gpio_61 {
		mux {
			pins = "gpio61";
			function = "qup15";
		};

		config {
			pins = "gpio61";
			drive-strength = <2>;
			bias-disable;
		};
	};

	/* GPIO_61 : NFC_I2C_SCL (Suspend) */
	sm_gpio_61_suspend: sm_gpio_61_suspend {
		mux {
			pins = "gpio61";
			function = "gpio";
		};

		config {
			pins = "gpio61";
			drive-strength = <2>;
			bias-disable;
			input-enable;
		};
	};

	/* GPIO_62 : NFC_EN */
	sm_gpio_62: sm_gpio_62 {
		mux {
			pins = "gpio62";
			function = "gpio";
		};

		config {
			pins = "gpio62";
			drive-strength = <2>;
			bias-disable;
			output-high;
		};
	};

	/* GPIO_63 : NFC_CLK_REQ */
	sm_gpio_63: sm_gpio_63 {
		mux {
			pins = "gpio63";
			function = "gpio";
		};

		config {
			pins = "gpio63";
			drive-strength = <2>;
			bias-pull-down;
			input-enable;
		};
	};

	/* GPIO_64 : HST_WLAN_EN */
	/* Follow QC */

	/* GPIO_65 : HST_BT_EN */
	/* Follow QC */

	/* GPIO_66 : HW_ID_0 */
	sm_gpio_66: sm_gpio_66 {
		mux {
			pins = "gpio66";
			function = "gpio";
		};

		config {
			pins = "gpio66";
			drive-strength = <2>;
			bias-pull-up;
			input-enable;
		};
	};

	/* GPIO_67 : HW_ID_1 */
	sm_gpio_67: sm_gpio_67 {
		mux {
			pins = "gpio67";
			function = "gpio";
		};

		config {
			pins = "gpio67";
			drive-strength = <2>;
			bias-pull-up;
			input-enable;
		};
	};

	/* GPIO_68 : HST_BT_UART_CTS */
	/* Follow QC */

	/* GPIO_69 : HST_BT_UART_RFR */
	/* Follow QC */

	/* GPIO_70 : HST_BT_UART_TX */
	/* Follow QC */

	/* GPIO_71 : HST_BT_UART_RX */
	/* Follow QC */

	/* GPIO_72 : HAP_I2C_SDA */
	sm_gpio_72: sm_gpio_72 {
		mux {
			pins = "gpio72";
			function = "qup17";
		};

		config {
			pins = "gpio72";
			drive-strength = <2>;
			bias-disable;
		};
	};

	/* GPIO_72 : HAP_I2C_SDA (Suspend) */
	sm_gpio_72_suspend: sm_gpio_72_suspend {
		mux {
			pins = "gpio72";
			function = "gpio";
		};

		config {
			pins = "gpio72";
			drive-strength = <2>;
			bias-disable;
			input-enable;
		};
	};

	/* GPIO_73 : HAP_I2C_SCL */
	sm_gpio_73: sm_gpio_73 {
		mux {
			pins = "gpio73";
			function = "qup17";
		};

		config {
			pins = "gpio73";
			drive-strength = <2>;
			bias-disable;
		};
	};

	/* GPIO_73 : HAP_I2C_SCL (Suspend) */
	sm_gpio_73_suspend: sm_gpio_73_suspend {
		mux {
			pins = "gpio73";
			function = "gpio";
		};

		config {
			pins = "gpio73";
			drive-strength = <2>;
			bias-disable;
			input-enable;
		};
	};

	/* GPIO_74 : RF_LCD_ID_EN */
	sm_gpio_74: sm_gpio_74 {
		mux {
			pins = "gpio74";
			function = "gpio";
		};

		config {
			pins = "gpio74";
			drive-strength = <2>;
			bias-disable;
			output-low;
		};
	};

	/* GPIO_75 : RF_ID_EXTENSION */
	sm_gpio_75: sm_gpio_75 {
		mux {
			pins = "gpio75";
			function = "gpio";
		};

		config {
			pins = "gpio75";
			drive-strength = <2>;
			bias-pull-down;
			input-enable;
		};
	};

	/* GPIO_76 : NC */
	sm_gpio_76: sm_gpio_76 {
		mux {
			pins = "gpio76";
			function = "gpio";
		};

		config {
			pins = "gpio76";
			drive-strength = <2>;
			bias-pull-down;
			input-enable;
		};
	};

	/* GPIO_77 : NC */
	sm_gpio_77: sm_gpio_77 {
		mux {
			pins = "gpio77";
			function = "gpio";
		};

		config {
			pins = "gpio77";
			drive-strength = <2>;
			bias-pull-down;
			input-enable;
		};
	};

	/* GPIO_78 : NC */
	sm_gpio_78: sm_gpio_78 {
		mux {
			pins = "gpio78";
			function = "gpio";
		};

		config {
			pins = "gpio78";
			drive-strength = <2>;
			bias-pull-down;
			input-enable;
		};
	};

	/* GPIO_79 : NC */
	sm_gpio_79: sm_gpio_79 {
		mux {
			pins = "gpio79";
			function = "gpio";
		};

		config {
			pins = "gpio79";
			drive-strength = <2>;
			bias-pull-down;
			input-enable;
		};
	};

	/* GPIO_80 : HALL_INT_N */
	sm_gpio_80: sm_gpio_80 {
		mux {
			pins = "gpio80";
			function = "gpio";
		};

		config {
			pins = "gpio80";
			drive-strength = <2>;
			bias-pull-up;
			input-enable;
		};
	};

	/* GPIO_81 : USB_CC_DIR */
	/* Follow QC */

	/* GPIO_82 : DISP_VSYNC */
	sm_gpio_82: sm_gpio_82 {
		mux {
			pins = "gpio82";
			function = "mdp_vsync";
		};

		config {
			pins = "gpio82";
			drive-strength = <2>;
			bias-disable;
		};
	};

	/* GPIO_83 : NC */
	sm_gpio_83: sm_gpio_83 {
		mux {
			pins = "gpio83";
			function = "gpio";
		};

		config {
			pins = "gpio83";
			drive-strength = <2>;
			bias-pull-down;
			input-enable;
		};
	};

	/* GPIO_84 : NC */
	sm_gpio_84: sm_gpio_84 {
		mux {
			pins = "gpio84";
			function = "gpio";
		};

		config {
			pins = "gpio84";
			drive-strength = <2>;
			bias-pull-down;
			input-enable;
		};
	};

	/* GPIO_85 : CAM_SOF_TELE */
	sm_gpio_85: sm_gpio_85 {
		mux {
			pins = "gpio85";
			function = "gpio";
		};

		config {
			pins = "gpio85";
			drive-strength = <2>;
			bias-pull-down;
			input-enable;
		};
	};

	/* GPIO_86 : NFC_DWL_REQ */
	sm_gpio_86: sm_gpio_86 {
		mux {
			pins = "gpio86";
			function = "gpio";
		};

		config {
			pins = "gpio86";
			drive-strength = <2>;
			bias-disable;
			output-low;
		};
	};

	/* GPIO_87 : NFC_IRQ */
	sm_gpio_87: sm_gpio_87 {
		mux {
			pins = "gpio87";
			function = "gpio";
		};

		config {
			pins = "gpio87";
			drive-strength = <2>;
			bias-pull-down;
			input-enable;
		};
	};

	/* GPIO_88 : WCD_RST_N */
	/* Follow QC */

	/* GPIO_89 : ALS_PROX_INT_N */
	sm_gpio_89: sm_gpio_89 {
		mux {
			pins = "gpio89";
			function = "gpio";
		};

		config {
			pins = "gpio89";
			drive-strength = <2>;
			bias-disable;
			input-enable;
		};
	};

	/* GPIO_90 : NC */
	sm_gpio_90: sm_gpio_90 {
		mux {
			pins = "gpio90";
			function = "gpio";
		};

		config {
			pins = "gpio90";
			drive-strength = <2>;
			bias-pull-down;
			input-enable;
		};
	};

	/* GPIO_91 : NC */
	sm_gpio_91: sm_gpio_91 {
		mux {
			pins = "gpio91";
			function = "gpio";
		};

		config {
			pins = "gpio91";
			drive-strength = <2>;
			bias-pull-down;
			input-enable;
		};
	};

	/* GPIO_92 : TRAY_DET */
	sm_gpio_92: sm_gpio_92 {
		mux {
			pins = "gpio92";
			function = "gpio";
		};

		config {
			pins = "gpio92";
			drive-strength = <2>;
			bias-disable;
			input-enable;
		};
	};

	/* GPIO_93 : UDON_SWITCH_SEL */
	/* Don't set here */

	/* GPIO_94 : PCIE0_RESET_N */
	/* Follow QC */

	/* GPIO_95 : PCIE0_CLK_REQ_N */
	/* Follow QC */

	/* GPIO_96 : PCIE0_WAKE_N */
	/* Follow QC */

	/* GPIO_97 : CAM_SOF */
	sm_gpio_97: sm_gpio_97 {
		mux {
			pins = "gpio97";
			function = "gpio";
		};

		config {
			pins = "gpio97";
			drive-strength = <2>;
			bias-pull-down;
			input-enable;
		};
	};

	/* GPIO_98 : RF_ID_EXTENSION_2 */
	sm_gpio_98: sm_gpio_98 {
		mux {
			pins = "gpio98";
			function = "gpio";
		};

		config {
			pins = "gpio98";
			drive-strength = <2>;
			bias-pull-down;
			input-enable;
		};
	};

	/* GPIO_99 : RGBC_IR_INT */
	sm_gpio_99: sm_gpio_99 {
		mux {
			pins = "gpio99";
			function = "gpio";
		};

		config {
			pins = "gpio99";
			drive-strength = <2>;
			bias-pull-up;
			input-enable;
		};
	};

	sm_gpio_99_suspend: sm_gpio_99_suspend {
		mux {
			pins = "gpio99";
			function = "gpio";
		};

		config {
			pins = "gpio99";
			drive-strength = <2>;
			bias-pull-down;
			input-enable;
		};
	};

	/* GPIO_100 : CAM_MCLK0 */
	sm_gpio_100: sm_gpio_100 {
		mux {
			pins = "gpio100";
			function = "cam_mclk";
		};

		config {
			pins = "gpio100";
			drive-strength = <2>;
			bias-disable;
		};
	};

	/* GPIO_101 : CAM_MCLK1 */
	sm_gpio_101: sm_gpio_101 {
		mux {
			pins = "gpio101";
			function = "cam_mclk";
		};

		config {
			pins = "gpio101";
			drive-strength = <2>;
			bias-disable;
		};
	};

	/* GPIO_102 : CAM_MCLK2 */
	sm_gpio_102: sm_gpio_102 {
		mux {
			pins = "gpio102";
			function = "cam_mclk";
		};

		config {
			pins = "gpio102";
			drive-strength = <2>;
			bias-disable;
		};
	};

	/* GPIO_103 : CAM_MCLK3 */
	sm_gpio_103: sm_gpio_103 {
		mux {
			pins = "gpio103";
			function = "cam_mclk";
		};

		config {
			pins = "gpio103";
			drive-strength = <2>;
			bias-disable;
		};
	};

	/* GPIO_104 : NC */
	sm_gpio_104: sm_gpio_104 {
		mux {
			pins = "gpio104";
			function = "gpio";
		};

		config {
			pins = "gpio104";
			drive-strength = <2>;
			bias-pull-down;
			input-enable;
		};
	};

	/* GPIO_105 : NC */
	sm_gpio_105: sm_gpio_105 {
		mux {
			pins = "gpio105";
			function = "gpio";
		};

		config {
			pins = "gpio105";
			drive-strength = <2>;
			bias-pull-down;
			input-enable;
		};
	};

	/* GPIO_106 : CAM2_RESET_N */
	sm_gpio_106: sm_gpio_106 {
		mux {
			pins = "gpio106";
			function = "gpio";
		};

		config {
			pins = "gpio106";
			drive-strength = <2>;
			bias-disable;
			output-low;
		};
	};

	/* GPIO_107 : CCI_I2C0_SDA */
	sm_gpio_107: sm_gpio_107 {
		mux {
			pins = "gpio107";
			function = "cci_i2c";
		};

		config {
			pins = "gpio107";
			drive-strength = <2>;
			bias-disable;
		};
	};

	/* GPIO_108 : CCI_I2C0_SCL */
	sm_gpio_108: sm_gpio_108 {
		mux {
			pins = "gpio108";
			function = "cci_i2c";
		};

		config {
			pins = "gpio108";
			drive-strength = <2>;
			bias-disable;
		};
	};

	/* GPIO_109 : CCI_I2C1_SDA */
	sm_gpio_109: sm_gpio_109 {
		mux {
			pins = "gpio109";
			function = "cci_i2c";
		};

		config {
			pins = "gpio109";
			drive-strength = <2>;
			bias-disable;
		};
	};

	/* GPIO_110 : CCI_I2C1_SCL */
	sm_gpio_110: sm_gpio_110 {
		mux {
			pins = "gpio110";
			function = "cci_i2c";
		};

		config {
			pins = "gpio110";
			drive-strength = <2>;
			bias-disable;
		};
	};

	/* GPIO_111 : CCI_I2C2_SDA */
	sm_gpio_111: sm_gpio_111 {
		mux {
			pins = "gpio111";
			function = "cci_i2c";
		};

		config {
			pins = "gpio111";
			drive-strength = <2>;
			bias-disable;
		};
	};

	/* GPIO_112 : CCI_I2C2_SCL */
	sm_gpio_112: sm_gpio_112 {
		mux {
			pins = "gpio112";
			function = "cci_i2c";
		};

		config {
			pins = "gpio112";
			drive-strength = <2>;
			bias-disable;
		};
	};

	/* GPIO_113 : CCI_I2C3_SDA */
	sm_gpio_113: sm_gpio_113 {
		mux {
			pins = "gpio113";
			function = "cci_i2c";
		};

		config {
			pins = "gpio113";
			drive-strength = <2>;
			bias-disable;
		};
	};

	/* GPIO_114 : CCI_I2C3_SCL */
	sm_gpio_114: sm_gpio_114 {
		mux {
			pins = "gpio114";
			function = "cci_i2c";
		};

		config {
			pins = "gpio114";
			drive-strength = <2>;
			bias-disable;
		};
	};

	/* GPIO_115 : NC */
	sm_gpio_115: sm_gpio_115 {
		mux {
			pins = "gpio115";
			function = "gpio";
		};

		config {
			pins = "gpio115";
			drive-strength = <2>;
			bias-pull-down;
			input-enable;
		};
	};

	/* GPIO_116 : PM8008_1_IRQ */
	sm_gpio_116: sm_gpio_116 {
		mux {
			pins = "gpio116";
			function = "gpio";
		};

		config {
			pins = "gpio116";
			drive-strength = <2>;
			bias-pull-up;
			input-enable;
		};
	};

	/* GPIO_117 : CAM3_RESET_N */
	sm_gpio_117: sm_gpio_117 {
		mux {
			pins = "gpio117";
			function = "gpio";
		};

		config {
			pins = "gpio117";
			drive-strength = <2>;
			bias-disable;
			output-low;
		};
	};

	/* GPIO_118 : IMU1_INT */
	/* Follow QC */

	/* GPIO_119 : EXT_VD0_XVS */
	sm_gpio_119: sm_gpio_119 {
		mux {
			pins = "gpio119";
			function = "cci_timer4";
		};

		config {
			pins = "gpio119";
			drive-strength = <2>;
			bias-disable;
		};
	};

	/* GPIO_120 : NC */
	sm_gpio_120: sm_gpio_120 {
		mux {
			pins = "gpio120";
			function = "gpio";
		};

		config {
			pins = "gpio120";
			drive-strength = <2>;
			bias-pull-down;
			input-enable;
		};
	};

	/* GPIO_121 : NC */
	sm_gpio_121: sm_gpio_121 {
		mux {
			pins = "gpio121";
			function = "gpio";
		};

		config {
			pins = "gpio121";
			drive-strength = <2>;
			bias-pull-down;
			input-enable;
		};
	};

	/* GPIO_122 : NC */
	sm_gpio_122: sm_gpio_122 {
		mux {
			pins = "gpio122";
			function = "gpio";
		};

		config {
			pins = "gpio122";
			drive-strength = <2>;
			bias-pull-down;
			input-enable;
		};
	};

	/* GPIO_123 : NC */
	sm_gpio_123: sm_gpio_123 {
		mux {
			pins = "gpio123";
			function = "gpio";
		};

		config {
			pins = "gpio123";
			drive-strength = <2>;
			bias-pull-down;
			input-enable;
		};
	};

	/* GPIO_124 : NC */
	sm_gpio_124: sm_gpio_124 {
		mux {
			pins = "gpio124";
			function = "gpio";
		};

		config {
			pins = "gpio124";
			drive-strength = <2>;
			bias-pull-down;
			input-enable;
		};
	};

	/* GPIO_125 : HAP_I2S_CLK */
	sm_gpio_125: sm_gpio_125 {
		mux {
			pins = "gpio125";
			function = "mi2s0_sck";
		};

		config {
			pins = "gpio125";
			drive-strength = <2>;
			bias-disable;
		};
	};

	/* GPIO_126 : HAP_I2S_DOUT */
	sm_gpio_126: sm_gpio_126 {
		mux {
			pins = "gpio126";
			function = "mi2s0_data0";
		};

		config {
			pins = "gpio126";
			drive-strength = <2>;
			bias-disable;
		};
	};

	/* GPIO_127 : HAP_TRG1 */
	sm_gpio_127: sm_gpio_127 {
		mux {
			pins = "gpio127";
			function = "gpio";
		};

		config {
			pins = "gpio127";
			drive-strength = <2>;
			bias-disable;
			output-low;
		};
	};

	/* GPIO_128 : HAP_I2S_SYNC */
	sm_gpio_128: sm_gpio_128 {
		mux {
			pins = "gpio128";
			function = "mi2s0_ws";
		};

		config {
			pins = "gpio128";
			drive-strength = <2>;
			bias-disable;
		};
	};

	/* GPIO_129 : HST_BT_WLAN_SLIMBUS_CLK */
	/* Follow QC */

	/* GPIO_130 : HST_BT_WLAN_SLIMBUS_DAT0 */
	/* Follow QC */

	/* GPIO_131 : NC */
	sm_gpio_131: sm_gpio_131 {
		mux {
			pins = "gpio131";
			function = "gpio";
		};

		config {
			pins = "gpio131";
			drive-strength = <2>;
			bias-pull-down;
			input-enable;
		};
	};

	/* GPIO_132 : UIM2_DETECT_EN */
	sm_gpio_132: sm_gpio_132 {
		mux {
			pins = "gpio132";
			function = "gpio";
		};

		config {
			pins = "gpio132";
			drive-strength = <2>;
			bias-disable;
			output-low;
		};
	};

	/* GPIO_133 : UIM2_DATA */
	/* Follow QC */

	/* GPIO_134 : UIM2_CLK */
	/* Follow QC */

	/* GPIO_135 : UIM2_RESET */
	/* Follow QC */

	/* GPIO_136 : UIM2_PRESENT */
	/* Follow QC */

	/* GPIO_137 : UIM1_DATA */
	/* Follow QC */

	/* GPIO_138 : UIM1_CLK */
	/* Follow QC */

	/* GPIO_139 : UIM1_RESET */
	/* Follow QC */

	/* GPIO_140 : TRAY_DET */
	/* Follow QC */

	/* GPIO_141 : SM_RFFE0_CLK */
	/* Follow QC */

	/* GPIO_142 : SM_RFFE0_DATA */
	/* Follow QC */

	/* GPIO_143 : SM_RFFE1_CLK */
	/* Follow QC */

	/* GPIO_144 : SM_RFFE1_DATA */
	/* Follow QC */

	/* GPIO_145 : SM_MSS_GRFC4 */
	/* Follow QC */

	/* GPIO_146 : SM_MSS_GRFC5 */
	/* Follow QC */

	/* GPIO_147 : SM_MSS_GRFC6 */
	/* Follow QC */

	/* GPIO_148 : SM_MSS_GRFC7 */
	/* Follow QC */

	/* GPIO_149 : SM_RFFE4_CLK */
	/* Follow QC */

	/* GPIO_150 : SM_RFFE4_DATA */
	/* Follow QC */

	/* GPIO_151 : WLAN_COEX_UART1_RX */
	/* Follow QC */

	/* GPIO_152 : WLAN_COEX_UART1_TX */
	/* Follow QC */

	/* GPIO_153 : HST_SW_CTRL */
	/* Follow QC */

	/* GPIO_154 : DISP_VDDR_EN */
	sm_gpio_154: sm_gpio_154 {
		mux {
			pins = "gpio154";
			function = "gpio";
		};

		config {
			pins = "gpio154";
			drive-strength = <2>;
			bias-disable;
		};
	};

	/* GPIO_155 : NC */
	sm_gpio_155: sm_gpio_155 {
		mux {
			pins = "gpio155";
			function = "gpio";
		};

		config {
			pins = "gpio155";
			drive-strength = <2>;
			bias-pull-down;
			input-enable;
		};
	};

	/* GPIO_156 : NC */
	sm_gpio_156: sm_gpio_156 {
		mux {
			pins = "gpio156";
			function = "gpio";
		};

		config {
			pins = "gpio156";
			drive-strength = <2>;
			bias-pull-down;
			input-enable;
		};
	};

	/* GPIO_157 : PA_INDICATOR_OR */
	sm_gpio_157: sm_gpio_157 {
		mux {
			pins = "gpio157";
			function = "pa_indicator";
		};

		config {
			pins = "gpio157";
			drive-strength = <2>;
			bias-disable;
		};
	};

	/* GPIO_158 : NC */
	sm_gpio_158: sm_gpio_158 {
		mux {
			pins = "gpio158";
			function = "gpio";
		};

		config {
			pins = "gpio158";
			drive-strength = <2>;
			bias-pull-down;
			input-enable;
		};
	};

	/* GPIO_159 : QLINK0_REQ */
	/* Follow QC */

	/* GPIO_160 : QLINK0_EN */
	/* Follow QC */

	/* GPIO_161 : QLINK0_WMSS_RESET_N */
	/* Follow QC */

	/* GPIO_162 : NC */
	sm_gpio_162: sm_gpio_162 {
		mux {
			pins = "gpio162";
			function = "gpio";
		};

		config {
			pins = "gpio162";
			drive-strength = <2>;
			bias-pull-down;
			input-enable;
		};
	};

	/* GPIO_163 : NC */
	sm_gpio_163: sm_gpio_163 {
		mux {
			pins = "gpio163";
			function = "gpio";
		};

		config {
			pins = "gpio163";
			drive-strength = <2>;
			bias-pull-down;
			input-enable;
		};
	};

	/* GPIO_164 : NC */
	sm_gpio_164: sm_gpio_164 {
		mux {
			pins = "gpio164";
			function = "gpio";
		};

		config {
			pins = "gpio164";
			drive-strength = <2>;
			bias-pull-down;
			input-enable;
		};
	};

	/* GPIO_165 : PM8008_2_IRQ */
	sm_gpio_165: sm_gpio_165 {
		mux {
			pins = "gpio165";
			function = "gpio";
		};

		config {
			pins = "gpio165";
			drive-strength = <2>;
			bias-pull-up;
			input-enable;
		};
	};

	/* GPIO_166 : TELEC_PWR_EN */
	sm_gpio_166: sm_gpio_166 {
		mux {
			pins = "gpio166";
			function = "gpio";
		};

		config {
			pins = "gpio166";
			drive-strength = <2>;
			bias-disable;
			output-low;
		};
	};

	/* GPIO_167 : PM8008_2_RESET_N */
	sm_gpio_167: sm_gpio_167 {
		mux {
			pins = "gpio167";
			function = "gpio";
		};

		config {
			pins = "gpio167";
			drive-strength = <2>;
			bias-disable;
			output-high;
		};
	};

	/* GPIO_168 : WCD_SWR_TX_CLK */
	/* Follow QC */

	/* GPIO_169 : WCD_SWR_TX_DATA0 */
	/* Follow QC */

	/* GPIO_170 : WCD_SWR_TX_DATA1 */
	/* Follow QC */

	/* GPIO_171 : WCD_SWR_RX_CLK */
	/* Follow QC */

	/* GPIO_172 : WCD_SWR_RX_DATA0 */
	/* Follow QC */

	/* GPIO_173 : WCD_SWR_RX_DATA1 */
	/* Follow QC */

	/* GPIO_174 : SM_DMIC1_CLK */
	/* Don't set here */

	/* GPIO_175 : SM_DMIC1_DATA */
	/* Don't set here */

	/* GPIO_176 : SM_DMIC2_CLK */
	/* Don't set here */

	/* GPIO_177 : SM_DMIC2_DATA */
	/* Don't set here */

	/* GPIO_178 : SPK_AMP_I2S_CLK */
	/* Don't set here */

	/* GPIO_179 : SPK_AMP_I2S_WS */
	/* Don't set here */

	/* GPIO_180 : SPK_AMP_I2S_ASP_DIN */
	/* Don't set here */

	/* GPIO_181 : SPK_AMP_I2S_ASP_DOUT */
	/* Don't set here */

	/* GPIO_182 : WCD_SWR_TX_DATA2 */
	/* Follow QC */

	/* GPIO_183 : NC */
	sm_gpio_183: sm_gpio_183 {
		mux {
			pins = "gpio183";
			function = "gpio";
		};

		config {
			pins = "gpio183";
			drive-strength = <2>;
			bias-pull-down;
			input-enable;
		};
	};

	/* GPIO_184 : NC */
	sm_gpio_184: sm_gpio_184 {
		mux {
			pins = "gpio184";
			function = "gpio";
		};

		config {
			pins = "gpio184";
			drive-strength = <2>;
			bias-pull-down;
			input-enable;
		};
	};

	/* GPIO_185 : NC */
	sm_gpio_185: sm_gpio_185 {
		mux {
			pins = "gpio185";
			function = "gpio";
		};

		config {
			pins = "gpio185";
			drive-strength = <2>;
			bias-pull-down;
			input-enable;
		};
	};

	/* GPIO_186 : NC */
	sm_gpio_186: sm_gpio_186 {
		mux {
			pins = "gpio186";
			function = "gpio";
		};

		config {
			pins = "gpio186";
			drive-strength = <2>;
			bias-pull-down;
			input-enable;
		};
	};

	/* GPIO_187 : IMU_SPI_MISO */
	/* Don't set here */

	/* GPIO_188 : IMU_SPI_MOSI */
	/* Don't set here */

	/* GPIO_189 : IMU_SPI_CLK */
	/* Don't set here */

	/* GPIO_190 : IMU_SPI_CS_N */
	/* Don't set here */

	/* GPIO_191 : MAG_I2C_SDA */
	/* Don't set here */

	/* GPIO_192 : MAG_I2C_SCL */
	/* Don't set here */

	/* GPIO_193 : SENSOR_I2C_SDA */
	/* Don't set here */

	/* GPIO_194 : SENSOR_I2C_SCL */
	/* Don't set here */

	/* GPIO_195 : NC */
	sm_gpio_195: sm_gpio_195 {
		mux {
			pins = "gpio195";
			function = "gpio";
		};

		config {
			pins = "gpio195";
			drive-strength = <2>;
			bias-pull-down;
			input-enable;
		};
	};

	/* GPIO_196 : NC */
	sm_gpio_196: sm_gpio_196 {
		mux {
			pins = "gpio196";
			function = "gpio";
		};

		config {
			pins = "gpio196";
			drive-strength = <2>;
			bias-pull-down;
			input-enable;
		};
	};

	/* GPIO_197 : NC */
	sm_gpio_197: sm_gpio_197 {
		mux {
			pins = "gpio197";
			function = "gpio";
		};

		config {
			pins = "gpio197";
			drive-strength = <2>;
			bias-pull-down;
			input-enable;
		};
	};

	/* GPIO_198 : NC */
	sm_gpio_198: sm_gpio_198 {
		mux {
			pins = "gpio198";
			function = "gpio";
		};

		config {
			pins = "gpio198";
			drive-strength = <2>;
			bias-pull-down;
			input-enable;
		};
	};

	/* GPIO_199 : HST_BLE_UART_TX */
	/* Follow QC */

	/* GPIO_200 : HST_BLE_UART_RX */
	/* Follow QC */

	/* GPIO_201 : HST_WLAN_UART_TX */
	/* Follow QC */

	/* GPIO_202 : HST_WLAN_UART_RX */
	/* Follow QC */

};

&pm8350c_rgb {
	red {
		somc,color_variation_max_num = <4>;
		somc,max_current = <
			45 511 511
			46 511 511
			47 511 511
			48 511 511>;
	};
	green {
		somc,color_variation_max_num = <4>;
		somc,max_current = <
			45 511 511
			46 511 511
			47 511 511
			48 511 511>;
	};
	blue {
		somc,color_variation_max_num = <4>;
		somc,max_current = <
			45 511 511
			46 511 511
			47 511 511
			48 511 511>;
	};
};

&spmi_bus {
	qcom,pmk8350@0 {
		pon_hlos@1300 {
			qcom,pon_2 {
				linux,code = <KEY_VOLUMEUP>;
			};
		};
	};
};

&soc {
	gpio_keys {
		pinctrl-0 = <&pmk8350_gpio_3
			     &pm8350_gpio_9
			     &pm8350b_gpio_5
			     &pm8350b_gpio_8>;

		vol_up {
			status = "disabled";
		};

		vol_dn {
			label = "volume_down";
			gpios = <&pmk8350_gpios 3 GPIO_ACTIVE_LOW>;
			linux,input-type = <1>;
			linux,code = <KEY_VOLUMEDOWN>;
			gpio-key,wakeup;
			debounce-interval = <15>;
			linux,can-disable;
		};

		g_assist_key: g_assist_key {
			label = "g_assist_key";
			gpios = <&pm8350_gpios 9 GPIO_ACTIVE_LOW>;
			linux,input-type = <1>;
			linux,code = <KEY_G_ASSIST>;
			gpio-key,wakeup;
			debounce-interval = <15>;
			linux,can-disable;
		};

		cam_snapshot {
			label = "cam_snapshot";
			gpios = <&pm8350b_gpios 5 GPIO_ACTIVE_LOW>;
			linux,input-type = <1>;
			linux,code = <766>;
			gpio-key,wakeup;
			debounce-interval = <15>;
			linux,can-disable;
		};

		cam_focus {
			label = "cam_focus";
			gpios = <&pm8350b_gpios 8 GPIO_ACTIVE_LOW>;
			linux,input-type = <1>;
			linux,code = <KEY_CAMERA_FOCUS>;
			gpio-key,wakeup;
			debounce-interval = <15>;
			linux,can-disable;
		};
	};

	qcom,qbt_handler {
		status = "disabled";
	};

};

&sdhc_2 {
	cd-gpios = <&tlmm 92 GPIO_ACTIVE_HIGH>;
};

&pmk8350_vadc {
	/delete-node/ pm8350_msm_therm;
	/delete-node/ pm8350_cam_flash_therm;
	/delete-node/ pm8350_hot_pocket_therm;
	/delete-node/ pm8350_wide_rfc_therm;
	/delete-node/ pm8350_rear_tof_therm;
	/delete-node/ pm8350b_usb_conn_therm;
	/delete-node/ pm8350b_wl_chg_therm;
	/delete-node/ pmk8350_xo_therm;

	sdm_therm {
		reg = <PM8350_ADC7_AMUX_THM1_100K_PU>;
		label = "sdm_therm";
		qcom,ratiometric;
		qcom,hw-settle-time = <200>;
		qcom,pre-scaling = <1 1>;
	};

	flash_therm {
		reg = <PM8350_ADC7_AMUX_THM2_100K_PU>;
		label = "flash_therm";
		qcom,ratiometric;
		qcom,hw-settle-time = <200>;
		qcom,pre-scaling = <1 1>;
	};

	assign2_therm {
		reg = <PM8350_ADC7_AMUX_THM3_100K_PU>;
		label = "assign2_therm";
		qcom,ratiometric;
		qcom,hw-settle-time = <200>;
		qcom,pre-scaling = <1 1>;
	};

	assign3_therm {
		reg = <PM8350_ADC7_AMUX_THM4_100K_PU>;
		label = "assign3_therm";
		qcom,ratiometric;
		qcom,hw-settle-time = <200>;
		qcom,pre-scaling = <1 1>;
	};

	assign1_therm {
		reg = <PM8350_ADC7_AMUX_THM5_100K_PU>;
		label = "assign1_therm";
		qcom,ratiometric;
		qcom,hw-settle-time = <200>;
		qcom,pre-scaling = <1 1>;
	};

	xo_therm {
		reg = <PMK8350_ADC7_AMUX_THM1_100K_PU>;
		label = "xo_therm";
		qcom,ratiometric;
		qcom,hw-settle-time = <200>;
		qcom,pre-scaling = <1 1>;
	};
};

&pmk8350_adc_tm {
	io-channels = <&pmk8350_vadc PM8350_ADC7_AMUX_THM1_100K_PU>,
			<&pmk8350_vadc PM8350_ADC7_AMUX_THM2_100K_PU>,
			<&pmk8350_vadc PM8350_ADC7_AMUX_THM3_100K_PU>,
			<&pmk8350_vadc PM8350_ADC7_AMUX_THM4_100K_PU>,
			<&pmk8350_vadc PM8350_ADC7_AMUX_THM5_100K_PU>,
			<&pmk8350_vadc PMK8350_ADC7_AMUX_THM1_100K_PU>;

	/delete-node/ pm8350_msm_therm;
	/delete-node/ pm8350_cam_flash_therm;
	/delete-node/ pm8350_hot_pocket_therm;
	/delete-node/ pm8350_wide_rfc_therm;
	/delete-node/ pm8350_rear_tof_therm;
	/delete-node/ pm8350b_usb_conn_therm;
	/delete-node/ pm8350b_wl_chg_therm;
	/delete-node/ pmk8350_xo_therm;

	sdm_therm {
		reg = <PM8350_ADC7_AMUX_THM1_100K_PU>;
		qcom,ratiometric;
		qcom,hw-settle-time = <200>;
	};

	flash_therm {
		reg = <PM8350_ADC7_AMUX_THM2_100K_PU>;
		qcom,ratiometric;
		qcom,hw-settle-time = <200>;
	};

	assign2_therm {
		reg = <PM8350_ADC7_AMUX_THM3_100K_PU>;
		qcom,ratiometric;
		qcom,hw-settle-time = <200>;
	};

	assign3_therm {
		reg = <PM8350_ADC7_AMUX_THM4_100K_PU>;
		qcom,ratiometric;
		qcom,hw-settle-time = <200>;
	};

	assign1_therm {
		reg = <PM8350_ADC7_AMUX_THM5_100K_PU>;
		qcom,ratiometric;
		qcom,hw-settle-time = <200>;
	};

	xo_therm {
		reg = <PMK8350_ADC7_AMUX_THM1_100K_PU>;
		qcom,ratiometric;
		qcom,hw-settle-time = <200>;
	};
};

&thermal_zones {
	skin-msm-therm-usr {
		status = "disable";
	};

	camera-therm-usr {
		status = "disable";
	};

	hot-pock-therm-usr {
		status = "disable";
	};

	rear-cam-therm-usr {
		status = "disable";
	};

	tof-therm-usr {
		status = "disable";
	};

	conn-therm-usr {
		status = "disable";
	};

	wlc-therm-usr {
		status = "disable";
	};

	xo-therm-usr {
		status = "disable";
	};

	modem-mmw-pa1-usr {
		status = "disable";
	};

	modem-mmw-pa2-usr {
		status = "disable";
	};

	modem-mmw-pa3-usr {
		status = "disable";
	};

	modem-sdr-mmw-usr {
		status = "disable";
	};

	modem-lte-sub6-pa1 {
		status = "disable";
	};

	modem-lte-sub6-pa2 {
		status = "disable";
	};

	sdm_therm {
		polling-delay-passive = <0>;
		polling-delay = <0>;
		thermal-governor = "user_space";
		thermal-sensors = <&pmk8350_adc_tm PM8350_ADC7_AMUX_THM1_100K_PU>;
		wake-capable-sensor;
		trips {
			active-config0 {
				temperature = <125000>;
				hysteresis = <1000>;
				type = "passive";
			};
		};
	};

	flash_therm {
		polling-delay-passive = <0>;
		polling-delay = <0>;
		thermal-governor = "user_space";
		thermal-sensors = <&pmk8350_adc_tm PM8350_ADC7_AMUX_THM2_100K_PU>;
		wake-capable-sensor;
		trips {
			active-config0 {
				temperature = <125000>;
				hysteresis = <1000>;
				type = "passive";
			};
		};
	};

	assign2_therm {
		polling-delay-passive = <0>;
		polling-delay = <0>;
		thermal-governor = "user_space";
		thermal-sensors = <&pmk8350_adc_tm PM8350_ADC7_AMUX_THM3_100K_PU>;
		wake-capable-sensor;
		trips {
			active-config0 {
				temperature = <125000>;
				hysteresis = <1000>;
				type = "passive";
			};
		};
	};

	assign3_therm {
		polling-delay-passive = <0>;
		polling-delay = <0>;
		thermal-governor = "user_space";
		thermal-sensors = <&pmk8350_adc_tm PM8350_ADC7_AMUX_THM4_100K_PU>;
		wake-capable-sensor;
		trips {
			active-config0 {
				temperature = <125000>;
				hysteresis = <1000>;
				type = "passive";
			};
		};
	};

	assign1_therm {
		polling-delay-passive = <0>;
		polling-delay = <0>;
		thermal-governor = "user_space";
		thermal-sensors = <&pmk8350_adc_tm PM8350_ADC7_AMUX_THM5_100K_PU>;
		wake-capable-sensor;
		trips {
			active-config0 {
				temperature = <125000>;
				hysteresis = <1000>;
				type = "passive";
			};
		};
	};

	xo_therm {
		polling-delay-passive = <0>;
		polling-delay = <0>;
		thermal-governor = "user_space";
		thermal-sensors = <&pmk8350_adc_tm PMK8350_ADC7_AMUX_THM1_100K_PU>;
		wake-capable-sensor;
		trips {
			active-config0 {
				temperature = <125000>;
				hysteresis = <1000>;
				type = "passive";
			};
		};
	};

	qtm_w_therm {
		polling-delay-passive = <0>;
		polling-delay = <0>;
		thermal-governor = "user_space";
		thermal-sensors = <&qmi_sensor
				(QMI_MODEM_INST_ID+QMI_MMW_PA1)>;
		trips {
			active-config0 {
				temperature = <125000>;
				hysteresis = <1000>;
				type = "passive";
			};
		};
	};

	qtm_n_therm {
		polling-delay-passive = <0>;
		polling-delay = <0>;
		thermal-governor = "user_space";
		thermal-sensors = <&qmi_sensor
				(QMI_MODEM_INST_ID+QMI_MMW_PA2)>;
		trips {
			active-config0 {
				temperature = <125000>;
				hysteresis = <1000>;
				type = "passive";
			};
		};
	};

	sdr_mmw_therm {
		polling-delay-passive = <0>;
		polling-delay = <0>;
		thermal-governor = "user_space";
		thermal-sensors = <&qmi_sensor
				(QMI_MODEM_INST_ID+QMI_MMW_PA3)>;
		trips {
			active-config0 {
				temperature = <125000>;
				hysteresis = <1000>;
				type = "passive";
			};
		};
	};

	pa_therm1 {
		polling-delay-passive = <0>;
		polling-delay = <0>;
		thermal-governor = "user_space";
		thermal-sensors = <&qmi_sensor
				(QMI_MODEM_INST_ID+QMI_PA)>;
		trips {
			active-config0 {
				temperature = <125000>;
				hysteresis = <1000>;
				type = "passive";
			};
		};
	};

	pa_therm2 {
		polling-delay-passive = <0>;
		polling-delay = <0>;
		thermal-governor = "user_space";
		thermal-sensors = <&qmi_sensor
				(QMI_MODEM_INST_ID+QMI_PA_1)>;
		trips {
			active-config0 {
				temperature = <125000>;
				hysteresis = <1000>;
				type = "passive";
			};
		};
	};

	socd {
		trips {
			socd-trip {
				temperature = <95>;
				hysteresis = <0>;
				type = "passive";
			};
		};
	};
};

&fsa4480 {
	status = "disabled";
};

&sde_dp {
	qcom,aux-en-gpio = <&tlmm 54 0>;
	qcom,aux-sel-gpio = <&tlmm 55 0>;
	qcom,dp-gpio-aux-switch;
};

&ibb_vreg {
       qcom,ibb-single-phase;
};

#include "sec_touchscreen.dtsi"
#include "somc-sagami-nfc.dtsi"

&cam_cci0 {
	qcom,i2c_fast_mode {
		hw-thigh = <43>;
		hw-tlow = <64>;
		hw-tsu-sto = <41>;
		hw-tsu-sta = <41>;
		hw-thd-dat = <25>;
		hw-thd-sta = <35>;
		hw-tbuf = <64>;
		hw-scl-stretch-en = <0>;
		hw-trdhld = <6>;
		hw-tsp = <3>;
		cci-clk-src = <37500000>;
		status = "ok";
	};

	qcom,i2c_fast_plus_mode {
		hw-thigh = <16>;
		hw-tlow = <22>;
		hw-tsu-sto = <17>;
		hw-tsu-sta = <18>;
		hw-thd-dat = <16>;
		hw-thd-sta = <15>;
		hw-tbuf = <19>;
		hw-scl-stretch-en = <1>;
		hw-trdhld = <3>;
		hw-tsp = <3>;
		cci-clk-src = <37500000>;
		status = "ok";
	};
};

&cam_cci1 {
	qcom,i2c_fast_mode {
		hw-thigh = <43>;
		hw-tlow = <64>;
		hw-tsu-sto = <41>;
		hw-tsu-sta = <41>;
		hw-thd-dat = <25>;
		hw-thd-sta = <35>;
		hw-tbuf = <64>;
		hw-scl-stretch-en = <0>;
		hw-trdhld = <6>;
		hw-tsp = <3>;
		cci-clk-src = <37500000>;
		status = "ok";
	};

	qcom,i2c_fast_plus_mode {
		hw-thigh = <16>;
		hw-tlow = <22>;
		hw-tsu-sto = <17>;
		hw-tsu-sta = <18>;
		hw-thd-dat = <16>;
		hw-thd-sta = <15>;
		hw-tbuf = <19>;
		hw-scl-stretch-en = <1>;
		hw-trdhld = <3>;
		hw-tsp = <3>;
		cci-clk-src = <37500000>;
		status = "ok";
	};
};

&pm8350c_flash {
	qcom,hw-strobe-gpios = <&pm8350c_gpios 1 0>, <&pm8350c_gpios 2 0>;
	status = "okay";
};

&pm8350c_flash0 {
	qcom,max-current-ma = <1000>;
	qcom,strobe-sel = <1>;
	qcom,strobe-config = <0>;
};

&pm8350c_flash1 {
	status = "disabled";
};

&pm8350c_flash2 {
	status = "disabled";
};

&pm8350c_flash3 {
	qcom,max-current = <1000>;
	qcom,strobe-sel = <1>;
	qcom,strobe-config = <0>;
};

&pm8350c_torch0 {
	qcom,max-current-ma = <500>;
	qcom,strobe-sel = <0>;
};

&pm8350c_torch1 {
	status = "disabled";
};

&pm8350c_torch2 {
	status = "disabled";
};

&pm8350c_torch3 {
	qcom,max-current-ma = <500>;
	qcom,strobe-sel = <0>;
};

&pm8350c_switch0 {
	qcom,led-mask = <9>;
};

&pm8350c_switch1 {
	status = "disabled";
};

&pm8350c_switch2 {
	status = "disabled";
};

#include "lahaina-sagami-camera.dtsi"
