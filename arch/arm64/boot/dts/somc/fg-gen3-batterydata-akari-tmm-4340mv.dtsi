// SPDX-License-Identifier: GPL-2.0-only
/*
 * Copyright (c) 2017, The Linux Foundation. All rights reserved.
 */

qcom,akari_tmm_4340mv {
	qcom, = <24>;
	somc,initial-capacity-uah = <3217000>;
	qcom,max-voltage-uv = <4335000>;
	qcom,fg-cc-cv-threshold-mv = <4325>;
	qcom,fastchg-current-ma = <2275>;
	qcom,batt-id-kohm = <330>;
	qcom,battery-beta = <4050>;
	qcom,battery-type = "1310-1782-1";
	qcom,checksum = <0x6F2D>;
	qcom,gui-version = "PMI8998GUI - 2.0.0.58";
	qcom,fg-profile-data = [
		 6D 1F CF 05
		 29 0A 3B FD
		 D7 1C D8 00
		 72 02 27 0D
		 8D 18 5B 22
		 BC 3C 1F 4B
		 60 00 00 00
		 10 00 00 00
		 00 00 89 C2
		 AA D5 F5 CA
		 2D 00 08 00
		 43 DC 9D DD
		 D8 05 5B FA
		 67 05 0F 03
		 70 D3 A4 22
		 38 06 09 20
		 27 00 14 00
		 83 1F 0E 06
		 CA 03 D1 FD
		 D4 1C C8 01
		 FB FD DE 05
		 A4 18 D5 22
		 9B 45 E3 52
		 5C 00 00 00
		 0E 00 00 00
		 00 00 D8 D5
		 62 B3 AD CA
		 26 00 00 00
		 22 EA 9D DD
		 21 06 CA F3
		 17 FD C7 02
		 63 F4 24 13
		 A2 33 CC FF
		 07 10 00 00
		 18 0C 5C 45
		 26 00 40 00
		 9B 01 0A FA
		 FF 00 00 00
		 00 00 00 00
		 00 00 00 00
		 00 00 00 00
		 00 00 00 00
		 00 00 00 00
		 00 00 00 00
		 00 00 00 00
		 00 00 00 00
		 00 00 00 00
		 00 00 00 00
		 00 00 00 00
		 00 00 00 00
		 00 00 00 00
		 00 00 00 00
		 00 00 00 00
		 00 00 00 00
		 00 00 00 00
		 00 00 00 00
	];
};
