/* Copyright (c) 2019, The Linux Foundation. All rights reserved.
 *
 * This program is free software; you can redistribute it and/or modify
 * it under the terms of the GNU General Public License version 2 and
 * only version 2 as published by the Free Software Foundation.
 *
 * This program is distributed in the hope that it will be useful,
 * but WITHOUT ANY WARRANTY; without even the implied warranty of
 * MERCHANTABILITY or FITNESS FOR A PARTICULAR PURPOSE.  See the
 * GNU General Public License for more details.
 */

qcom,pdx203_tdk_4300mv {
	/* Added or Modified by SOMC */
	qcom,battery-type = "1319-9997";
	qcom,fastchg-current-ma = <3850>;
	qcom,jeita-hard-thresholds = <0x5314 0x181d>;
	somc,initial-capacity-uah = <3999000>;
	somc,step-cfg = <
		(-2550) 50    0 4500    0 4300 1
		   50  120    0 4500  750 4300 2
		  120  200    0 4100 2300 4300 3
		  120  200 4100 4200 1500 4300 3
		  120  200 4200 4500 1350 4300 3
		  200  450    0 4150 3050 4300 3
		  200  450 4150 4200 2300 4300 3
		  200  450 4200 4500 1500 4300 3
		  450  550    0 4500 1150 4200 4
		  550 2550    0 4500    0 4200 5
	>;
	somc,step-cell-impedance-mohm = <0>;

	/* Prepared by Qualcomm */
	qcom,profile-revision = <24>;
	/* #4167896_SoMC_MyronTDK_3654mAh_averaged_MasterSlave_Oct1st2019*/
	qcom,max-voltage-uv = <4300000>;
	qcom,fg-cc-cv-threshold-mv = <4290>;
	qcom,nom-batt-capacity-mah = <3654>;
	qcom,batt-id-kohm = <15>;
	qcom,battery-beta = <4250>;
	qcom,therm-room-temp = <100000>;
	/* qcom,battery-type = "4167896_somc_myrontdk_3654mah_averaged_masterslave_oct1st2019"; */
	qcom,therm-coefficients = <0x2318 0xd0c 0xdaf7 0xc556 0x848d>;
	qcom,therm-center-offset = <0x70>;
	qcom,therm-pull-up = <100>;
	qcom,rslow-normal-coeffs = <0x39 0xfb 0x63 0x12>;
	qcom,rslow-low-coeffs = <0xef 0x03 0x6e 0x13>;
	qcom,checksum = <0xA944>;
	qcom,gui-version = "PM855GUI - 1.0.0.13";
	qcom,fg-profile-data = [
		 09 00 DE E3
		 E9 DD AA DB
		 FF DD 00 00
		 CF BC 1F 8B
		 FB 87 90 82
		 A1 94 66 80
		 20 00 39 FB
		 63 12 07 F4
		 71 ED CE 07
		 32 00 2F EB
		 45 ED D6 D2
		 83 0B 9D E5
		 4D C4 CF 04
		 AC 00 3D D2
		 60 00 4D 00
		 4C 00 4B 00
		 33 00 35 00
		 39 00 42 00
		 4D 00 41 00
		 3B 00 60 00
		 33 00 43 00
		 49 00 46 00
		 3B 00 64 00
		 63 64 50 00
		 40 00 37 08
		 60 F8 50 00
		 4C 00 5E 08
		 5F 08 48 00
		 88 20 73 48
		 58 58 4A 0E
		 42 00 D8 08
		 E9 1F 55 0D
		 5D 02 0F 05
		 9E 1C D4 02
		 3F 04 CE 23
		 80 18 B6 43
		 F8 55 14 03
		 73 11 8D 22
		 69 05 FE 03
		 1F 05 FA 1C
		 82 F9 47 05
		 D5 02 3C 18
		 59 23 05 45
		 A1 53 A0 13
		 83 1F E3 E5
		 FD C3 CB B6
		 DE 1C 0D BB
		 50 05 E1 BA
		 5B 18 F2 92
		 98 85 B3 9A
		 8B 98 09 80
		 B8 03 A0 04
		 A0 FA 61 F2
		 00 F8 4B DC
		 95 E2 ED 07
		 DD EA CD D5
		 0F 10 18 00
		 D0 E7 A3 03
		 CF 04 79 03
		 CE 07 32 00
		 29 03 49 03
		 12 04 AE 02
		 94 04 4A 02
		 20 02 CB 02
		 A7 04 46 00
		 3C 00 4F 00
		 52 64 55 00
		 55 F8 53 00
		 53 F0 55 00
		 56 00 4C 08
		 37 08 42 00
		 56 28 54 48
		 5D 60 6E 0D
		 52 00 4E 00
		 5A 08 64 00
		 54 00 42 00
		 47 08 55 08
		 52 00 5C 20
		 78 48 5F 58
		 4E 0E 5D 00
		 63 F8 4D 00
		 D8 F8 78 1F
		 E7 04 CC 0A
		 75 0D E1 1C
		 08 23 00 44
		 EF 53 83 18
		 1D 02 81 05
		 0A 02 6C 10
		 3F 0A 97 20
		 C6 04 D2 02
		 00 06 D7 1C
		 A0 02 BB 04
		 3A 03 94 18
		 D2 03 E7 05
		 30 03 7B 00
		 62 1F 09 04
		 FF 03 6D 05
		 D1 1C 52 02
		 31 05 F1 02
		 B0 18 26 03
		 12 05 C5 03
		 72 00 08 01
		 C0 00 FA 00
		 8A 0E 00 00
	];
};
