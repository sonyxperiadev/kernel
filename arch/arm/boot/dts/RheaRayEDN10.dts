/dts-v1/;

/ {
	#address-cells = <1>;
	#size-cells = <1>;
	model = "Broadcom_RheaRayEDN10_board, v1";
	compatible = "Broadcom,RheaRay";

	chosen {
	};

	pinmux {
		compatible = "Broadcom,RheaRay-pinmux";
		reg = <0x35004800 147>;		/*base address and # of pins*/
		data = <
			0x00000023   /* 0x3500_4800: ADCSYN: GPEN09: 0 = TTL input: 0 = pull-down disabled: 1 = pull-up enabled: 0 = unslewed output: 0 = Input Enabled: 011: 8mA */
			0x00000023   /* 0x3500_4804: BATRM: BATRM: 0 = TTL input: 0 = pull-down disabled: 1 = pull-up enabled: 0 = unslewed output: 0 = Input Enabled: 011: 8mA */
			0x00000023   /* 0x3500_4808: BSC1CLK: BSC1CLK: 0 = TTL input: 0 = pull-down disabled: 1 = pull-up enabled: 0 = unslewed output: 0 = Input Enabled: 011: 8mA */
			0x00000023   /* 0x3500_480C: BSC1DAT: BSC1DAT: 0 = TTL input: 0 = pull-down disabled: 1 = pull-up enabled: 0 = unslewed output: 0 = Input Enabled: 011: 8mA */
			0x00000203   /* 0x3500_4810: CAMCS0: LCDD16: 0 = TTL input: 0 = pull-down disabled: 0 = pull-up disabled: 0 = unslewed output: 0 = Input Enabled: 011: 8mA */
			0x00000203   /* 0x3500_4814: CAMCS1: LCDD17: 0 = TTL input: 0 = pull-down disabled: 0 = pull-up disabled: 0 = unslewed output: 0 = Input Enabled: 011: 8mA */
			0x00000080   /* 0x3500_4818: CLK32K: CLK32K: 1  = Schmitt Trigger input: 0 = pull-down disabled: 0 = pull-up disabled: 0 = unslewed output: 0 = Input Enabled: 000: 2mA */
			0x00000043   /* 0x3500_481C: CLK_CX8: CLK_CX8: 0 = TTL input: 1 = pull-down enabled: 0 = pull-up disabled: 0 = unslewed output: 0 = Input Enabled: 011: 8mA */
			0x00000003   /* 0x3500_4820: DCLK1: DCLK1 : 0 = TTL input: 0 = pull-down disabled: 0 = pull-up disabled: 0 = unslewed output: 0 = Input Enabled: 011: 8mA */
			0x00000203   /* 0x3500_4824: DCLK4: SSP1DO: 0 = TTL input: 0 = pull-down disabled: 0 = pull-up disabled: 0 = unslewed output: 0 = Input Enabled: 011: 8mA */
			0x00000403   /* 0x3500_4828: DCLKREQ1: GPIO111: 0 = TTL input: 0 = pull-down disabled: 0 = pull-up disabled: 0 = unslewed output: 0 = Input Enabled: 011: 8mA */
			0x00000203   /* 0x3500_482C: DCLKREQ4: SSP1DI: 0 = TTL input: 0 = pull-down disabled: 0 = pull-up disabled: 0 = unslewed output: 0 = Input Enabled: 011: 8mA */
			0x00000043   /* 0x3500_4830: DMIC0CLK: DMIC0CLK: 0 = TTL input: 1 = pull-down enabled: 0 = pull-up disabled: 0 = unslewed output: 0 = Input Enabled: 011: 8mA */
			0x00000043   /* 0x3500_4834: DMIC0DQ: DMIC0DQ: 0 = TTL input: 1 = pull-down enabled: 0 = pull-up disabled: 0 = unslewed output: 0 = Input Enabled: 011: 8mA */
			0x00000403   /* 0x3500_4838: DSI0TE: DSI0TE: 0 = TTL input: 0 = pull-down disabled: 0 = pull-up disabled: 0 = unslewed output: 0 = Input Enabled: 011: 8mA */
			0x00000103   /* 0x3500_483C: GPIO00: KEY_R0: 0 = TTL input: 0 = pull-down disabled: 0 = pull-up disabled: 0 = unslewed output: 0 = Input Enabled: 011: 8mA */
			0x00000103   /* 0x3500_4840: GPIO01: KEY_R1: 0 = TTL input: 0 = pull-down disabled: 0 = pull-up disabled: 0 = unslewed output: 0 = Input Enabled: 011: 8mA */
			0x00000103   /* 0x3500_4844: GPIO02: KEY_R2: 0 = TTL input: 0 = pull-down disabled: 0 = pull-up disabled: 0 = unslewed output: 0 = Input Enabled: 011: 8mA */
			0x00000103   /* 0x3500_4848: GPIO03: KEY_R3: 0 = TTL input: 0 = pull-down disabled: 0 = pull-up disabled: 0 = unslewed output: 0 = Input Enabled: 011: 8mA */
			0x00000103   /* 0x3500_484C: GPIO04: KEY_R4: 0 = TTL input: 0 = pull-down disabled: 0 = pull-up disabled: 0 = unslewed output: 0 = Input Enabled: 011: 8mA */
			0x00000103   /* 0x3500_4850: GPIO05: KEY_R5: 0 = TTL input: 0 = pull-down disabled: 0 = pull-up disabled: 0 = unslewed output: 0 = Input Enabled: 011: 8mA */
			0x00000103   /* 0x3500_4854: GPIO06: KEY_R6: 0 = TTL input: 0 = pull-down disabled: 0 = pull-up disabled: 0 = unslewed output: 0 = Input Enabled: 011: 8mA */
			0x00000103   /* 0x3500_4858: GPIO07: KEY_R7: 0 = TTL input: 0 = pull-down disabled: 0 = pull-up disabled: 0 = unslewed output: 0 = Input Enabled: 011: 8mA */
			0x00000103   /* 0x3500_485C: GPIO08: KEY_C0: 0 = TTL input: 0 = pull-down disabled: 0 = pull-up disabled: 0 = unslewed output: 0 = Input Enabled: 011: 8mA */
			0x00000103   /* 0x3500_4860: GPIO09: KEY_C1: 0 = TTL input: 0 = pull-down disabled: 0 = pull-up disabled: 0 = unslewed output: 0 = Input Enabled: 011: 8mA */
			0x00000103   /* 0x3500_4864: GPIO10: KEY_C2: 0 = TTL input: 0 = pull-down disabled: 0 = pull-up disabled: 0 = unslewed output: 0 = Input Enabled: 011: 8mA */
			0x00000103   /* 0x3500_4868: GPIO11: KEY_C3: 0 = TTL input: 0 = pull-down disabled: 0 = pull-up disabled: 0 = unslewed output: 0 = Input Enabled: 011: 8mA */
			0x00000103   /* 0x3500_486C: GPIO12: KEY_C4: 0 = TTL input: 0 = pull-down disabled: 0 = pull-up disabled: 0 = unslewed output: 0 = Input Enabled: 011: 8mA */
			0x00000103   /* 0x3500_4870: GPIO13: KEY_C5: 0 = TTL input: 0 = pull-down disabled: 0 = pull-up disabled: 0 = unslewed output: 0 = Input Enabled: 011: 8mA */
			0x00000103   /* 0x3500_4874: GPIO14: KEY_C6: 0 = TTL input: 0 = pull-down disabled: 0 = pull-up disabled: 0 = unslewed output: 0 = Input Enabled: 011: 8mA */
			0x00000103   /* 0x3500_4878: GPIO15: KEY_C7: 0 = TTL input: 0 = pull-down disabled: 0 = pull-up disabled: 0 = unslewed output: 0 = Input Enabled: 011: 8mA */
			0x00000123   /* 0x3500_487C: GPIO16: BSC2CLK: 0 = TTL input: 0 = pull-down disabled: 1 = pull-up enabled: 0 = unslewed output: 0 = Input Enabled: 011: 8mA */
			0x00000123   /* 0x3500_4880: GPIO17: BSC2DAT: 0 = TTL input: 0 = pull-down disabled: 1 = pull-up enabled: 0 = unslewed output: 0 = Input Enabled: 011: 8mA */
			0x00000103   /* 0x3500_4884: GPIO18: LCDCS1: 0 = TTL input: 0 = pull-down disabled: 0 = pull-up disabled: 0 = unslewed output: 0 = Input Enabled: 011: 8mA */
			0x00000103   /* 0x3500_4888: GPIO19: LCDWE: 0 = TTL input: 0 = pull-down disabled: 0 = pull-up disabled: 0 = unslewed output: 0 = Input Enabled: 011: 8mA */
			0x00000103   /* 0x3500_488C: GPIO20: LCDRE: 0 = TTL input: 0 = pull-down disabled: 0 = pull-up disabled: 0 = unslewed output: 0 = Input Enabled: 011: 8mA */
			0x00000103   /* 0x3500_4890: GPIO21: LCDD7: 0 = TTL input: 0 = pull-down disabled: 0 = pull-up disabled: 0 = unslewed output: 0 = Input Enabled: 011: 8mA */
			0x00000103   /* 0x3500_4894: GPIO22: LCDD6: 0 = TTL input: 0 = pull-down disabled: 0 = pull-up disabled: 0 = unslewed output: 0 = Input Enabled: 011: 8mA */
			0x00000103   /* 0x3500_4898: GPIO23: LCDD5: 0 = TTL input: 0 = pull-down disabled: 0 = pull-up disabled: 0 = unslewed output: 0 = Input Enabled: 011: 8mA */
			0x00000103   /* 0x3500_489C: GPIO24: LCDD4: 0 = TTL input: 0 = pull-down disabled: 0 = pull-up disabled: 0 = unslewed output: 0 = Input Enabled: 011: 8mA */
			0x00000103   /* 0x3500_48A0: GPIO25: LCDD3: 0 = TTL input: 0 = pull-down disabled: 0 = pull-up disabled: 0 = unslewed output: 0 = Input Enabled: 011: 8mA */
			0x00000103   /* 0x3500_48A4: GPIO26: LCDD2: 0 = TTL input: 0 = pull-down disabled: 0 = pull-up disabled: 0 = unslewed output: 0 = Input Enabled: 011: 8mA */
			0x00000103   /* 0x3500_48A8: GPIO27: LCDD1: 0 = TTL input: 0 = pull-down disabled: 0 = pull-up disabled: 0 = unslewed output: 0 = Input Enabled: 011: 8mA */
			0x00000103   /* 0x3500_48AC: GPIO28: DSI1TE: 0 = TTL input: 0 = pull-down disabled: 0 = pull-up disabled: 0 = unslewed output: 0 = Input Enabled: 011: 8mA */
			0x00000203   /* 0x3500_48B0: GPIO32: SSP1CK: 0 = TTL input: 0 = pull-down disabled: 0 = pull-up disabled: 0 = unslewed output: 0 = Input Enabled: 011: 8mA */
			0x00000403   /* 0x3500_48B4: GPIO33: DMIC1CLK: 0 = TTL input: 0 = pull-down disabled: 0 = pull-up disabled: 0 = unslewed output: 0 = Input Enabled: 011: 8mA */
			0x00000403   /* 0x3500_48B8: GPIO34: DMIC1DQ: 0 = TTL input: 0 = pull-down disabled: 0 = pull-up disabled: 0 = unslewed output: 0 = Input Enabled: 011: 8mA */
			0x00000403   /* 0x3500_48BC: GPS_CALREQ: GPIO99: 0 = TTL input: 0 = pull-down disabled: 0 = pull-up disabled: 0 = unslewed output: 0 = Input Enabled: 011: 8mA */
			0x00000403   /* 0x3500_48C0: GPS_HOSTREQ: GPIO100: 0 = TTL input: 0 = pull-down disabled: 0 = pull-up disabled: 0 = unslewed output: 0 = Input Enabled: 011: 8mA */
			0x00000403   /* 0x3500_48C4: GPS_PABLANK: GPIO98: 0 = TTL input: 0 = pull-down disabled: 0 = pull-up disabled: 0 = unslewed output: 0 = Input Enabled: 011: 8mA */
			0x00000403   /* 0x3500_48C8: GPS_TMARK: GPIO97: 0 = TTL input: 0 = pull-down disabled: 0 = pull-up disabled: 0 = unslewed output: 0 = Input Enabled: 011: 8mA */
			0x00000400   /* 0x3500_48CC: ICUSBDM: GPIO122: 0 = TTL input: 0 = pull-down disabled: 0 = pull-up disabled: 0 = unslewed output: 0 = Input Enabled: 000: 2mA */
			0x00000400   /* 0x3500_48D0: ICUSBDP: GPIO121: 0 = TTL input: 0 = pull-down disabled: 0 = pull-up disabled: 0 = unslewed output: 0 = Input Enabled: 000: 2mA */
			0x00000003   /* 0x3500_48D4: LCDCS0: LCDCS0: 0 = TTL input: 0 = pull-down disabled: 0 = pull-up disabled: 0 = unslewed output: 0 = Input Enabled: 011: 8mA */
			0x0000040B   /* 0x3500_48D8: LCDRES: GPIO41: 0 = TTL input: 0 = pull-down disabled: 0 = pull-up disabled: 0 = unslewed output: 1 = Input Disabled: 011: 8mA */
			0x00000003   /* 0x3500_48DC: LCDSCL: LCDSCL: 0 = TTL input: 0 = pull-down disabled: 0 = pull-up disabled: 0 = unslewed output: 0 = Input Enabled: 011: 8mA */
			0x00000003   /* 0x3500_48E0: LCDSDA: LCDSDA: 0 = TTL input: 0 = pull-down disabled: 0 = pull-up disabled: 0 = unslewed output: 0 = Input Enabled: 011: 8mA */
			0x00000043   /* 0x3500_48E4: LCDTE: LCDTE: 0 = TTL input: 1 = pull-down enabled: 0 = pull-up disabled: 0 = unslewed output: 0 = Input Enabled: 011: 8mA */
			0x00000403   /* 0x3500_48E8: MDMGPIO00: GPIO112: 0 = TTL input: 0 = pull-down disabled: 0 = pull-up disabled: 0 = unslewed output: 0 = Input Enabled: 011: 8mA */
			0x00000403   /* 0x3500_48EC: MDMGPIO01: GPIO113: 0 = TTL input: 0 = pull-down disabled: 0 = pull-up disabled: 0 = unslewed output: 0 = Input Enabled: 011: 8mA */
			0x00000403   /* 0x3500_48F0: MDMGPIO02: GPIO114: 0 = TTL input: 0 = pull-down disabled: 0 = pull-up disabled: 0 = unslewed output: 0 = Input Enabled: 011: 8mA */
			0x00000203   /* 0x3500_48F4: MDMGPIO03: GPEN14: 0 = TTL input: 0 = pull-down disabled: 0 = pull-up disabled: 0 = unslewed output: 0 = Input Enabled: 011: 8mA */
			0x00000403   /* 0x3500_48F8: MDMGPIO04: GPIO116: 0 = TTL input: 0 = pull-down disabled: 0 = pull-up disabled: 0 = unslewed output: 0 = Input Enabled: 011: 8mA */
			0x00000403   /* 0x3500_48FC: MDMGPIO05: GPIO117: 0 = TTL input: 0 = pull-down disabled: 0 = pull-up disabled: 0 = unslewed output: 0 = Input Enabled: 011: 8mA */
			0x00000403   /* 0x3500_4900: MDMGPIO06: GPIO118: 0 = TTL input: 0 = pull-down disabled: 0 = pull-up disabled: 0 = unslewed output: 0 = Input Enabled: 011: 8mA */
			0x00000403   /* 0x3500_4904: MDMGPIO07: GPIO119: 0 = TTL input: 0 = pull-down disabled: 0 = pull-up disabled: 0 = unslewed output: 0 = Input Enabled: 011: 8mA */
			0x00000403   /* 0x3500_4908: MDMGPIO08: GPIO120: 0 = TTL input: 0 = pull-down disabled: 0 = pull-up disabled: 0 = unslewed output: 0 = Input Enabled: 011: 8mA */
			0x00000043   /* 0x3500_490C: MMC0CK: MMC0CK: 0 = TTL input: 1 = pull-down enabled: 0 = pull-up disabled: 0 = unslewed output: 0 = Input Enabled: 011: 8mA */
			0x00000023   /* 0x3500_4910: MMC0CMD: MMC0CMD: 0 = TTL input: 0 = pull-down disabled: 1 = pull-up enabled: 0 = unslewed output: 0 = Input Enabled: 011: 8mA */
			0x00000023   /* 0x3500_4914: MMC0DAT0: MMC0DAT0: 0 = TTL input: 0 = pull-down disabled: 1 = pull-up enabled: 0 = unslewed output: 0 = Input Enabled: 011: 8mA */
			0x00000023   /* 0x3500_4918: MMC0DAT1: MMC0DAT1: 0 = TTL input: 0 = pull-down disabled: 1 = pull-up enabled: 0 = unslewed output: 0 = Input Enabled: 011: 8mA */
			0x00000023   /* 0x3500_491C: MMC0DAT2: MMC0DAT2: 0 = TTL input: 0 = pull-down disabled: 1 = pull-up enabled: 0 = unslewed output: 0 = Input Enabled: 011: 8mA */
			0x00000023   /* 0x3500_4920: MMC0DAT3: MMC0DAT3: 0 = TTL input: 0 = pull-down disabled: 1 = pull-up enabled: 0 = unslewed output: 0 = Input Enabled: 011: 8mA */
			0x00000023   /* 0x3500_4924: MMC0DAT4: MMC0DAT4: 0 = TTL input: 0 = pull-down disabled: 1 = pull-up enabled: 0 = unslewed output: 0 = Input Enabled: 011: 8mA */
			0x00000023   /* 0x3500_4928: MMC0DAT5: MMC0DAT5: 0 = TTL input: 0 = pull-down disabled: 1 = pull-up enabled: 0 = unslewed output: 0 = Input Enabled: 011: 8mA */
			0x00000023   /* 0x3500_492C: MMC0DAT6: MMC0DAT6: 0 = TTL input: 0 = pull-down disabled: 1 = pull-up enabled: 0 = unslewed output: 0 = Input Enabled: 011: 8mA */
			0x00000023   /* 0x3500_4930: MMC0DAT7: MMC0DAT7: 0 = TTL input: 0 = pull-down disabled: 1 = pull-up enabled: 0 = unslewed output: 0 = Input Enabled: 011: 8mA */
			0x00000043   /* 0x3500_4934: MMC0RST: MMC0RSTN: 0 = TTL input: 1 = pull-down enabled: 0 = pull-up disabled: 0 = unslewed output: 0 = Input Enabled: 011: 8mA */
			0x00000003   /* 0x3500_4938: MMC1CK: MMC1CK: 0 = TTL input: 0 = pull-down disabled: 0 = pull-up disabled: 0 = unslewed output: 0 = Input Enabled: 011: 8mA */
			0x00000003   /* 0x3500_493C: MMC1CMD: MMC1CMD: 0 = TTL input: 0 = pull-down disabled: 0 = pull-up disabled: 0 = unslewed output: 0 = Input Enabled: 011: 8mA */
			0x00000003   /* 0x3500_4940: MMC1DAT0: MMC1DAT0: 0 = TTL input: 0 = pull-down disabled: 0 = pull-up disabled: 0 = unslewed output: 0 = Input Enabled: 011: 8mA */
			0x00000003   /* 0x3500_4944: MMC1DAT1: MMC1DAT1: 0 = TTL input: 0 = pull-down disabled: 0 = pull-up disabled: 0 = unslewed output: 0 = Input Enabled: 011: 8mA */
			0x00000003   /* 0x3500_4948: MMC1DAT2: MMC1DAT2: 0 = TTL input: 0 = pull-down disabled: 0 = pull-up disabled: 0 = unslewed output: 0 = Input Enabled: 011: 8mA */
			0x00000003   /* 0x3500_494C: MMC1DAT3: MMC1DAT3: 0 = TTL input: 0 = pull-down disabled: 0 = pull-up disabled: 0 = unslewed output: 0 = Input Enabled: 011: 8mA */
			0x00000303   /* 0x3500_4950: MMC1DAT4: ANA_SYS_REQ2: 0 = TTL input: 0 = pull-down disabled: 0 = pull-up disabled: 0 = unslewed output: 0 = Input Enabled: 011: 8mA */
			0x00000303   /* 0x3500_4954: MMC1DAT5: ANA_SYS_REQ1: 0 = TTL input: 0 = pull-down disabled: 0 = pull-up disabled: 0 = unslewed output: 0 = Input Enabled: 011: 8mA */
			0x00000303   /* 0x3500_4958: MMC1DAT6: ANA_SYS_REQ3: 0 = TTL input: 0 = pull-down disabled: 0 = pull-up disabled: 0 = unslewed output: 0 = Input Enabled: 011: 8mA */
			0x00000403   /* 0x3500_495C: MMC1DAT7: GPIO71: 0 = TTL input: 0 = pull-down disabled: 0 = pull-up disabled: 0 = unslewed output: 0 = Input Enabled: 011: 8mA */
			0x00000003   /* 0x3500_4960: MMC1RST: MMC1RSTN: 0 = TTL input: 0 = pull-down disabled: 0 = pull-up disabled: 0 = unslewed output: 0 = Input Enabled: 011: 8mA */
			0x00000003   /* 0x3500_4964: PC1: PC1: 0 = TTL input: 0 = pull-down disabled: 0 = pull-up disabled: 0 = unslewed output: 0 = Input Enabled: 011: 8mA */
			0x00000003   /* 0x3500_4968: PC2: PC2: 0 = TTL input: 0 = pull-down disabled: 0 = pull-up disabled: 0 = unslewed output: 0 = Input Enabled: 011: 8mA */
			0x00000023   /* 0x3500_496C: PMBSCCLK: PMBSCCLK: 0 = TTL input: 0 = pull-down disabled: 1 = pull-up enabled: 0 = unslewed output: 0 = Input Enabled: 011: 8mA */
			0x00000023   /* 0x3500_4970: PMBSCDAT: PMBSCDAT: 0 = TTL input: 0 = pull-down disabled: 1 = pull-up enabled: 0 = unslewed output: 0 = Input Enabled: 011: 8mA */
			0x00000023   /* 0x3500_4974: PMUINT: GPIO29: 0 = TTL input: 0 = pull-down disabled: 1 = pull-up enabled: 0 = unslewed output: 0 = Input Enabled: 011: 8mA */
			0x00000020   /* 0x3500_4978: RESETN: RESETN: 0 = TTL input: 0 = pull-down disabled: 1 = pull-up enabled: 0 = unslewed output: 0 = Input Enabled: 000: 2mA */
			0x00000003   /* 0x3500_497C: RFST2G_MTSLOTEN3G: GPEN03: 0 = TTL input: 0 = pull-down disabled: 0 = pull-up disabled: 0 = unslewed output: 0 = Input Enabled: 011: 8mA */
			0x00000003   /* 0x3500_4980: RTXDATA2G_TXDATA3G1: RTXDATA2G_TXDATA3G1: 0 = TTL input: 0 = pull-down disabled: 0 = pull-up disabled: 0 = unslewed output: 0 = Input Enabled: 011: 8mA */
			0x00000003   /* 0x3500_4984: RTXEN2G_TXDATA3G2: RTXEN2G_TXDATA3G2: 0 = TTL input: 0 = pull-down disabled: 0 = pull-up disabled: 0 = unslewed output: 0 = Input Enabled: 011: 8mA */
			0x00000003   /* 0x3500_4988: RXDATA3G0: RXDATA3G0: 0 = TTL input: 0 = pull-down disabled: 0 = pull-up disabled: 0 = unslewed output: 0 = Input Enabled: 011: 8mA */
			0x00000003   /* 0x3500_498C: RXDATA3G1: RXDATA3G1: 0 = TTL input: 0 = pull-down disabled: 0 = pull-up disabled: 0 = unslewed output: 0 = Input Enabled: 011: 8mA */
			0x00000003   /* 0x3500_4990: RXDATA3G2: RXDATA3G2: 0 = TTL input: 0 = pull-down disabled: 0 = pull-up disabled: 0 = unslewed output: 0 = Input Enabled: 011: 8mA */
			0x00000043   /* 0x3500_4994: SDCK: SDCK: 0 = TTL input: 1 = pull-down enabled: 0 = pull-up disabled: 0 = unslewed output: 0 = Input Enabled: 011: 8mA */
			0x00000023   /* 0x3500_4998: SDCMD: SDCMD: 0 = TTL input: 0 = pull-down disabled: 1 = pull-up enabled: 0 = unslewed output: 0 = Input Enabled: 011: 8mA */
			0x00000023   /* 0x3500_499C: SDDAT0: SDDAT0: 0 = TTL input: 0 = pull-down disabled: 1 = pull-up enabled: 0 = unslewed output: 0 = Input Enabled: 011: 8mA */
			0x00000023   /* 0x3500_49A0: SDDAT1: SDDAT1: 0 = TTL input: 0 = pull-down disabled: 1 = pull-up enabled: 0 = unslewed output: 0 = Input Enabled: 011: 8mA */
			0x00000023   /* 0x3500_49A4: SDDAT2: SDDAT2: 0 = TTL input: 0 = pull-down disabled: 1 = pull-up enabled: 0 = unslewed output: 0 = Input Enabled: 011: 8mA */
			0x00000023   /* 0x3500_49A8: SDDAT3: SDDAT3: 0 = TTL input: 0 = pull-down disabled: 1 = pull-up enabled: 0 = unslewed output: 0 = Input Enabled: 011: 8mA */
			0x00000003   /* 0x3500_49AC: SIMCLK: SIMCLK: 0 = TTL input: 0 = pull-down disabled: 0 = pull-up disabled: 0 = unslewed output: 0 = Input Enabled: 011: 8mA */
			0x00000003   /* 0x3500_49B0: SIMDAT: SIMDAT: 0 = TTL input: 0 = pull-down disabled: 0 = pull-up disabled: 0 = unslewed output: 0 = Input Enabled: 011: 8mA */
			0x00000023   /* 0x3500_49B4: SIMDET: SIMDET: 0 = TTL input: 0 = pull-down disabled: 1 = pull-up enabled: 0 = unslewed output: 0 = Input Enabled: 011: 8mA */
			0x00000003   /* 0x3500_49B8: SIMRST: SIMRSTN: 0 = TTL input: 0 = pull-down disabled: 0 = pull-up disabled: 0 = unslewed output: 0 = Input Enabled: 011: 8mA */
			0x00000100   /* 0x3500_49BC: GPIO93: GPEN13: 0 = TTL input: 0 = pull-down disabled: 0 = pull-up disabled: 0 = unslewed output: 0 = Input Enabled: 000: 2mA */
			0x00000203   /* 0x3500_49C0: GPIO94: SSP1SYN: 0 = TTL input: 0 = pull-down disabled: 0 = pull-up disabled: 0 = unslewed output: 0 = Input Enabled: 011: 8mA */
			0x00000003   /* 0x3500_49C4: SPI0CLK: SSP0CK: 0 = TTL input: 0 = pull-down disabled: 0 = pull-up disabled: 0 = unslewed output: 0 = Input Enabled: 011: 8mA */
			0x00000003   /* 0x3500_49C8: SPI0FSS: SSP0SYN: 0 = TTL input: 0 = pull-down disabled: 0 = pull-up disabled: 0 = unslewed output: 0 = Input Enabled: 011: 8mA */
			0x00000003   /* 0x3500_49CC: SPI0RXD: SSP0DI: 0 = TTL input: 0 = pull-down disabled: 0 = pull-up disabled: 0 = unslewed output: 0 = Input Enabled: 011: 8mA */
			0x00000003   /* 0x3500_49D0: SPI0TXD: SSP0DO: 0 = TTL input: 0 = pull-down disabled: 0 = pull-up disabled: 0 = unslewed output: 0 = Input Enabled: 011: 8mA */
			0x00000043   /* 0x3500_49D4: SRI_C: SRI_C: 0 = TTL input: 1 = pull-down enabled: 0 = pull-up disabled: 0 = unslewed output: 0 = Input Enabled: 011: 8mA */
			0x00000003   /* 0x3500_49D8: SRI_D: SRI_D: 0 = TTL input: 0 = pull-down disabled: 0 = pull-up disabled: 0 = unslewed output: 0 = Input Enabled: 011: 8mA */
			0x00000003   /* 0x3500_49DC: SRI_E: SRI_E: 0 = TTL input: 0 = pull-down disabled: 0 = pull-up disabled: 0 = unslewed output: 0 = Input Enabled: 011: 8mA */
			0x00000203   /* 0x3500_49E0: SSPCK: SIM2CLK: 0 = TTL input: 0 = pull-down disabled: 0 = pull-up disabled: 0 = unslewed output: 0 = Input Enabled: 011: 8mA */
			0x00000223   /* 0x3500_49E4: SSPDI: SIM2DET: 0 = TTL input: 0 = pull-down disabled: 1 = pull-up enabled: 0 = unslewed output: 0 = Input Enabled: 011: 8mA */
			0x00000203   /* 0x3500_49E8: SSPDO: SIM2DAT: 0 = TTL input: 0 = pull-down disabled: 0 = pull-up disabled: 0 = unslewed output: 0 = Input Enabled: 011: 8mA */
			0x00000203   /* 0x3500_49EC: SSPSYN: SIM2RST: 0 = TTL input: 0 = pull-down disabled: 0 = pull-up disabled: 0 = unslewed output: 0 = Input Enabled: 011: 8mA */
			0x00000023   /* 0x3500_49F0: STAT1: STAT1: 0 = TTL input: 0 = pull-down disabled: 1 = pull-up enabled: 0 = unslewed output: 0 = Input Enabled: 011: 8mA */
			0x00000003   /* 0x3500_49F4: STAT2: STAT2: 0 = TTL input: 0 = pull-down disabled: 0 = pull-up disabled: 0 = unslewed output: 0 = Input Enabled: 011: 8mA */
			0x00000043   /* 0x3500_49F8: SWCLKTCK: SWCLKTCK: 0 = TTL input: 1 = pull-down enabled: 0 = pull-up disabled: 0 = unslewed output: 0 = Input Enabled: 011: 8mA */
			0x00000023   /* 0x3500_49FC: SWDIOTMS: SWDIOTMS: 0 = TTL input: 0 = pull-down disabled: 1 = pull-up enabled: 0 = unslewed output: 0 = Input Enabled: 011: 8mA */
			0x00000023   /* 0x3500_4A00: SYSCLKEN: SYSCLKEN: 0 = TTL input: 0 = pull-down disabled: 1 = pull-up enabled: 0 = unslewed output: 0 = Input Enabled: 011: 8mA */
			0x00000023   /* 0x3500_4A04: TDI: TDI: 0 = TTL input: 0 = pull-down disabled: 1 = pull-up enabled: 0 = unslewed output: 0 = Input Enabled: 011: 8mA */
			0x00000043   /* 0x3500_4A08: TDO: TDO: 0 = TTL input: 1 = pull-down enabled: 0 = pull-up disabled: 0 = unslewed output: 0 = Input Enabled: 011: 8mA */
			0x00000040   /* 0x3500_4A0C: TESTMODE: TESTMODE: 0 = TTL input: 1 = pull-down enabled: 0 = pull-up disabled: 0 = unslewed output: 0 = Input Enabled: 000: 2mA */
			0x00000003   /* 0x3500_4A10: TRACECLK: TRACECLK: 0 = TTL input: 0 = pull-down disabled: 0 = pull-up disabled: 0 = unslewed output: 0 = Input Enabled: 011: 8mA */
			0x00000003   /* 0x3500_4A14: TRACEDT00: TRACEDT00: 0 = TTL input: 0 = pull-down disabled: 0 = pull-up disabled: 0 = unslewed output: 0 = Input Enabled: 011: 8mA */
			0x00000003   /* 0x3500_4A18: TRACEDT01: TRACEDT01: 0 = TTL input: 0 = pull-down disabled: 0 = pull-up disabled: 0 = unslewed output: 0 = Input Enabled: 011: 8mA */
			0x00000003   /* 0x3500_4A1C: TRACEDT02: TRACEDT02: 0 = TTL input: 0 = pull-down disabled: 0 = pull-up disabled: 0 = unslewed output: 0 = Input Enabled: 011: 8mA */
			0x00000003   /* 0x3500_4A20: TRACEDT03: TRACEDT03: 0 = TTL input: 0 = pull-down disabled: 0 = pull-up disabled: 0 = unslewed output: 0 = Input Enabled: 011: 8mA */
			0x00000003   /* 0x3500_4A24: TRACEDT04: TRACEDT04: 0 = TTL input: 0 = pull-down disabled: 0 = pull-up disabled: 0 = unslewed output: 0 = Input Enabled: 011: 8mA */
			0x00000003   /* 0x3500_4A28: TRACEDT05: TRACEDT05: 0 = TTL input: 0 = pull-down disabled: 0 = pull-up disabled: 0 = unslewed output: 0 = Input Enabled: 011: 8mA */
			0x00000003   /* 0x3500_4A2C: TRACEDT06: TRACEDT06: 0 = TTL input: 0 = pull-down disabled: 0 = pull-up disabled: 0 = unslewed output: 0 = Input Enabled: 011: 8mA */
			0x00000003   /* 0x3500_4A30: TRACEDT07: TRACEDT07: 0 = TTL input: 0 = pull-down disabled: 0 = pull-up disabled: 0 = unslewed output: 0 = Input Enabled: 011: 8mA */
			0x00000043   /* 0x3500_4A34: TRSTB: TRSTB: 0 = TTL input: 1 = pull-down enabled: 0 = pull-up disabled: 0 = unslewed output: 0 = Input Enabled: 011: 8mA */
			0x00000043   /* 0x3500_4A38: TXDATA3G0: TXDATA3G0: 0 = TTL input: 1 = pull-down enabled: 0 = pull-up disabled: 0 = unslewed output: 0 = Input Enabled: 011: 8mA */
			0x00000003   /* 0x3500_4A3C: UBCTSN: UBCTSN: 0 = TTL input: 0 = pull-down disabled: 0 = pull-up disabled: 0 = unslewed output: 0 = Input Enabled: 011: 8mA */
			0x00000003   /* 0x3500_4A40: UBRTSN: UBRTSN: 0 = TTL input: 0 = pull-down disabled: 0 = pull-up disabled: 0 = unslewed output: 0 = Input Enabled: 011: 8mA */
			0x00000003   /* 0x3500_4A44: UBRX: UBRX: 0 = TTL input: 0 = pull-down disabled: 0 = pull-up disabled: 0 = unslewed output: 0 = Input Enabled: 011: 8mA */
			0x00000003   /* 0x3500_4A48: UBTX: UBTX: 0 = TTL input: 0 = pull-down disabled: 0 = pull-up disabled: 0 = unslewed output: 0 = Input Enabled: 011: 8mA */
			
			>;
	};

	/* gpio node must be consistent with pinmux node */
	gpio {
		compatible = "Broadcom,RheaRay-gpio";
		reg = <0x35003000 18>;		/*base address and # of exposed GPIOs*/
		data = <
			29    0x00000002 /* 1: Input  0: Drive Low */
			41    0x00000000 /* 0: Output  0: Drive Low */
			71    0x00000002 /* 1: Input  0: Drive Low */
			97    0x00000000 /* 0: Output  0: Drive Low */
			98    0x00000002 /* 1: Input  0: Drive Low */
			99    0x00000000 /* 0: Output  0: Drive Low */
			100    0x00000000 /* 0: Output  0: Drive Low */
			111    0x00000002 /* 1: Input  0: Drive Low */
			112    0x00000002 /* 1: Input  0: Drive Low */
			113    0x00000000 /* 0: Output  0: Drive Low */
			114    0x00000000 /* 0: Output  0: Drive Low */
			116    0x00000000 /* 0: Output  0: Drive Low */
			117    0x00000002 /* 1: Input  0: Drive Low */
			118    0x00000000 /* 0: Output  0: Drive Low */
			119    0x00000000 /* 0: Output  0: Drive Low */
			120    0x00000000 /* 0: Output  0: Drive Low */
			121    0x00000002 /* 1: Input  0: Drive Low */
			122    0x00000002 /* 1: Input  0: Drive Low */
			>;
	};
};
