/dts-v1/;


/ {
	#address-cells = <1>;
	#size-cells = <1>;
	model = "HawaiiStone_EDN000";
	compatible = "HawaiiA0";
	/*  timestamp = "v0.0, 8/28/2012 4:04:21 PM";*/
	/*Version	Date	Person Responisble	Change Description	*/
	/*0.0	8/21/2012	Tim Reese	Based on Peter Chang's Rhea_B0_IOConfig	*/

	chosen {
	};

	pinmux {
		compatible = "HawaiiA0-pinmux";
		reg = <0x35004800 155>;     /* base address and # of pins */
		data = <
			0x00000003   /* 0x3500_4800: ADCSYN: GPEN09: 0 = TTL input: 0 = pull-down disabled: 0 = pull-up disabled: 0 = unslewed output: 0 = Input Enabled: 011: 8mA */
			0x00000023   /* 0x3500_4804: BATRM: BATRM: 0 = TTL input: 0 = pull-down disabled: 1 = pull-up enabled: 0 = unslewed output: 0 = Input Enabled: 011: 8mA */
			0x00000020   /* 0x3500_4808: BSC1CLK: BSC1CLK: 0 : Reserved: 0 : Reserved: 1 = pull-up enabled: 0 = unslewed output: 0 = Input Enabled: 000 : Reserved */
			0x00000020   /* 0x3500_480C: BSC1DAT: BSC1DAT: 0 : Reserved: 0 : Reserved: 1 = pull-up enabled: 0 = unslewed output: 0 = Input Enabled: 000 : Reserved */
			0x00000000   /* 0x3500_4810: CAMCS0: ANA_SYS_REQ1: 0 = TTL input: 0 = pull-down disabled: 0 = pull-up disabled: 0 = unslewed output: 0 = Input Enabled: 000: 2mA */
			0x00000100   /* 0x3500_4814: CAMCS1: ANA_SYS_REQ2: 0 = TTL input: 0 = pull-down disabled: 0 = pull-up disabled: 0 = unslewed output: 0 = Input Enabled: 000: 2mA */
			0x00000080   /* 0x3500_4818: CLK32K: CLK32K: 1  = Schmitt Trigger input: 0 = pull-down disabled: 0 = pull-up disabled: 0 = unslewed output: 0 = Input Enabled: 000: 2mA */
			0x00000012   /* 0x3500_481C: CLK_CX8: CLK_CX8: 0 = TTL input: 0 = pull-down disabled: 0 = pull-up disabled: 1 = slewed output: 0 = Input Enabled: 010: 6mA */
			0x00000003   /* 0x3500_4820: DCLK1: DCLK1: 0 = TTL input: 0 = pull-down disabled: 0 = pull-up disabled: 0 = unslewed output: 0 = Input Enabled: 011: 8mA */
			0x00000003   /* 0x3500_4824: DCLK4: DCLK4: 0 = TTL input: 0 = pull-down disabled: 0 = pull-up disabled: 0 = unslewed output: 0 = Input Enabled: 011: 8mA */
			0x00000403   /* 0x3500_4828: DCLKREQ1: GPIO111: 0 = TTL input: 0 = pull-down disabled: 0 = pull-up disabled: 0 = unslewed output: 0 = Input Enabled: 011: 8mA */
			0x00000200   /* 0x3500_482C: DCLKREQ4: SSP1DI: 0 = TTL input: 0 = pull-down disabled: 0 = pull-up disabled: 0 = unslewed output: 0 = Input Enabled: 000: 2mA */
			0x00000003   /* 0x3500_4830: DMIC0CLK: DMIC0CLK: 0 = TTL input: 0 = pull-down disabled: 0 = pull-up disabled: 0 = unslewed output: 0 = Input Enabled: 011: 8mA */
			0x00000003   /* 0x3500_4834: DMIC0DQ: DMIC0DQ: 0 = TTL input: 0 = pull-down disabled: 0 = pull-up disabled: 0 = unslewed output: 0 = Input Enabled: 011: 8mA */
			0x00000403   /* 0x3500_4838: DSI0TE: DSI0TE: 0 = TTL input: 0 = pull-down disabled: 0 = pull-up disabled: 0 = unslewed output: 0 = Input Enabled: 011: 8mA */
			0x00000123   /* 0x3500_483C: GPIO00: KEY_R0: 0 = TTL input: 0 = pull-down disabled: 1 = pull-up enabled: 0 = unslewed output: 0 = Input Enabled: 011: 8mA */
			0x00000123   /* 0x3500_4840: GPIO01: KEY_R1: 0 = TTL input: 0 = pull-down disabled: 1 = pull-up enabled: 0 = unslewed output: 0 = Input Enabled: 011: 8mA */
			0x00000003   /* 0x3500_4844: GPIO02: GPIO02: 0 = TTL input: 0 = pull-down disabled: 0 = pull-up disabled: 0 = unslewed output: 0 = Input Enabled: 011: 8mA */
			0x00000003   /* 0x3500_4848: GPIO03: GPIO03: 0 = TTL input: 0 = pull-down disabled: 0 = pull-up disabled: 0 = unslewed output: 0 = Input Enabled: 011: 8mA */
			0x00000020   /* 0x3500_484C: GPIO04: GPIO04: 0 = TTL input: 0 = pull-down disabled: 1 = pull-up enabled: 0 = unslewed output: 0 = Input Enabled: 000: 2mA */
			0x00000003   /* 0x3500_4850: GPIO05: GPIO05: 0 = TTL input: 0 = pull-down disabled: 0 = pull-up disabled: 0 = unslewed output: 0 = Input Enabled: 011: 8mA */
			0x00000400   /* 0x3500_4854: GPIO06: SSP2DI: 0 = TTL input: 0 = pull-down disabled: 0 = pull-up disabled: 0 = unslewed output: 0 = Input Enabled: 000: 2mA */
			0x00000403   /* 0x3500_4858: GPIO07: SSP2DO: 0 = TTL input: 0 = pull-down disabled: 0 = pull-up disabled: 0 = unslewed output: 0 = Input Enabled: 011: 8mA */
			0x00000123   /* 0x3500_485C: GPIO08: KEY_C0: 0 = TTL input: 0 = pull-down disabled: 1 = pull-up enabled: 0 = unslewed output: 0 = Input Enabled: 011: 8mA */
			0x00000123   /* 0x3500_4860: GPIO09: KEY_C1: 0 = TTL input: 0 = pull-down disabled: 1 = pull-up enabled: 0 = unslewed output: 0 = Input Enabled: 011: 8mA */
			0x00000123   /* 0x3500_4864: GPIO10: KEY_C2: 0 = TTL input: 0 = pull-down disabled: 1 = pull-up enabled: 0 = unslewed output: 0 = Input Enabled: 011: 8mA */
			0x00000003   /* 0x3500_4868: GPIO11: GPIO11: 0 = TTL input: 0 = pull-down disabled: 0 = pull-up disabled: 0 = unslewed output: 0 = Input Enabled: 011: 8mA */
			0x00000303   /* 0x3500_486C: GPIO12: T_SHUTDOWN: 0 = TTL input: 0 = pull-down disabled: 0 = pull-up disabled: 0 = unslewed output: 0 = Input Enabled: 011: 8mA */
			0x00000303   /* 0x3500_4870: GPIO13: UB3RX: 0 = TTL input: 0 = pull-down disabled: 0 = pull-up disabled: 0 = unslewed output: 0 = Input Enabled: 011: 8mA */
			0x00000400   /* 0x3500_4874: GPIO14: SSP2CK: 0 = TTL input: 0 = pull-down disabled: 0 = pull-up disabled: 0 = unslewed output: 0 = Input Enabled: 000: 2mA */
			0x00000400   /* 0x3500_4878: GPIO15: SSP2SYN: 0 = TTL input: 0 = pull-down disabled: 0 = pull-up disabled: 0 = unslewed output: 0 = Input Enabled: 000: 2mA */
			0x00000120   /* 0x3500_487C: GPIO16: BSC2CLK: 0 : Reserved: 0 : Reserved: 1 = pull-up enabled: 0 = unslewed output: 0 = Input Enabled: 000 : Reserved */
			0x00000120   /* 0x3500_4880: GPIO17: BSC2DAT: 0 : Reserved: 0 : Reserved: 1 = pull-up enabled: 0 = unslewed output: 0 = Input Enabled: 000 : Reserved */
			0x00000203   /* 0x3500_4884: GPIO18: UB2TX: 0 = TTL input: 0 = pull-down disabled: 0 = pull-up disabled: 0 = unslewed output: 0 = Input Enabled: 011: 8mA */
			0x00000240   /* 0x3500_4888: GPIO19: UB2RX: 0 = TTL input: 1 = pull-down enabled: 0 = pull-up disabled: 0 = unslewed output: 0 = Input Enabled: 000: 2mA */
			0x00000203   /* 0x3500_488C: GPIO20: UB2RTSN: 0 = TTL input: 0 = pull-down disabled: 0 = pull-up disabled: 0 = unslewed output: 0 = Input Enabled: 011: 8mA */
			0x00000240   /* 0x3500_4890: GPIO21: UB2CTSN: 0 = TTL input: 1 = pull-down enabled: 0 = pull-up disabled: 0 = unslewed output: 0 = Input Enabled: 000: 2mA */
			0x00000003   /* 0x3500_4894: GPIO22: GPIO22: 0 = TTL input: 0 = pull-down disabled: 0 = pull-up disabled: 0 = unslewed output: 0 = Input Enabled: 011: 8mA */
			0x00000003   /* 0x3500_4898: GPIO23: GPIO23: 0 = TTL input: 0 = pull-down disabled: 0 = pull-up disabled: 0 = unslewed output: 0 = Input Enabled: 011: 8mA */
			0x00000203   /* 0x3500_489C: GPIO24: PWM2: 0 = TTL input: 0 = pull-down disabled: 0 = pull-up disabled: 0 = unslewed output: 0 = Input Enabled: 011: 8mA */
			0x00000003   /* 0x3500_48A0: GPIO25: GPIO25: 0 = TTL input: 0 = pull-down disabled: 0 = pull-up disabled: 0 = unslewed output: 0 = Input Enabled: 011: 8mA */
			0x00000003   /* 0x3500_48A4: GPIO26: GPIO26: 0 = TTL input: 0 = pull-down disabled: 0 = pull-up disabled: 0 = unslewed output: 0 = Input Enabled: 011: 8mA */
			0x00000303   /* 0x3500_48A8: GPIO27: UB3TX: 0 = TTL input: 0 = pull-down disabled: 0 = pull-up disabled: 0 = unslewed output: 0 = Input Enabled: 011: 8mA */
			0x00000403   /* 0x3500_48AC: GPIO28: GPEN15: 0 = TTL input: 0 = pull-down disabled: 0 = pull-up disabled: 0 = unslewed output: 0 = Input Enabled: 011: 8mA */
			0x00000003   /* 0x3500_48B0: GPIO32: GPIO32: 0 = TTL input: 0 = pull-down disabled: 0 = pull-up disabled: 0 = unslewed output: 0 = Input Enabled: 011: 8mA */
			0x00000020   /* 0x3500_48B4: GPIO33: GPIO33: 0 = TTL input: 0 = pull-down disabled: 1 = pull-up enabled: 0 = unslewed output: 0 = Input Enabled: 000: 2mA */
			0x00000003   /* 0x3500_48B8: GPIO34: GPIO34: 0 = TTL input: 0 = pull-down disabled: 0 = pull-up disabled: 0 = unslewed output: 0 = Input Enabled: 011: 8mA */
			0x00000003   /* 0x3500_48BC: GPS_CALREQ: CLASSGPWR: 0 = TTL input: 0 = pull-down disabled: 0 = pull-up disabled: 0 = unslewed output: 0 = Input Enabled: 011: 8mA */
			0x00000403   /* 0x3500_48C0: GPS_HOSTREQ: GPIO100: 0 = TTL input: 0 = pull-down disabled: 0 = pull-up disabled: 0 = unslewed output: 0 = Input Enabled: 011: 8mA */
			0x00000303   /* 0x3500_48C4: GPS_PABLANK: GPEN12: 0 = TTL input: 0 = pull-down disabled: 0 = pull-up disabled: 0 = unslewed output: 0 = Input Enabled: 011: 8mA */
			0x00000003   /* 0x3500_48C8: GPS_TMARK: GPEN10: 0 = TTL input: 0 = pull-down disabled: 0 = pull-up disabled: 0 = unslewed output: 0 = Input Enabled: 011: 8mA */
			0x00000303   /* 0x3500_48CC: ICUSBDM: GPEN11: 0 = TTL input: 0 = pull-down disabled: 0 = pull-up disabled: 0 = unslewed output: 0 = Input Enabled: 011: 8mA */
			0x00000403   /* 0x3500_48D0: ICUSBDP: GPIO121: 0 = TTL input: 0 = pull-down disabled: 0 = pull-up disabled: 0 = unslewed output: 0 = Input Enabled: 011: 8mA */
			0x00000103   /* 0x3500_48D4: LCDCS0: PC3: 0 = TTL input: 0 = pull-down disabled: 0 = pull-up disabled: 0 = unslewed output: 0 = Input Enabled: 011: 8mA */
			0x00000000   /* 0x3500_48D8: LCDRES: BSC4_CLK: 0 : Reserved: 0 : Reserved: 0 = pull-up disabled: 0 = unslewed output: 0 = Input Enabled: 000 : Reserved */
			0x00000000   /* 0x3500_48DC: LCDSCL: BSC3_CLK: 0 : Reserved: 0 : Reserved: 0 = pull-up disabled: 0 = unslewed output: 0 = Input Enabled: 000 : Reserved */
			0x00000000   /* 0x3500_48E0: LCDSDA: BSC3_SDA: 0 : Reserved: 0 : Reserved: 0 = pull-up disabled: 0 = unslewed output: 0 = Input Enabled: 000 : Reserved */
			0x00000000   /* 0x3500_48E4: LCDTE: BSC4_SDA: 0 : Reserved: 0 : Reserved: 0 = pull-up disabled: 0 = unslewed output: 0 = Input Enabled: 000 : Reserved */
			0x00000205   /* 0x3500_48E8: MDMGPIO00: GPEN00: 0 = TTL input: 0 = pull-down disabled: 0 = pull-up disabled: 0 = unslewed output: 0 = Input Enabled: 101: 12mA */
			0x00000201   /* 0x3500_48EC: MDMGPIO01: GPEN01: 0 = TTL input: 0 = pull-down disabled: 0 = pull-up disabled: 0 = unslewed output: 0 = Input Enabled: 001: 4mA */
			0x00000201   /* 0x3500_48F0: MDMGPIO02: GPEN02: 0 = TTL input: 0 = pull-down disabled: 0 = pull-up disabled: 0 = unslewed output: 0 = Input Enabled: 001: 4mA */
			0x00000203   /* 0x3500_48F4: MDMGPIO03: GPEN14: 0 = TTL input: 0 = pull-down disabled: 0 = pull-up disabled: 0 = unslewed output: 0 = Input Enabled: 011: 8mA */
			0x00000200   /* 0x3500_48F8: MDMGPIO04: GPEN04: 0 = TTL input: 0 = pull-down disabled: 0 = pull-up disabled: 0 = unslewed output: 0 = Input Enabled: 000: 2mA */
			0x00000200   /* 0x3500_48FC: MDMGPIO05: GPEN05: 0 = TTL input: 0 = pull-down disabled: 0 = pull-up disabled: 0 = unslewed output: 0 = Input Enabled: 000: 2mA */
			0x00000200   /* 0x3500_4900: MDMGPIO06: GPEN06: 0 = TTL input: 0 = pull-down disabled: 0 = pull-up disabled: 0 = unslewed output: 0 = Input Enabled: 000: 2mA */
			0x00000200   /* 0x3500_4904: MDMGPIO07: GPEN07: 0 = TTL input: 0 = pull-down disabled: 0 = pull-up disabled: 0 = unslewed output: 0 = Input Enabled: 000: 2mA */
			0x00000205   /* 0x3500_4908: MDMGPIO08: GPEN08: 0 = TTL input: 0 = pull-down disabled: 0 = pull-up disabled: 0 = unslewed output: 0 = Input Enabled: 101: 12mA */
			0x00000003   /* 0x3500_490C: MMC0CK: MMC0CK: 0 = TTL input: 0 = pull-down disabled: 0 = pull-up disabled: 0 = unslewed output: 0 = Input Enabled: 011: 8mA */
			0x00000003   /* 0x3500_4910: MMC0CMD: MMC0CMD: 0 = TTL input: 0 = pull-down disabled: 0 = pull-up disabled: 0 = unslewed output: 0 = Input Enabled: 011: 8mA */
			0x00000003   /* 0x3500_4914: MMC0DAT0: MMC0DAT0: 0 = TTL input: 0 = pull-down disabled: 0 = pull-up disabled: 0 = unslewed output: 0 = Input Enabled: 011: 8mA */
			0x00000003   /* 0x3500_4918: MMC0DAT1: MMC0DAT1: 0 = TTL input: 0 = pull-down disabled: 0 = pull-up disabled: 0 = unslewed output: 0 = Input Enabled: 011: 8mA */
			0x00000003   /* 0x3500_491C: MMC0DAT2: MMC0DAT2: 0 = TTL input: 0 = pull-down disabled: 0 = pull-up disabled: 0 = unslewed output: 0 = Input Enabled: 011: 8mA */
			0x00000003   /* 0x3500_4920: MMC0DAT3: MMC0DAT3: 0 = TTL input: 0 = pull-down disabled: 0 = pull-up disabled: 0 = unslewed output: 0 = Input Enabled: 011: 8mA */
			0x00000003   /* 0x3500_4924: MMC0DAT4: MMC0DAT4: 0 = TTL input: 0 = pull-down disabled: 0 = pull-up disabled: 0 = unslewed output: 0 = Input Enabled: 011: 8mA */
			0x00000003   /* 0x3500_4928: MMC0DAT5: MMC0DAT5: 0 = TTL input: 0 = pull-down disabled: 0 = pull-up disabled: 0 = unslewed output: 0 = Input Enabled: 011: 8mA */
			0x00000003   /* 0x3500_492C: MMC0DAT6: MMC0DAT6: 0 = TTL input: 0 = pull-down disabled: 0 = pull-up disabled: 0 = unslewed output: 0 = Input Enabled: 011: 8mA */
			0x00000003   /* 0x3500_4930: MMC0DAT7: MMC0DAT7: 0 = TTL input: 0 = pull-down disabled: 0 = pull-up disabled: 0 = unslewed output: 0 = Input Enabled: 011: 8mA */
			0x00000003   /* 0x3500_4934: MMC0RST: MMC0RSTN: 0 = TTL input: 0 = pull-down disabled: 0 = pull-up disabled: 0 = unslewed output: 0 = Input Enabled: 011: 8mA */
			0x00000003   /* 0x3500_4938: MMC1CK: MMC1CK: 0 = TTL input: 0 = pull-down disabled: 0 = pull-up disabled: 0 = unslewed output: 0 = Input Enabled: 011: 8mA */
			0x00000003   /* 0x3500_493C: MMC1CMD: MMC1CMD: 0 = TTL input: 0 = pull-down disabled: 0 = pull-up disabled: 0 = unslewed output: 0 = Input Enabled: 011: 8mA */
			0x00000003   /* 0x3500_4940: MMC1DAT0: MMC1DAT0: 0 = TTL input: 0 = pull-down disabled: 0 = pull-up disabled: 0 = unslewed output: 0 = Input Enabled: 011: 8mA */
			0x00000003   /* 0x3500_4944: MMC1DAT1: MMC1DAT1: 0 = TTL input: 0 = pull-down disabled: 0 = pull-up disabled: 0 = unslewed output: 0 = Input Enabled: 011: 8mA */
			0x00000003   /* 0x3500_4948: MMC1DAT2: MMC1DAT2: 0 = TTL input: 0 = pull-down disabled: 0 = pull-up disabled: 0 = unslewed output: 0 = Input Enabled: 011: 8mA */
			0x00000003   /* 0x3500_494C: MMC1DAT3: MMC1DAT3: 0 = TTL input: 0 = pull-down disabled: 0 = pull-up disabled: 0 = unslewed output: 0 = Input Enabled: 011: 8mA */
			0x00000420   /* 0x3500_4950: MMC1DAT4: GPIO74: 0 = TTL input: 0 = pull-down disabled: 1 = pull-up enabled: 0 = unslewed output: 0 = Input Enabled: 000: 2mA */
			0x00000420   /* 0x3500_4954: MMC1DAT5: GPIO73: 0 = TTL input: 0 = pull-down disabled: 1 = pull-up enabled: 0 = unslewed output: 0 = Input Enabled: 000: 2mA */
			0x00000420   /* 0x3500_4958: MMC1DAT6: GPIO72: 0 = TTL input: 0 = pull-down disabled: 1 = pull-up enabled: 0 = unslewed output: 0 = Input Enabled: 000: 2mA */
			0x00000300   /* 0x3500_495C: MMC1DAT7: ANA_SYS_REQ3: 0 = TTL input: 0 = pull-down disabled: 0 = pull-up disabled: 0 = unslewed output: 0 = Input Enabled: 000: 2mA */
			0x00000403   /* 0x3500_4960: MMC1RST: GPIO70: 0 = TTL input: 0 = pull-down disabled: 0 = pull-up disabled: 0 = unslewed output: 0 = Input Enabled: 011: 8mA */
			0x00000003   /* 0x3500_4964: PC1: PC1: 0 = TTL input: 0 = pull-down disabled: 0 = pull-up disabled: 0 = unslewed output: 0 = Input Enabled: 011: 8mA */
			0x00000003   /* 0x3500_4968: PC2: PC2: 0 = TTL input: 0 = pull-down disabled: 0 = pull-up disabled: 0 = unslewed output: 0 = Input Enabled: 011: 8mA */
			0x00000020   /* 0x3500_496C: PMBSCCLK: PMBSCCLK: 0 : Reserved: 0 : Reserved: 1 = pull-up enabled: 0 = unslewed output: 0 = Input Enabled: 000 : Reserved */
			0x00000020   /* 0x3500_4970: PMBSCDAT: PMBSCDAT: 0 : Reserved: 0 : Reserved: 1 = pull-up enabled: 0 = unslewed output: 0 = Input Enabled: 000 : Reserved */
			0x00000003   /* 0x3500_4974: PMUINT: GPIO29: 0 = TTL input: 0 = pull-down disabled: 0 = pull-up disabled: 0 = unslewed output: 0 = Input Enabled: 011: 8mA */
			0x00000020   /* 0x3500_4978: RESETN: RESETN: 0 = TTL input: 0 = pull-down disabled: 1 = pull-up enabled: 0 = unslewed output: 0 = Input Enabled: 000: 2mA */
			0x00000005   /* 0x3500_497C: RFST2G_MTSLOTEN3G: GPEN03: 0 = TTL input: 0 = pull-down disabled: 0 = pull-up disabled: 0 = unslewed output: 0 = Input Enabled: 101: 12mA */
			0x00000003   /* 0x3500_4980: RTXDATA2G_TXDATA3G1: RTXDATA2G_TXDATA3G1: 0 = TTL input: 0 = pull-down disabled: 0 = pull-up disabled: 0 = unslewed output: 0 = Input Enabled: 011: 8mA */
			0x00000012   /* 0x3500_4984: RTXEN2G_TXDATA3G2: RTXEN2G_TXDATA3G2: 0 = TTL input: 0 = pull-down disabled: 0 = pull-up disabled: 1 = slewed output: 0 = Input Enabled: 010: 6mA */
			0x00000005   /* 0x3500_4988: RXDATA3G0: RXDATA3G0: 0 = TTL input: 0 = pull-down disabled: 0 = pull-up disabled: 0 = unslewed output: 0 = Input Enabled: 101: 12mA */
			0x00000005   /* 0x3500_498C: RXDATA3G1: RXDATA3G1: 0 = TTL input: 0 = pull-down disabled: 0 = pull-up disabled: 0 = unslewed output: 0 = Input Enabled: 101: 12mA */
			0x00000005   /* 0x3500_4990: RXDATA3G2: RXDATA3G2: 0 = TTL input: 0 = pull-down disabled: 0 = pull-up disabled: 0 = unslewed output: 0 = Input Enabled: 101: 12mA */
			0x00000003   /* 0x3500_4994: SDCK: SDCK: 0 = TTL input: 0 = pull-down disabled: 0 = pull-up disabled: 0 = unslewed output: 0 = Input Enabled: 011: 8mA */
			0x00000003   /* 0x3500_4998: SDCMD: SDCMD: 0 = TTL input: 0 = pull-down disabled: 0 = pull-up disabled: 0 = unslewed output: 0 = Input Enabled: 011: 8mA */
			0x00000003   /* 0x3500_499C: SDDAT0: SDDAT0: 0 = TTL input: 0 = pull-down disabled: 0 = pull-up disabled: 0 = unslewed output: 0 = Input Enabled: 011: 8mA */
			0x00000003   /* 0x3500_49A0: SDDAT1: SDDAT1: 0 = TTL input: 0 = pull-down disabled: 0 = pull-up disabled: 0 = unslewed output: 0 = Input Enabled: 011: 8mA */
			0x00000003   /* 0x3500_49A4: SDDAT2: SDDAT2: 0 = TTL input: 0 = pull-down disabled: 0 = pull-up disabled: 0 = unslewed output: 0 = Input Enabled: 011: 8mA */
			0x00000003   /* 0x3500_49A8: SDDAT3: SDDAT3: 0 = TTL input: 0 = pull-down disabled: 0 = pull-up disabled: 0 = unslewed output: 0 = Input Enabled: 011: 8mA */
			0x00000003   /* 0x3500_49AC: SIMCLK: SIMCLK: 0 = TTL input: 0 = pull-down disabled: 0 = pull-up disabled: 0 = unslewed output: 0 = Input Enabled: 011: 8mA */
			0x00001003   /* 0x3500_49B0: SIMDAT: SIMDAT: 0 = TTL input: 0 = pull-down disabled: 0 = pull-up disabled: 0 = unslewed output: 0 = Input Enabled: 011: 8mA : 10 = 10k pull-up */
			0x00000020   /* 0x3500_49B4: SIMDET: SIMDET: 0 = TTL input: 0 = pull-down disabled: 1 = pull-up enabled: 0 = unslewed output: 0 = Input Enabled: 000: 2mA */
			0x00000003   /* 0x3500_49B8: SIMRST: SIMRSTN: 0 = TTL input: 0 = pull-down disabled: 0 = pull-up disabled: 0 = unslewed output: 0 = Input Enabled: 011: 8mA */
			0x00000203   /* 0x3500_49BC: GPIO93: SSP1CK: 0 = TTL input: 0 = pull-down disabled: 0 = pull-up disabled: 0 = unslewed output: 0 = Input Enabled: 011: 8mA */
			0x00000203   /* 0x3500_49C0: GPIO94: SSP1SYN: 0 = TTL input: 0 = pull-down disabled: 0 = pull-up disabled: 0 = unslewed output: 0 = Input Enabled: 011: 8mA */
			0x00000420   /* 0x3500_49C4: SPI0CLK: GPIO90: 0 = TTL input: 0 = pull-down disabled: 1 = pull-up enabled: 0 = unslewed output: 0 = Input Enabled: 000: 2mA */
			0x00000420   /* 0x3500_49C8: SPI0FSS: GPIO89: 0 = TTL input: 0 = pull-down disabled: 1 = pull-up enabled: 0 = unslewed output: 0 = Input Enabled: 000: 2mA */
			0x00000420   /* 0x3500_49CC: SPI0RXD: GPIO92: 0 = TTL input: 0 = pull-down disabled: 1 = pull-up enabled: 0 = unslewed output: 0 = Input Enabled: 000: 2mA */
			0x00000420   /* 0x3500_49D0: SPI0TXD: GPIO91: 0 = TTL input: 0 = pull-down disabled: 1 = pull-up enabled: 0 = unslewed output: 0 = Input Enabled: 000: 2mA */
			0x00000003   /* 0x3500_49D4: SRI_C: SRI_C: 0 = TTL input: 0 = pull-down disabled: 0 = pull-up disabled: 0 = unslewed output: 0 = Input Enabled: 011: 8mA */
			0x00000003   /* 0x3500_49D8: SRI_D: SRI_D: 0 = TTL input: 0 = pull-down disabled: 0 = pull-up disabled: 0 = unslewed output: 0 = Input Enabled: 011: 8mA */
			0x00000003   /* 0x3500_49DC: SRI_E: SRI_E: 0 = TTL input: 0 = pull-down disabled: 0 = pull-up disabled: 0 = unslewed output: 0 = Input Enabled: 011: 8mA */
			0x00000203   /* 0x3500_49E0: SSPCK: SIM2CLK: 0 = TTL input: 0 = pull-down disabled: 0 = pull-up disabled: 0 = unslewed output: 0 = Input Enabled: 011: 8mA */
			0x00000220   /* 0x3500_49E4: SSPDI: SIM2DET: 0 = TTL input: 0 = pull-down disabled: 1 = pull-up enabled: 0 = unslewed output: 0 = Input Enabled: 000: 2mA */
			0x00001203   /* 0x3500_49E8: SSPDO: SIM2DAT: 0 = TTL input: 0 = pull-down disabled: 0 = pull-up disabled: 0 = unslewed output: 0 = Input Enabled: 011: 8mA : 10 = 10k pull-up */
			0x00000203   /* 0x3500_49EC: SSPSYN: SIM2RST: 0 = TTL input: 0 = pull-down disabled: 0 = pull-up disabled: 0 = unslewed output: 0 = Input Enabled: 011: 8mA */
			0x00000023   /* 0x3500_49F0: STAT1: STAT1: 0 = TTL input: 0 = pull-down disabled: 1 = pull-up enabled: 0 = unslewed output: 0 = Input Enabled: 011: 8mA */
			0x00000003   /* 0x3500_49F4: STAT2: STAT2: 0 = TTL input: 0 = pull-down disabled: 0 = pull-up disabled: 0 = unslewed output: 0 = Input Enabled: 011: 8mA */
			0x00000043   /* 0x3500_49F8: SWCLKTCK: SWCLKTCK: 0 = TTL input: 1 = pull-down enabled: 0 = pull-up disabled: 0 = unslewed output: 0 = Input Enabled: 011: 8mA */
			0x00000023   /* 0x3500_49FC: SWDIOTMS: SWDIOTMS: 0 = TTL input: 0 = pull-down disabled: 1 = pull-up enabled: 0 = unslewed output: 0 = Input Enabled: 011: 8mA */
			0x00000003   /* 0x3500_4A00: SYSCLKEN: SYSCLKEN: 0 = TTL input: 0 = pull-down disabled: 0 = pull-up disabled: 0 = unslewed output: 0 = Input Enabled: 011: 8mA */
			0x00000020   /* 0x3500_4A04: TDI: TDI: 0 = TTL input: 0 = pull-down disabled: 1 = pull-up enabled: 0 = unslewed output: 0 = Input Enabled: 000: 2mA */
			0x00000003   /* 0x3500_4A08: TDO: TDO: 0 = TTL input: 0 = pull-down disabled: 0 = pull-up disabled: 0 = unslewed output: 0 = Input Enabled: 011: 8mA */
			0x00000040   /* 0x3500_4A0C: TESTMODE: TESTMODE: 0 = TTL input: 1 = pull-down enabled: 0 = pull-up disabled: 0 = unslewed output: 0 = Input Enabled: 000: 2mA */
			0x00000003   /* 0x3500_4A10: TRACECLK: TRACECLK: 0 = TTL input: 0 = pull-down disabled: 0 = pull-up disabled: 0 = unslewed output: 0 = Input Enabled: 011: full drive */
			0x00000003   /* 0x3500_4A14: TRACEDT00: TRACEDT00: 0 = TTL input: 0 = pull-down disabled: 0 = pull-up disabled: 0 = unslewed output: 0 = Input Enabled: 011: full drive */
			0x00000003   /* 0x3500_4A18: TRACEDT01: TRACEDT01: 0 = TTL input: 0 = pull-down disabled: 0 = pull-up disabled: 0 = unslewed output: 0 = Input Enabled: 011: full drive */
			0x00000003   /* 0x3500_4A1C: TRACEDT02: TRACEDT02: 0 = TTL input: 0 = pull-down disabled: 0 = pull-up disabled: 0 = unslewed output: 0 = Input Enabled: 011: full drive */
			0x00000003   /* 0x3500_4A20: TRACEDT03: TRACEDT03: 0 = TTL input: 0 = pull-down disabled: 0 = pull-up disabled: 0 = unslewed output: 0 = Input Enabled: 011: full drive */
			0x00000000   /* 0x3500_4A24: TRACEDT04: TRACEDT04: 0 = TTL input: 0 = pull-down disabled: 0 = pull-up disabled: 0 = unslewed output: 0 = Input Enabled: 000: 1/4 drive */
			0x00000000   /* 0x3500_4A28: TRACEDT05: TRACEDT05: 0 = TTL input: 0 = pull-down disabled: 0 = pull-up disabled: 0 = unslewed output: 0 = Input Enabled: 000: 1/4 drive */
			0x00000000   /* 0x3500_4A2C: TRACEDT06: TRACEDT06: 0 = TTL input: 0 = pull-down disabled: 0 = pull-up disabled: 0 = unslewed output: 0 = Input Enabled: 000: 1/4 drive */
			0x00000003   /* 0x3500_4A30: TRACEDT07: TRACEDT07: 0 = TTL input: 0 = pull-down disabled: 0 = pull-up disabled: 0 = unslewed output: 0 = Input Enabled: 011: full drive */
			0x00000040   /* 0x3500_4A34: TRSTB: TRSTB: 0 = TTL input: 1 = pull-down enabled: 0 = pull-up disabled: 0 = unslewed output: 0 = Input Enabled: 000: 2mA */
			0x00000012   /* 0x3500_4A38: TXDATA3G0: TXDATA3G0: 0 = TTL input: 0 = pull-down disabled: 0 = pull-up disabled: 1 = slewed output: 0 = Input Enabled: 010: 6mA */
			0x00000320   /* 0x3500_4A3C: UBCTSN: UB3CTSN: 0 = TTL input: 0 = pull-down disabled: 1 = pull-up enabled: 0 = unslewed output: 0 = Input Enabled: 000: 2mA */
			0x00000323   /* 0x3500_4A40: UBRTSN: UB3RTSN: 0 = TTL input: 0 = pull-down disabled: 1 = pull-up enabled: 0 = unslewed output: 0 = Input Enabled: 011: 8mA */
			0x00000000   /* 0x3500_4A44: UBRX: UBRX: 0 = TTL input: 0 = pull-down disabled: 0 = pull-up disabled: 0 = unslewed output: 0 = Input Enabled: 000: 2mA */
			0x00000003   /* 0x3500_4A48: UBTX: UBTX: 0 = TTL input: 0 = pull-down disabled: 0 = pull-up disabled: 0 = unslewed output: 0 = Input Enabled: 011: 8mA */
			0x00000000   /* 0x3500_4A4C: TRACEDT08: TRACEDT08: 0 = TTL input: 0 = pull-down disabled: 0 = pull-up disabled: 0 = unslewed output: 0 = Input Enabled: 000: 1/4 drive */
			0x00000000   /* 0x3500_4A50: TRACEDT09: TRACEDT09: 0 = TTL input: 0 = pull-down disabled: 0 = pull-up disabled: 0 = unslewed output: 0 = Input Enabled: 000: 1/4 drive */
			0x00000000   /* 0x3500_4A54: TRACEDT10: TRACEDT10: 0 = TTL input: 0 = pull-down disabled: 0 = pull-up disabled: 0 = unslewed output: 0 = Input Enabled: 000: 1/4 drive */
			0x00000000   /* 0x3500_4A58: TRACEDT11: TRACEDT11: 0 = TTL input: 0 = pull-down disabled: 0 = pull-up disabled: 0 = unslewed output: 0 = Input Enabled: 000: 1/4 drive */
			0x00000000   /* 0x3500_4A5C: TRACEDT12: TRACEDT12: 0 = TTL input: 0 = pull-down disabled: 0 = pull-up disabled: 0 = unslewed output: 0 = Input Enabled: 000: 1/4 drive */
			0x00000000   /* 0x3500_4A60: TRACEDT13: TRACEDT13: 0 = TTL input: 0 = pull-down disabled: 0 = pull-up disabled: 0 = unslewed output: 0 = Input Enabled: 000: 1/4 drive */
			0x00000000   /* 0x3500_4A64: TRACEDT14: TRACEDT14: 0 = TTL input: 0 = pull-down disabled: 0 = pull-up disabled: 0 = unslewed output: 0 = Input Enabled: 000: 1/4 drive */
			0x00000000   /* 0x3500_4A68: TRACEDT15: TRACEDT15: 0 = TTL input: 0 = pull-down disabled: 0 = pull-up disabled: 0 = unslewed output: 0 = Input Enabled: 000: 1/4 drive */
			
		>;
	};

	/* gpio node must be consistent with pinmux node */
	gpio {
		compatible = "HawaiiA0-gpio";
		reg = <0x35003000 24>;      /* base address and # of exposed GPIOs */
		data = <
			2    0x00000000 /* 0: Drive Low  0: Output */
			3    0x00000000 /* 0: Drive Low  0: Output */
			4    0x00000001 /* 0: Drive Low  1: Input */
			5    0x00000000 /* 0: Drive Low  0: Output */
			11    0x00000000 /* 0: Drive Low  0: Output */
			22    0x00000000 /* 0: Drive Low  0: Output */
			23    0x00000000 /* 0: Drive Low  0: Output */
			25    0x00000000 /* 0: Drive Low  0: Output */
			26    0x00000000 /* 0: Drive Low  0: Output */
			29    0x00000001 /* 0: Drive Low  1: Input */
			32    0x00000000 /* 0: Drive Low  0: Output */
			33    0x00000001 /* 0: Drive Low  1: Input */
			34    0x00000000 /* 0: Drive Low  0: Output */
			70    0x00000000 /* 0: Drive Low  0: Output */
			72    0x00000001 /* 0: Drive Low  1: Input */
			73    0x00000001 /* 0: Drive Low  1: Input */
			74    0x00000001 /* 0: Drive Low  1: Input */
			89    0x00000001 /* 0: Drive Low  1: Input */
			90    0x00000001 /* 0: Drive Low  1: Input */
			91    0x00000001 /* 0: Drive Low  1: Input */
			92    0x00000001 /* 0: Drive Low  1: Input */
			100    0x00000000 /* 0: Drive Low  0: Output */
			111    0x00000000 /* 0: Drive Low  0: Output */
			121    0x00000000 /* 0: Drive Low  0: Output */
		>;
	};
};
