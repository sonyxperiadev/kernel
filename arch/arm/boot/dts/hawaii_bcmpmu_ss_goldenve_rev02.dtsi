/ {
	bcmpmu {
	compatible = "Broadcom,bcmpmu";
	initdata = <
	     /* Add  Val  Mask Map */
		0x14 0x75 0xFF 0
		/*  enable PC3 function */
		0x15 0x0E 0xFF 0
		 /* Selecting 0.87V */
		0xC9 0x30 0xFF 0
		  /* Mask Interrupt */
		0x30 0xFF 0xFF 0
		0x31 0xFF 0xFF 0
		0x32 0xFF 0xFF 0
		0x33 0xFF 0xFF 0
		0x34 0xFF 0xFF 0
		0x35 0xFF 0xFF 0
		0x36 0xFF 0xFF 0
		0x37 0xFF 0xFF 0
		0x38 0xFF 0xFF 0
		0x39 0xFF 0xFF 0
		0x3A 0xFF 0xFF 0
		0x3B 0xFF 0xFF 0
		0x3C 0xFF 0xFF 0
		0x3D 0xFF 0xFF 0
		0x3E 0xFF 0xFF 0
		0x3F 0xFF 0xFF 0
		 /* Trickle charging timer setting */
		0x40 0x38 0x38 0
		 /*  disable software charger timer */
		0x41 0x0 0x04 0
		 /* SWUP */
		0x42 0x04 0x04 0
		 /* Enable BC12_EN */
		0x44 0x01 0x01 0
		  /*  ICCMAX to 1500mA*/
		0x47 0x0B 0xFF 0
		/*fcc boot curr to 0 */
		0x49 0x0 0xFF 0
		  /* NTC Hot Temperature Comparator*/
		0xCC 0x43 0xFF 1
		  /* NTC Hot Temperature Comparator*/
		0xCD 0x7F 0xFF 1
		  /* NTC Cold Temperature Comparator*/
		0xCE 0x3B 0xFF 1
		  /* NTC Cold Temperature Comparator*/
		0xCF 0xF8 0xFF 1
		  /* NTC Hot Temperature Comparator bit 9,8 */
		0xD0 0x09 0xFF 1
		 /* ID detection ,current source Trimming */
		0x47 0xD2 0xFF 1
		0x48 0x98 0xFF 1
		0x49 0xF0 0xFF 1
		 /*ADP_THR_RATIO*/
		0x4A 0x58 0xFF 1
		 /* Enable ADP_PRB  ADP_DSCHG comparators */
		0x4B 0xC3 0xFF 1
		/*FG EOC CURR TH*/
		0xBF 0x64 0xFF 1
		/*RTC_C2C1_XOTRIM*/
		0xEF 0x44 0xFF 1
		/* PWMLEDCTRL1 */
		0x00 0x23 0xFF 1
		/* HSCP3*/
		0x82 0x00 0xFF 1
		 /* HS audio powerdown feedback path */
		 0x7B 0x0C 0xFF 1
		 /* NTC BiasSynchronous Mode,Host Enable Control NTC_PM0 Disable*/
		 0xD5 0x12 0xFF 1
		 0xD6 0x0 0xFF 1
		 0xD7 0x12 0xFF 1
		 0xD8 0x0 0xFF 1
		 /* EN_SESS_VALID  enable ID detection */
		 0x40 0x18 0xFF 1
		 /* MMSR LPM voltage - 0.88V */
		 0xCA 0x04 0x3F 0
		 /* SDSR1 LPM volt 0.9V*/
		 0xCD 0x06 0x3F 0
		 /* SDSR2 LPM voltage - 1.24V */
		 0xD0 0x28 0x3F 0
		 /* IOSR1 LPM voltage - 1.8V */
		 0xC4 0x3E 0x3f 0
		 /* CSR LPM voltage - 1.24V */
		 0xC0 0x28 0x3F 0

		 /* PASRCTRL MobC00256738*/
		 0x08 0x00 0x06 1
		 0x0D 0x00 0xF0 1
		 0x0E 0x00 0x3F 1

		 /* FG */
		 0xA0 0x40 0xFF 1
		 0xA2 0x01 0xFF 1
		 0xA3 0x04 0xFF 1

		 /*otg boost ctrl1-2*/
		 0x4c 0xd4 0xFF 1
		 0x4d 0x1b 0xFF 1

		 /*MBC_CC_BOOST*/
		 0x5c 0x5 0x0F 0

		 /*otgctrl1 disable boost bydefault*/
		 0x40 0x0 0x4 1

		 /* pll */
		 0x1A 0x0 0xFF 0

		 /* enable PASR mode */
		 /* PMU_REG_GPIOCTRL3 */
		 0x16 0x02 0xFF 0
		 /* PMU_REG_PASRCTRL1 */
		 0x08 0x19 0xFF 1
		 /* PMU_REG_PASRCTRL2 */
		 0x09 0x02 0xFF 1

		 /*turn of synthesizer when no PLL request */
		 0x1A 0xfe 0xff 0
		>;
	};
};
