/* Copyright (c) 2013, The Linux Foundation. All rights reserved.
 *
 * This program is free software; you can redistribute it and/or modify
 * it under the terms of the GNU General Public License version 2 and
 * only version 2 as published by the Free Software Foundation.
 *
 * This program is distributed in the hope that it will be useful,
 * but WITHOUT ANY WARRANTY; without even the implied warranty of
 * MERCHANTABILITY or FITNESS FOR A PARTICULAR PURPOSE.  See the
 * GNU General Public License for more details.
 */

/*---------------------------------------------------------------------------
 * This file is autogenerated file using gcdb parser. Please do not edit it.
 * Update input XML file to add a new entry or update variable in this file
 * VERSION = "1.0"
 *---------------------------------------------------------------------------*/
&mdss_mdp {
	dsi_innolux_qhd_vid: qcom,mdss_dsi_innolux_qhd_video {
		qcom,mdss-dsi-panel-name = "innolux QHD video mode dsi panel for speed up";
		qcom,mdss-dsi-panel-controller = <&mdss_dsi0>;
		qcom,mdss-dsi-panel-type = "dsi_video_mode";
		qcom,mdss-dsi-panel-destination = "display_1";
		qcom,mdss-dsi-panel-frame-rate = <60>;
		qcom,mdss-dsi-virtual-channel-id = <0>;
		qcom,mdss-dsi-stream = <0>;
		qcom,mdss-dsi-panel-width = <540>;
		qcom,mdss-dsi-panel-height = <960>;
		qcom,mdss-dsi-h-front-porch = <130>;
		qcom,mdss-dsi-h-back-porch = <30>;
		qcom,mdss-dsi-h-pulse-width = <2>;
		qcom,mdss-dsi-h-sync-skew = <0>;
		qcom,mdss-dsi-v-back-porch = <16>;
		qcom,mdss-dsi-v-front-porch = <56>;
		qcom,mdss-dsi-v-pulse-width = <2>;
		qcom,mdss-dsi-h-left-border = <0>;
		qcom,mdss-dsi-h-right-border = <0>;
		qcom,mdss-dsi-v-top-border = <0>;
		qcom,mdss-dsi-v-bottom-border = <0>;
		qcom,mdss-dsi-bpp = <24>;
		qcom,mdss-dsi-color-order = <0>;
		qcom,mdss-dsi-underflow-color = <0xff>;
		qcom,mdss-dsi-border-color = <0>;
/*panel command format*/
/* 1 byte : data type */
/* 1 byte : last in chain */
/* 1 byte : virtual chan */
/* 1 byte : ask ACK from peripheral */
/* 1 byte : wait time ms */
/* 2 byte : cmd len*/
/* n byte : cmd data*/
		qcom,mdss-dsi-on-command = [

          /*Select CMD2, Page 0*/
					29 01 00 00 00 00 06
						F0 55 AA 52 08 00

          /*Source hold time*/
					29 01 00 00 00 00 02 B6 05            

          /*Gate EQ control*/
					29 01 00 00 00 00 03
						B7 70 70

          /*Source EQ control (Mode 2)*/
					29 01 00 00 00 00 05
					  B8 01 04 04 04

          /*Inversion*/
					29 01 00 00 00 00 02 BC 00

          /*Display Timing: Dual 8-phase 4-overlap*/
					29 01 00 00 00 00 0C
					  C7 00 FF FF 10 10 0A 0B FF FF 93 00

          /*Select CMD2, Page 1*/
					29 01 00 00 00 00 06
					  F0 55 AA 52 08 01

          /*AVDD: 5.5V*/
					29 01 00 00 00 00 02 B0 0A

          /*AVEE: -5.5V*/
					29 01 00 00 00 00 02 B1 0A

          /*VCL: -2.5V*/
					29 01 00 00 00 00 02 B2 00

          /*VGH: 15.0V*/
					29 01 00 00 00 00 02 B3 10

          /*VGLX: -10.0V*/
					29 01 00 00 00 00 02 B4 06

          /*AVDD: 2.5xVDDB*/
					29 01 00 00 00 00 02 B6 44

          /*AVEE: -2.5xVDDB*/
					29 01 00 00 00 00 02 B7 34

          /*VCL: -1.5xVDDB*/
					29 01 00 00 00 00 02 B8 14

          /*VGH: 2xAVDD-AVEE*/
					29 01 00 00 00 00 02 B9 35

          /*VGLX: AVEE-AVDD*/
					29 01 00 00 00 00 02 BA 14

          /*Pump:0x00*/
					29 01 00 00 00 00 02 C2 00

          /*Gamma Gradient Control*/
					29 01 00 00 00 00 05
            D0 0F 0F 10 10

          /*Positive Red Gamma*/
          29 01 00 00 00 00 11
            D1 00 05 00 11 00 23 00 38 00 42 00 62 00 84 00 B7
          29 01 00 00 00 00 11
            D2 00 E2 01 21 01 5E 01 B1 01 FB 01 FC 02 4A 02 A5
          29 01 00 00 00 00 11
            D3 03 11 03 53 03 81 03 A7 03 B7 03 C5 03 CC 03 D8
          29 01 00 00 00 00 05
            D4 03 F6 03 FF

          /*Positive Green Gamma*/
          29 01 00 00 00 00 11
            D5 00 05 00 0F 00 22 00 33 00 43 00 60 00 7B 00 B2
          29 01 00 00 00 00 11
            D6 00 E1 01 29 01 68 01 BF 02 06 02 0A 02 55 02 B5
          29 01 00 00 00 00 11
            D7 03 15 03 4D 03 79 03 A3 03 B1 03 C3 03 CC 03 DC
          29 01 00 00 00 00 05
            D8 03 F1 03 FF


          /*Positive Blue Gamma*/
          29 01 00 00 00 00 11
            D9 00 05 00 0E 00 20 00 32 00 43 00 5F 00 79 00 AA
          29 01 00 00 00 00 11
            DD 00 D4 01 1D 01 59 01 B4 01 EC 01 ED 02 35 02 97
          29 01 00 00 00 00 11
            DE 02 D5 03 2D 03 61 03 9A 03 AB 03 BE 03 C8 03 D5
          29 01 00 00 00 00 05
            DF 03 FB 03 FF

          /*Negative Red Gamma*/
          29 01 00 00 00 00 11
            E0 00 01 00 0C 00 1F 00 32 00 41 00 61 00 80 00 B3
          29 01 00 00 00 00 11
            E1 00 DF 01 21 01 5B 01 AF 01 FB 01 FC 02 4A 02 A8
          29 01 00 00 00 00 11
            E2 02 EF 03 52 03 81 03 A6 03 B7 03 C4 03 CB 03 D8
          29 01 00 00 00 00 05
            E3 03 F6 03 FF

          /*Negative Green Gamma*/
          29 01 00 00 00 00 11
            E4 00 01 00 0A 00 1D 00 2E 00 3F 00 5C 00 77 00 AE
          29 01 00 00 00 00 11
            E5 00 DF 01 28 01 69 01 BF 02 04 02 07 02 53 02 B3
          29 01 00 00 00 00 11
            E6 03 13 03 4C 03 79 03 A3 03 B0 03 C3 03 CC 03 DC
          29 01 00 00 00 00 05
            E7 03 F1 03 FE

          /*Negative Blue Gamma*/
          29 01 00 00 00 00 11
            E8 00 01 00 0A 00 1B 00 2D 00 3E 00 5B 00 75 00 A6
          29 01 00 00 00 00 11
            E9 00 D1 01 1A 01 57 01 B2 01 E9 01 EB 02 35 02 95
          29 01 00 00 00 00 11
            EA 02 D3 03 2B 03 61 03 9A 03 AB 03 BE 03 C8 03 D5
          29 01 00 00 00 00 05
            EB 03 FB 03 FF

          /*Select CMD2, Page 0*/
					29 01 00 00 00 00 06
						F0 55 AA 52 08 00

          /*Source hold time*/
					29 01 00 00 00 00 02 B3 00  

					05 01 00 00 7D 00 02 11 00 /* exit sleep */
					05 01 00 00 64 00 02 29 00 /* display on */
					15 01 00 00 01 00 02 53 2c /* backlight on */
					15 01 00 00 01 00 02 51 50 /* brightness max */
          ];
		qcom,mdss-dsi-off-command = [
          05 01 00 00 96 00 02 28 00 /* display off */
					05 01 00 00 96 00 02 10 00 /* enter sleep */];
		qcom,mdss-dsi-on-command-state = "dsi_lp_mode";
		qcom,mdss-dsi-off-command-state = "dsi_hs_mode";
		qcom,mdss-dsi-h-sync-pulse = <1>;

		qcom,mdss-dsi-hfp-power-mode;

		qcom,mdss-dsi-traffic-mode = "burst_mode";
		qcom,mdss-dsi-lane-map = <0>;
		qcom,mdss-dsi-bllp-eof-power-mode;
		qcom,mdss-dsi-bllp-power-mode;
		qcom,mdss-dsi-lane-0-state;
		qcom,mdss-dsi-lane-1-state;
		qcom,mdss-dsi-panel-timings = [7d 25 1d 00 37 33 22 27 1e 03 04 00];
		qcom,mdss-dsi-t-clk-post = <0x20>;
		qcom,mdss-dsi-t-clk-pre = <0x2c>;
		qcom,mdss-dsi-bl-min-level = <1>;
		qcom,mdss-dsi-bl-max-level = <255>;
		qcom,mdss-dsi-dma-trigger = "trigger_sw";
		qcom,mdss-dsi-mdp-trigger = "none";
		qcom,mdss-dsi-bl-pmic-control-type = "bl_ctrl_dcs";

		qcom,mdss-dsi-reset-sequence = <1 1>, <0 1>, <1 20>;
		qcom,mdss-pan-physical-width-dimension = <59>;
		qcom,mdss-pan-physical-height-dimension = <104>;

		qcom,platform-reset-gpio = <&msmgpio 25 0>;
		somc,dric-gpio = <&msmgpio 23 0>;
		somc,driver-ic = <0>;
		somc,panel-id = [FF];
	};

	dsi_truly_qhd_vid: qcom,mdss_dsi_truly_qhd_video {
		qcom,mdss-dsi-panel-name = "truly QHD video mode dsi panel,speed up, 0423-V2-Gamma ,0318 power saving";
		qcom,mdss-dsi-panel-controller = <&mdss_dsi0>;
		qcom,mdss-dsi-panel-type = "dsi_video_mode";
		qcom,mdss-dsi-panel-destination = "display_1";
		qcom,mdss-dsi-panel-framerate = <60>;
		qcom,mdss-dsi-virtual-channel-id = <0>;
		qcom,mdss-dsi-stream = <0>;
		qcom,mdss-dsi-panel-width = <540>;
		qcom,mdss-dsi-panel-height = <960>;
		qcom,mdss-dsi-h-front-porch = <130>;
		qcom,mdss-dsi-h-back-porch = <30>;
		qcom,mdss-dsi-h-pulse-width = <2>;
		qcom,mdss-dsi-h-sync-skew = <0>;
		qcom,mdss-dsi-v-back-porch = <16>;
		qcom,mdss-dsi-v-front-porch = <56>;
		qcom,mdss-dsi-v-pulse-width = <2>;
		qcom,mdss-dsi-h-left-border = <0>;
		qcom,mdss-dsi-h-right-border = <0>;
		qcom,mdss-dsi-v-top-border = <0>;
		qcom,mdss-dsi-v-bottom-border = <0>;
		qcom,mdss-dsi-bpp = <24>;
		qcom,mdss-dsi-color-order = <0>;
		qcom,mdss-dsi-underflow-color = <0xff>;
		qcom,mdss-dsi-border-color = <0>;
/*panel command format*/
/* 1 byte : data type */
/* 1 byte : last in chain */
/* 1 byte : virtual chan */
/* 1 byte : ask ACK from peripheral */
/* 1 byte : wait time ms */
/* 2 byte : cmd len*/
/* n byte : cmd data*/
		qcom,mdss-dsi-on-command = [

          ///OTM9605A+4.81"HSD
					29 01 00 00 00 00 02
						00 00

					29 01 00 00 00 00 04        
						FF 96 05 01

					29 01 00 00 00 00 02
						00 80
												
					29 01 00 00 00 00 03
						FF 96 05

					29 01 00 00 00 00 02
					  00 90
					
//Update on 20140318 for power saving
					29 01 00 00 00 00 08
						C5 96 86 06 33 33 33 31

          // VGH/VGL pumping ratio 
					29 01 00 00 00 00 02
					  00 92

					29 01 00 00 00 00 02
					  C5 06

					29 01 00 00 00 00 02
					  00 00

					//GVDD & NGVDD=5.3V
					29 01 00 00 00 00 03
					  D8 AF AF

					//VRGH Disable
					29 01 00 00 00 00 02 
						00 B2

					29 01 00 00 00 00 05 
						F5 15 00 15 00

					//VRGH minimum
					29 01 00 00 00 00 02 
						00 93

					29 01 00 00 00 00 02 
						C5 03

          //GVDD, GVEE, Vcom...PAD output
					29 01 00 00 00 00 02 
						00 B1
						
          //28 disable output 29 enable
					29 01 00 00 00 00 02 
						C5 28

					//--------------------Panel Setting-------------------//
          
					29 01 00 00 00 00 02 
						00 B4

          //address C0B4h 00h=>1 dot inversion 10h=>2 dot inversion 50h=>column inversion
					29 01 00 00 00 00 02 
						C0 50

					29 01 00 00 00 00 02 
            00 C5

          //MIPI read contention
					29 01 00 00 00 00 02
            B0 03

					29 01 00 00 00 00 02 
						00 C0

          //temperature sensor disable
					29 01 00 00 00 00 08 
						C5 00 00 00 00 00 00 00

					29 01 00 00 00 00 02
            00 80

          //Frame rate
					29 01 00 00 00 00 03
            C1 36 66
            
          /*Gamma Gradient Control*/
					29 01 00 00 00 00 02
            00 89           
          
          //TCON OSC turbo mode
					29 01 00 00 00 00 02
            C0 01

					29 01 00 00 00 00 02
            00 80

					//Source Driver Precharge Control            
					29 01 00 00 00 00 02
            C4 9C

          29 01 00 00 00 00 02
            00 C7

      		// gate pre-charge
          29 01 00 00 00 00 04
            CF 80 00 02

					29 01 00 00 00 00 02
						00 A0                        			

					//Osc time out
					29 01 00 00 00 00 02
						C1 00                      			

					29 01 00 00 00 00 02
						00 C0
						
					//60 Frames
					29 01 00 00 00 00 02
						CF 3D

					29 01 00 00 00 00 02
						00 C7
						
//Update on 20140318 for Power saving
					29 01 00 00 00 00 04
						CF 80 00 05

					29 01 00 00 00 00 02
						00 C0
						
					29 01 00 00 00 00 02
						C5 00

					29 01 00 00 00 00 02
						00 83
						
					29 01 00 00 00 00 02
						B2 80

					29 01 00 00 00 00 02
						00 B5

					////reverse scan 48						
					29 01 00 00 00 00 02
						C0 18

//--------------Digital 3 Gamma---------------------------
					29 01 00 00 00 00 02
						00 00
					29 01 00 00 00 00 02
						00 00

					29 01 00 00 00 00 02
						00 00
					29 01 00 00 00 00 22
            EC 40 56 33 44 44 44 44 44 44 44 44 44 44 44 44 44 44 44 44 44 44 44 44 44 44 44 44 44 24 41 44 24 02

					29 01 00 00 00 00 02
						00 00
					29 01 00 00 00 00 22
            ED 40 44 44 44 44 44 44 44 44 44 44 44 44 44 44 44 44 44 44 44 44 44 44 44 44 44 44 44 44 44 44 24 02
            
					29 01 00 00 00 00 02
						00 00
					29 01 00 00 00 00 22
            EE 61 88 56 44 44 44 44 44 44 44 44 44 44 44 44 44 44 44 44 44 44 44 44 44 44 44 44 33 13 41 44 44 04
            
//---------Gamma meet main source -----------																		
					//===========================================================
					29 01 00 00 00 00 02
						00 00
					29 01 00 00 00 00 11
						E1 00 0c 11 0E 07 0e 08 05 0C 0e 0a 00 06 0e 06 00

					29 01 00 00 00 00 02
						00 00
					29 01 00 00 00 00 11
						E2 00 0c 11 0E 07 0e 08 05 0C 0e 0a 00 06 0e 06 00
					//===========================================================
					
					29 01 00 00 00 00 02
						00 80
					29 01 00 00 00 00 0D
						CE 8B 03 28 8A 03 28 89 03 28 88 03 28
					
					29 01 00 00 00 00 02
						00 90
					29 01 00 00 00 00 0F
						CE F0 00 00 F0 00 00 F0 00 00 F0 00 00 00 00
					
					29 01 00 00 00 00 02
						00 A0
					29 01 00 00 00 00 0F
						CE 38 07 03 C0 00 18 00 38 06 03 C1 00 18 00
					
					29 01 00 00 00 00 02
						00 B0
					29 01 00 00 00 00 0F
						CE 38 05 03 C2 00 18 00 38 04 03 C3 00 18 00
					
					29 01 00 00 00 00 02
						00 C0
					29 01 00 00 00 00 0F	
						CE 38 03 03 C4 00 18 00 38 02 03 C5 00 18 00
							
					29 01 00 00 00 00 02
						00 D0
					29 01 00 00 00 00 0F
						CE 38 01 03 C6 00 18 00 38 00 03 C7 00 18 00
					
					29 01 00 00 00 00 02
						00 C0
					29 01 00 00 00 00 10
						CB 04 04 04 04 00 04 00 04 00 04 00 04 04 04 00
					
					29 01 00 00 00 00 02
						00 D0
					29 01 00 00 00 00 10
						CB 00 00 00 00 00 04 04 04 04 00 04 00 04 00 04
					
					29 01 00 00 00 00 02
						00 E0
					29 01 00 00 00 00 0B
						CB 00 04 04 04 00 00 00 00 00 00
					
					29 01 00 00 00 00 02
						00 F0
					29 01 00 00 00 00 0B
						CB 00 CC CC 00 00 00 CC CC 0F 00
					
					29 01 00 00 00 00 02
						00 80
					29 01 00 00 00 00 0B
						CC 26 25 21 22 00 0C 00 0A 00 10
					
					29 01 00 00 00 00 02
						00 90
					29 01 00 00 00 00 10
						CC 00 0E 02 04 00 00 00 00 00 00 26 25 21 22 00
					
					29 01 00 00 00 00 02
						00 A0
					29 01 00 00 00 00 10
						CC 0B 00 09 00 0F 00 0D 01 03 00 00 00 00 00 00
					
					29 01 00 00 00 00 02
						00 B0
					29 01 00 00 00 00 0B
						CC 25 26 21 22 00 0D 00 0F 00 09
					
					29 01 00 00 00 00 02
						00 C0
					29 01 00 00 00 00 10
						CC 00 0B 03 01 00 00 00 00 00 00 25 26 21 22 00
					
					29 01 00 00 00 00 02
						00 D0
					29 01 00 00 00 00 10
						CC 0E 00 10 00 0A 00 0C 04 02 00 00 00 00 00 00
					
					29 01 00 00 00 00 02
						00 00
					29 01 00 00 00 00 04
						FF FF FF FF	//Command 2 Disable
																								
					05 01 00 00 78 00 02 11 00 /* exit sleep */
					05 01 00 00 0A 00 02 29 00 /* display on */
					15 01 00 00 0a 00 02 53 2c /* backlight on */
					15 01 00 00 0a 00 02 51 50 /* brightness max */

          ];
		qcom,mdss-dsi-off-command = [
					05 01 00 00 96 00 02 28 00 /* display off */
					05 01 00 00 96 00 02 10 00 /* enter sleep */];
		qcom,mdss-dsi-on-command-state = "dsi_lp_mode";
		qcom,mdss-dsi-off-command-state = "dsi_hs_mode";
		qcom,mdss-dsi-h-sync-pulse = <1>;
		qcom,mdss-dsi-traffic-mode = "burst_mode";
		qcom,mdss-dsi-lane-map = <0>;
		qcom,mdss-dsi-hfp-power-mode;
		qcom,mdss-dsi-bllp-eof-power-mode;
		qcom,mdss-dsi-bllp-power-mode;
		qcom,mdss-dsi-lane-0-state;
		qcom,mdss-dsi-lane-1-state;
		qcom,mdss-dsi-panel-timings = [7d 25 1d 00 37 33 22 27 1e 03 04 00];
		qcom,mdss-dsi-t-clk-post = <0x20>;
		qcom,mdss-dsi-t-clk-pre = <0x2c>;
		qcom,mdss-dsi-bl-min-level = <1>;
		qcom,mdss-dsi-bl-max-level = <255>;
		qcom,mdss-dsi-dma-trigger = "trigger_sw";
		qcom,mdss-dsi-mdp-trigger = "none";
		qcom,mdss-dsi-bl-pmic-control-type = "bl_ctrl_dcs";
		qcom,mdss-dsi-reset-sequence = <1 1>, <0 1>, <1 6>;
		qcom,mdss-pan-physical-width-dimension = <59>;
		qcom,mdss-pan-physical-height-dimension = <104>;
		qcom,mdss-dsi-lp11-init;
		qcom,mdss-dsi-init-delay-us = <1>;

		qcom,platform-reset-gpio = <&msmgpio 25 0>;
		somc,dric-gpio = <&msmgpio 23 0>;
		somc,driver-ic = <1>;
		somc,panel-id = [FF];
	};
};

