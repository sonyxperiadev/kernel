/* arch/arm/boot/dts/msm8974pro-ac-shinano_leo.dts
 *
 * Copyright (c) 2013-2014, The Linux Foundation. All rights reserved.
 * Copyright (C) 2014 Sony Mobile Communications AB.
 *
 * Author: Kouhei Fujiya <Kouhei.X.Fujiya@sonymobile.com>
 *
 * This program is free software; you can redistribute it and/or modify
 * it under the terms of the GNU General Public License version 2 and
 * only version 2 as published by the Free Software Foundation.
 *
 * This program is distributed in the hope that it will be useful,
 * but WITHOUT ANY WARRANTY; without even the implied warranty of
 * MERCHANTABILITY or FITNESS FOR A PARTICULAR PURPOSE.  See the
 * GNU General Public License for more details.
 */

/dts-v1/;

/include/ "msm8974pro-ac-pm8941.dtsi"
/include/ "msm8974-mtp.dtsi"
/include/ "msm8974pro-ac-shinano_common.dtsi"
/include/ "msm8974pro-ac-shinano_leo_common.dtsi"
/include/ "msm8974pro-ac-shinano_leo.dtsi"
/include/ "dsi-panel-leo.dtsi"

/ {
	model = "SoMC Leo ROW";
	compatible = "somc,leo-row", "qcom,msm8974";
	qcom,board-id = <8 0>;
	qcom,msm-id = <194 0x10000>,
		      <209 0x10000>,
		      <210 0x10000>,
		      <212 0x10000>,
		      <213 0x10000>,
		      <215 0x10000>,
		      <216 0x10000>,
		      <218 0x10000>;
	somc,space-no = "1280-4852",	/* Gina */
			"1280-4876",	/* Rita */
			"1280-4918",	/* Gina-APAC */
			"1282-0073";	/* Katyusha */
};
