/* Copyright (c) 2014, The Linux Foundation. All rights reserved.
 *
 * This program is free software; you can redistribute it and/or modify
 * it under the terms of the GNU General Public License version 2 and
 * only version 2 as published by the Free Software Foundation.
 *
 * This program is distributed in the hope that it will be useful,
 * but WITHOUT ANY WARRANTY; without even the implied warranty of
 * MERCHANTABILITY or FITNESS FOR A PARTICULAR PURPOSE.  See the
 * GNU General Public License for more details.
 */
/*
 * Copyright (C) 2014 Sony Mobile Communications Inc.
 *
 * This program is free software; you can redistribute it and/or modify
 * it under the terms of the GNU General Public License version 2, as
 * published by the Free Software Foundation.
 */


/dts-v1/;

#include "apq8094-v1.dtsi"
#include "msm8994-mtp.dtsi"
#include "msm8994-kitakami_common.dtsi"
#include "msm8994-kitakami_r1_common.dtsi"
#include "msm8994-kitakami_karin_common.dtsi"
#include "apq8094-kitakami_karin_windy.dtsi"
#include "dsi-panel-karin.dtsi"

/ {
	model = "SoMC Karin-WINDY";
	compatible = "somc,karin-windy", "qcom,apq8094";
	qcom,board-id = <8 0>, <0x10008 0>;
};
