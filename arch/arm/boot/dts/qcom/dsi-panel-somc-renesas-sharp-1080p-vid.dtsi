/* Copyright (c) 2013-2015, The Linux Foundation. All rights reserved.
 *
 * This program is free software; you can redistribute it and/or modify
 * it under the terms of the GNU General Public License version 2 and
 * only version 2 as published by the Free Software Foundation.
 *
 * This program is distributed in the hope that it will be useful,
 * but WITHOUT ANY WARRANTY; without even the implied warranty of
 * MERCHANTABILITY or FITNESS FOR A PARTICULAR PURPOSE.  See the
 * GNU General Public License for more details.
 */
/*
 * Copyright (C) 2015 Sony Mobile Communications Inc.
 *
 * This program is free software; you can redistribute it and/or modify
 * it under the terms of the GNU General Public License version 2, as
 * published by the Free Software Foundation.
 */

&mdss_mdp {
	dsi_renesas_sharp_1080_vid: somc,renesas_sharp_1080p_panel {
		qcom,mdss-dsi-panel-name = "sharp renesas 1080p video";
		qcom,mdss-dsi-panel-controller = <&mdss_dsi0>;
		qcom,mdss-dsi-panel-destination = "display_1";
		qcom,mdss-dsi-panel-type = "dsi_video_mode";
		qcom,mdss-dsi-panel-width = <1080>;
		qcom,mdss-dsi-panel-height = <1920>;
		qcom,mdss-dsi-bpp = <24>;
		qcom,mdss-dsi-h-back-porch = <76>;
		qcom,mdss-dsi-h-pulse-width = <4>;
		qcom,mdss-dsi-h-front-porch = <128>;
		qcom,mdss-dsi-v-back-porch = <3>;
		qcom,mdss-dsi-v-pulse-width = <2>;
		qcom,mdss-dsi-v-front-porch = <4>;
		qcom,mdss-pan-physical-width-dimension = <64>;
		qcom,mdss-pan-physical-height-dimension = <114>;
		qcom,mdss-dsi-panel-framerate = <60>;
		qcom,mdss-dsi-virtual-channel-id = <0>;
		qcom,mdss-dsi-stream = <0>;
		qcom,mdss-dsi-h-sync-skew = <0>;
		qcom,mdss-dsi-h-left-border = <0>;
		qcom,mdss-dsi-h-right-border = <0>;
		qcom,mdss-dsi-v-top-border = <0>;
		qcom,mdss-dsi-v-bottom-border = <0>;
		qcom,mdss-dsi-underflow-color = <0x0>;
		qcom,mdss-dsi-border-color = <0>;
		qcom,mdss-dsi-h-sync-pulse = <1>;
		qcom,mdss-dsi-traffic-mode = "non_burst_sync_event";
		qcom,mdss-dsi-bllp-eof-power-mode;
		qcom,mdss-dsi-bllp-power-mode;
		qcom,mdss-dsi-dma-trigger = "trigger_sw";
		qcom,mdss-dsi-mdp-trigger = "none";
		somc,mdss-dsi-init-command = [23 01 00 00 00 00 02 B0 04
				23 01 00 00 00 00 02 00 00
				23 01 00 00 00 00 02 00 00
				23 01 00 00 00 00 02 D6 01
				29 01 00 00 00 00 03 C0 0F 0F
				29 01 00 00 00 00 03 EC 00 10
				29 01 00 00 00 00 19 C7
					05 19 22 2B 38 51 41 50 5C 64 6B 74
					0F 23 2B 32 3F 52 44 55 61 69 70 77
				29 01 00 00 00 00 19 C8
					03 18 21 2B 38 51 42 4F 5D 65 6C 74
					0D 22 2A 32 3E 52 41 54 5D 66 6D 77
				29 01 00 00 00 00 19 C9
					00 15 1E 28 36 50 42 50 5E 66 6D 74
					0A 1F 27 2F 3D 51 41 55 5E 67 6E 77
				05 01 00 00 00 00 01 11];
		qcom,mdss-dsi-on-command = [05 01 00 00 00 00 01 29];
		qcom,mdss-dsi-off-command = [05 01 00 00 14 00 01 28
				05 01 00 00 6E 00 01 10];
		qcom,mdss-dsi-on-command-state = "dsi_lp_mode";
		qcom,mdss-dsi-off-command-state = "dsi_hs_mode";

		qcom,mdss-dsi-lane-0-state;
		qcom,mdss-dsi-lane-1-state;
		qcom,mdss-dsi-lane-2-state;
		qcom,mdss-dsi-lane-3-state;
		qcom,mdss-dsi-panel-timings = [E6 38 26 00 68 6C 2A 3A 2C 03 04 00];
		qcom,mdss-dsi-lp11-init;
		qcom,mdss-dsi-t-clk-post = <0x02>;
		qcom,mdss-dsi-t-clk-pre = <0x2B>;
		qcom,mdss-dsi-bl-min-level = <1>;
		qcom,mdss-dsi-bl-max-level = <255>;
		qcom,mdss-brightness-max-level = <255>;
		qcom,mdss-dsi-bl-pmic-control-type = "bl_ctrl_wled";

		somc,mdss-dsi-disp-on-in-hs = <1>;
		somc,mdss-dsi-wait-time-before-on-cmd = <150>;
		somc,mdss-dsi-lane-config = [00 c2 ef 00 00 00 00 01 75
				00 c2 ef 00 00 00 00 01 75
				00 c2 ef 00 00 00 00 01 75
				00 c2 ef 00 00 00 00 01 75
				00 02 45 00 00 00 00 01 97];
		somc,disp-en-on-pre = <25>;
		somc,pw-on-rst-seq = <0 60>, <1 10>;
		somc,disp-en-off-post = <50>;
		somc,pw-off-rst-b-seq = <0 10>;
		somc,lcd-id = <1>;
		somc,lcd-id-adc = <0 57000>;

		somc,mdss-dsi-pre-uv-command = [23 01 00 00 00 00 02 B0 04];
		somc,mdss-dsi-uv-command = [06 01 00 00 00 00 01 DA
			06 01 00 00 00 00 01 DB];
		somc,mdss-dsi-uv-param-type = <4>;
		somc,mdss-dsi-pcc-table-size = <73>;
		somc,mdss-dsi-pcc-table = <
			0x00 0x01 0x10 0x13 0x28 0x2B 0x8000 0x7400 0x8000
			0x00 0x02 0x14 0x17 0x28 0x2B 0x7a80 0x7400 0x7e00
			0x00 0x03 0x18 0x1B 0x28 0x2B 0x7480 0x7380 0x8000
			0x00 0x04 0x1C 0x1F 0x28 0x2B 0x7280 0x7380 0x8000
			0x00 0x05 0x20 0x23 0x28 0x2B 0x6e00 0x7400 0x8000
			0x00 0x06 0x0C 0x0F 0x24 0x27 0x7f80 0x7200 0x7c00
			0x00 0x07 0x10 0x13 0x24 0x27 0x8000 0x7400 0x7d80
			0x00 0x08 0x14 0x17 0x24 0x27 0x7d00 0x7700 0x7e00
			0x00 0x09 0x18 0x1B 0x24 0x27 0x7700 0x7600 0x8000
			0x00 0x0A 0x1C 0x1F 0x24 0x27 0x7380 0x7500 0x7c00
			0x00 0x0B 0x20 0x23 0x24 0x27 0x6f00 0x7500 0x7e80
			0x00 0x0C 0x0C 0x0F 0x20 0x23 0x7f80 0x7200 0x7900
			0x00 0x0D 0x10 0x13 0x20 0x23 0x8000 0x7400 0x7b00
			0x00 0x0E 0x14 0x17 0x20 0x23 0x7a80 0x7400 0x7b00
			0x00 0x0F 0x18 0x1B 0x20 0x23 0x7800 0x7700 0x7e80
			0x00 0x10 0x1C 0x1F 0x20 0x23 0x7780 0x7900 0x7f80
			0x00 0x11 0x20 0x23 0x20 0x23 0x7300 0x7900 0x7f00
			0x00 0x12 0x24 0x27 0x20 0x23 0x7100 0x7980 0x8000
			0x00 0x13 0x0C 0x0F 0x1C 0x1F 0x7f80 0x7200 0x7700
			0x00 0x14 0x10 0x13 0x1C 0x1F 0x7c00 0x7000 0x7580
			0x00 0x15 0x14 0x17 0x1C 0x1F 0x7f80 0x7900 0x7e00
			0x00 0x16 0x18 0x1B 0x1C 0x1F 0x7c00 0x7a00 0x7d80
			0x00 0x17 0x1C 0x1F 0x1C 0x1F 0x7900 0x7a00 0x7e00
			0x00 0x18 0x20 0x23 0x1C 0x1F 0x7600 0x7c80 0x8000
			0x00 0x19 0x24 0x27 0x1C 0x1F 0x7300 0x7c00 0x7e80
			0x00 0x1A 0x0C 0x0F 0x18 0x1B 0x8000 0x7200 0x7300
			0x00 0x1B 0x10 0x13 0x18 0x1B 0x7e80 0x7200 0x7500
			0x00 0x1C 0x14 0x17 0x18 0x1B 0x7f00 0x7900 0x7b80
			0x00 0x1D 0x18 0x1B 0x18 0x1B 0x7f00 0x7d00 0x7e00
			0x00 0x1E 0x1C 0x1F 0x18 0x1B 0x7d00 0x7d80 0x8000
			0x00 0x1F 0x20 0x23 0x18 0x1B 0x7900 0x7f00 0x8000
			0x00 0x20 0x24 0x27 0x18 0x1B 0x7780 0x8000 0x8000
			0x00 0x21 0x10 0x13 0x14 0x17 0x7f80 0x7380 0x7200
			0x00 0x22 0x14 0x17 0x14 0x17 0x7f00 0x7900 0x7900
			0x00 0x23 0x18 0x1B 0x14 0x17 0x7f00 0x7d00 0x7b80
			0xFF 0x00 0x1C 0x1F 0x14 0x17 0x8000 0x8000 0x8000
			0x00 0x24 0x20 0x23 0x14 0x17 0x7a00 0x8000 0x7e80
			0x00 0x25 0x24 0x27 0x14 0x17 0x7780 0x8000 0x7d80
			0x00 0x26 0x10 0x13 0x10 0x13 0x8000 0x7400 0x7000
			0x00 0x27 0x14 0x17 0x10 0x13 0x7f80 0x7900 0x7680
			0x00 0x28 0x18 0x1B 0x10 0x13 0x8000 0x7d80 0x7980
			0x00 0x29 0x1C 0x1F 0x10 0x13 0x8000 0x8000 0x7c00
			0x00 0x2A 0x20 0x23 0x10 0x13 0x7a00 0x8000 0x7c00
			0x00 0x2B 0x10 0x13 0x0C 0x0F 0x7f80 0x7480 0x6f00
			0x00 0x2C 0x14 0x17 0x0C 0x0F 0x7f80 0x7900 0x7400
			0x00 0x2D 0x18 0x1B 0x0C 0x0F 0x7f80 0x7d80 0x7680
			0x00 0x2E 0x1C 0x1F 0x0C 0x0F 0x8000 0x8000 0x7980
			0x01 0x00 0x00 0x09 0x32 0x3B 0x8000 0x6D00 0x8000
			0x02 0x00 0x0A 0x13 0x32 0x3B 0x7A00 0x7100 0x8000
			0x03 0x00 0x14 0x1D 0x32 0x3B 0x7400 0x7180 0x8000
			0x04 0x00 0x1E 0x27 0x32 0x3B 0x7100 0x7200 0x8000
			0x05 0x00 0x28 0x31 0x32 0x3B 0x6C80 0x7180 0x8000
			0x06 0x00 0x32 0x3B 0x32 0x3B 0x6680 0x7300 0x8000
			0x07 0x00 0x00 0x09 0x28 0x31 0x8000 0x6B80 0x7080
			0x08 0x00 0x0A 0x13 0x28 0x31 0x8000 0x7400 0x8000
			0x09 0x00 0x14 0x1D 0x28 0x31 0x7A00 0x7700 0x8000
			0x0A 0x00 0x1E 0x27 0x28 0x31 0x7600 0x7780 0x8000
			0x0B 0x00 0x28 0x31 0x28 0x31 0x6F80 0x7980 0x8000
			0x0C 0x00 0x32 0x3B 0x28 0x31 0x7080 0x7E80 0x8000
			0x0D 0x00 0x00 0x09 0x14 0x27 0x8000 0x6B00 0x6D00
			0x0E 0x00 0x0A 0x13 0x14 0x27 0x8000 0x7380 0x7480
			0xFF 0x00 0x14 0x27 0x14 0x27 0x8000 0x8000 0x8000
			0x10 0x00 0x28 0x31 0x14 0x27 0x7500 0x8000 0x7E80
			0x11 0x00 0x32 0x3B 0x14 0x27 0x7100 0x8000 0x7C80
			0x12 0x00 0x00 0x09 0x00 0x09 0x8000 0x6900 0x6500
			0x13 0x00 0x00 0x13 0x0A 0x13 0x8000 0x7300 0x6F00
			0x13 0x00 0x0A 0x13 0x00 0x09 0x8000 0x7300 0x6F00
			0x14 0x00 0x14 0x27 0x0A 0x13 0x7F00 0x8000 0x7900
			0x15 0x00 0x14 0x27 0x00 0x09 0x7E80 0x8000 0x7680
			0x16 0x00 0x28 0x31 0x0A 0x13 0x7380 0x8000 0x7600
			0x17 0x00 0x32 0x3B 0x0A 0x13 0x7080 0x8000 0x7900
			0x18 0x00 0x28 0x31 0x00 0x09 0x7A00 0x8000 0x7580
			0x19 0x00 0x32 0x3B 0x00 0x09 0x6F00 0x8000 0x7200>;
		somc,mdss-phy-size-mm = <64 114>;
	};
};
