/* Copyright (c) 2016, The Linux Foundation. All rights reserved.
 *
 * This program is free software; you can redistribute it and/or modify
 * it under the terms of the GNU General Public License version 2 and
 * only version 2 as published by the Free Software Foundation.
 *
 * This program is distributed in the hope that it will be useful,
 * but WITHOUT ANY WARRANTY; without even the implied warranty of
 * MERCHANTABILITY or FITNESS FOR A PARTICULAR PURPOSE.  See the
 * GNU General Public License for more details.
 */
/*
 * Copyright (C) 2016 Sony Mobile Communications Inc.
 *
 * This program is free software; you can redistribute it and/or modify
 * it under the terms of the GNU General Public License version 2, as
 * published by the Free Software Foundation.
 */


/dts-v1/;

#include "msm8998-v2.1.dtsi"
#include "msm8998-mtp.dtsi"
#include "msm8998-yoshino-maple_dsds.dtsi"

/ {
	model = "SoMC Maple-DSDS(MSM8998 v2.1)";
	compatible = "somc,maple-dsds", "qcom,msm8998";
	qcom,board-id = <8 0>;
};
