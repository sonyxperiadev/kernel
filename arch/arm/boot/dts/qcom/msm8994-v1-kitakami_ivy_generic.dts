/* Copyright (c) 2014, The Linux Foundation. All rights reserved.
 *
 * This program is free software; you can redistribute it and/or modify
 * it under the terms of the GNU General Public License version 2 and
 * only version 2 as published by the Free Software Foundation.
 *
 * This program is distributed in the hope that it will be useful,
 * but WITHOUT ANY WARRANTY; without even the implied warranty of
 * MERCHANTABILITY or FITNESS FOR A PARTICULAR PURPOSE.  See the
 * GNU General Public License for more details.
 */
/*
 * Copyright (C) 2014 Sony Mobile Communications Inc.
 *
 * This program is free software; you can redistribute it and/or modify
 * it under the terms of the GNU General Public License version 2, as
 * published by the Free Software Foundation.
 */


/dts-v1/;

#include "msm8994-v1.dtsi"
#include "msm8994-pinctrl.dtsi"
#include "msm8994-mtp.dtsi"
#include "msm8994-kitakami_common.dtsi"
#include "msm8994-kitakami_r1_common.dtsi"
#include "msm8994-kitakami_ivy_common.dtsi"
#include "msm8994-kitakami_ivy_generic.dtsi"
#include "dsi-panel-ivy.dtsi"

/ {
	model = "SoMC Ivy-ROW";
	compatible = "somc,ivy-row", "qcom,msm8994";
	qcom,msm-id = <207 0x0>, <207 0x10000>;
	qcom,board-id = <8 0>, <0x10008 0>;
};
