/*
 * This program is free software; you can redistribute it and/or modify
 * it under the terms of the GNU General Public License version 2 and
 * only version 2 as published by the Free Software Foundation.
 *
 * This program is distributed in the hope that it will be useful,
 * but WITHOUT ANY WARRANTY; without even the implied warranty of
 * MERCHANTABILITY or FITNESS FOR A PARTICULAR PURPOSE.  See the
 * GNU General Public License for more details.
 */
/*
 * Copyright (C) 2016 Sony Mobile Communications Inc.
 *
 * This program is free software; you can redistribute it and/or modify
 * it under the terms of the GNU General Public License version 2, as
 * published by the Free Software Foundation.
 */

synaptics_clearpad@2c {
/* Write area------------------------------------------ */

	somc,clearpad-f01-rmi-cmd00		= <0x00>;
	somc,clearpad-f01-rmi-ctrl00		= <0x00>;
	somc,clearpad-f01-rmi-ctrl01		= <0x01>;
	somc,clearpad-f01-rmi-data00		= <0x00>;
	somc,clearpad-f01-rmi-data01		= <0x01>;
	somc,clearpad-f01-rmi-query11		= <0x0B>;

	somc,clearpad-f34-flash-ctrl00		= <0x00>;
	somc,clearpad-f34-flash-data00		= <0x00>;
	somc,clearpad-f34-flash-data01		= <0x01>;
	somc,clearpad-f34-flash-data02		= <0x02>;
	somc,clearpad-f34-flash-data03		= <0x03>;
	somc,clearpad-f34-flash-data04		= <0x04>;
	somc,clearpad-f34-flash-data05		= <0x05>;
	somc,clearpad-f34-flash-query00		= <0x00>;
	somc,clearpad-f34-flash-query01		= <0x01>;
	somc,clearpad-f34-flash-query03		= <0x03>;

/* Write area------------------------------------------ */
};

#include "clearpad-ic-s332u-regoffset.dtsi"
#include "clearpad-ic-s3330-regoffset.dtsi"
#include "clearpad-ic-s3500-regoffset.dtsi"
