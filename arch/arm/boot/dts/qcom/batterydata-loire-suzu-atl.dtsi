/* Copyright (c) 2015, The Linux Foundation. All rights reserved.
 *
 * This program is free software; you can redistribute it and/or modify
 * it under the terms of the GNU General Public License version 2 and
 * only version 2 as published by the Free Software Foundation.
 *
 * This program is distributed in the hope that it will be useful,
 * but WITHOUT ANY WARRANTY; without even the implied warranty of
 * MERCHANTABILITY or FITNESS FOR A PARTICULAR PURPOSE.  See the
 * GNU General Public License for more details.
 */
/*
 * Copyright (C) 2015 Sony Mobile Communications Inc.
 *
 * This program is free software; you can redistribute it and/or modify
 * it under the terms of the GNU General Public License version 2, as
 * published by the Free Software Foundation.
 */

qcom,loire-suzu-atl {
	qcom,batt-id-kohm = <15>;
	qcom,battery-type = "1299-8177";
	qcom,chg-rslow-comp-c1 = <2254000>;
	qcom,chg-rslow-comp-c2 = <2550738>;
	qcom,chg-rs-to-rslow = <828734>;
	qcom,chg-rslow-comp-thr = <0x99>;
	qcom,fg-profile-data = [
		DC 83 53 7C
		33 80 75 75
		4C 83 A8 5B
		4E 80 0D 8C
		3E 82 E4 98
		6A B7 B2 C3
		5D 0E EF 83
		80 7C 34 80
		46 75 52 83
		9A 68 D5 7A
		D9 87 36 82
		03 9A 4C BD
		6C CA 5B 0E
		32 0A 09 5B
		88 6D CD FC
		81 3E 15 3C
		5F 38 00 00
		2F 4C EC 38
		5F 38 00 00
		00 00 00 00
		00 00 00 00
		16 70 06 6B
		FB 66 F0 80
		14 75 20 63
		59 68 91 81
		93 74 F0 61
		44 6B D0 AB
		20 37 68 0D
		65 A0 71 0C
		28 00 FF 36
		F0 11 30 03
		00 00 00 0C
	];
};
