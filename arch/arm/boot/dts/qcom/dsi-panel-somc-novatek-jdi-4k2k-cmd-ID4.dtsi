/* Copyright (c) 2013-2015, The Linux Foundation. All rights reserved.
 *
 * This program is free software; you can redistribute it and/or modify
 * it under the terms of the GNU General Public License version 2 and
 * only version 2 as published by the Free Software Foundation.
 *
 * This program is distributed in the hope that it will be useful,
 * but WITHOUT ANY WARRANTY; without even the implied warranty of
 * MERCHANTABILITY or FITNESS FOR A PARTICULAR PURPOSE.  See the
 * GNU General Public License for more details.
 */
/*
 * Copyright (C) 2015 Sony Mobile Communications Inc.
 *
 * This program is free software; you can redistribute it and/or modify
 * it under the terms of the GNU General Public License version 2, as
 * published by the Free Software Foundation.
 */

&mdss_mdp {
	dsi_dual_0_jdi_novatek_4k2k_cut2_cmd: somc,dual_0_jdi_novatek_4k2k_cut2_cmd_panel {
		qcom,mdss-dsi-panel-name = "4";
		qcom,mdss-dsi-panel-controller = <&mdss_dsi0>;
		qcom,mdss-dsi-panel-destination = "display_1";
		qcom,mdss-dsi-panel-type = "dsi_cmd_mode";
		qcom,mdss-dsi-panel-width = <1080>;
		qcom,mdss-dsi-panel-height = <3840>;
		qcom,mdss-dsi-bpp = <24>;
		qcom,mdss-dsi-h-back-porch = <8>;
		qcom,mdss-dsi-h-pulse-width = <8>;
		qcom,mdss-dsi-h-front-porch = <172>;
		qcom,mdss-dsi-v-back-porch = <8>;
		qcom,mdss-dsi-v-pulse-width = <8>;
		qcom,mdss-dsi-v-front-porch = <691>;
		qcom,mdss-pan-physical-width-dimension = <68>;
		qcom,mdss-pan-physical-height-dimension = <121>;
		qcom,mdss-dsi-panel-framerate = <60>;
		qcom,mdss-dsi-virtual-channel-id = <0>;
		qcom,mdss-dsi-stream = <0>;
		qcom,mdss-dsi-h-sync-skew = <0>;
		qcom,mdss-dsi-h-left-border = <0>;
		qcom,mdss-dsi-h-right-border = <0>;
		qcom,mdss-dsi-v-top-border = <0>;
		qcom,mdss-dsi-v-bottom-border = <0>;
		qcom,mdss-dsi-underflow-color = <0x0>;
		qcom,mdss-dsi-border-color = <0>;
		qcom,mdss-dsi-h-sync-pulse = <1>;
		qcom,mdss-dsi-traffic-mode = "non_burst_sync_event";
		qcom,mdss-dsi-bllp-eof-power-mode;
		qcom,mdss-dsi-bllp-power-mode;
		qcom,mdss-dsi-dma-trigger = "trigger_sw";
		qcom,mdss-dsi-mdp-trigger = "none";
		somc,mdss-dsi-init-command = [05 01 00 00 0A 00 01 01
				29 01 00 00 00 00 06 F0 55 AA 52 08 01
				29 01 00 00 00 00 06 D5 00 00 00 00 00
				29 01 00 00 00 00 06 F0 55 AA 52 08 04
				29 01 00 00 00 00 0A B0 42 0A 86 53 1B 97 21 43 65
				29 01 00 00 00 00 06 F0 55 AA 52 08 07
				29 01 00 00 00 00 04 B1 2F 54 86
				29 01 00 00 00 00 06 B3 20 20 FF 00 30
				29 01 00 00 00 00 0D B4 05 1E 04 30 38 40 5A 60 31 80 35 C0
				29 01 00 00 00 00 0D B5 38 6B 31 5C 22 B8 6E 8B C5 60 F6 70
				29 01 00 00 00 00 0D B6 49 8C 41 BB B3 56 91 45 2B ED 02 CD
				23 01 00 00 00 00 02 DD 00
				23 01 00 00 00 00 02 EF 01
				29 01 00 00 00 00 06 F0 55 AA 52 08 02
				29 01 00 00 00 00 11 B0 00 00 00 14 00 3A 00 5E 00 7E 00 97 00 AB 00 BD
				29 01 00 00 00 00 11 B1 00 CE 01 07 01 31 01 72 01 A2 01 EC 02 26 02 28
				29 01 00 00 00 00 11 B2 02 5F 02 9E 02 C7 02 FD 03 23 03 58 03 68 03 7A
				29 01 00 00 00 00 0D B3 03 8E 03 A3 03 BA 03 D4 03 F1 03 FF
				29 01 00 00 00 00 11 B4 00 00 00 14 00 3B 00 5F 00 7E 00 97 00 AB 00 BD
				29 01 00 00 00 00 11 B5 00 CF 01 07 01 31 01 72 01 A2 01 EB 02 25 02 27
				29 01 00 00 00 00 11 B6 02 5F 02 9E 02 C7 02 FB 03 20 03 54 03 64 03 76
				29 01 00 00 00 00 0D B7 03 8A 03 A0 03 B8 03 D3 03 F0 03 FF
				29 01 00 00 00 00 11 B8 00 00 00 17 00 43 00 69 00 89 00 A1 00 B6 00 C8
				29 01 00 00 00 00 11 B9 00 D9 01 0F 01 3A 01 79 01 A8 01 F0 02 29 02 2B
				29 01 00 00 00 00 11 BA 02 62 02 A0 02 C9 02 FA 03 1B 03 4B 03 5B 03 6C
				29 01 00 00 00 00 0D BB 03 81 03 97 03 B1 03 CE 03 EE 03 FF
				29 01 00 00 00 00 11 BC 00 00 00 14 00 3A 00 5E 00 7E 00 97 00 AB 00 BD
				29 01 00 00 00 00 11 BD 00 CE 01 07 01 31 01 72 01 A2 01 EC 02 26 02 28
				29 01 00 00 00 00 11 BE 02 5F 02 9E 02 C7 02 FD 03 23 03 58 03 68 03 7A
				29 01 00 00 00 00 0D BF 03 8E 03 A3 03 BA 03 D4 03 F1 03 FF
				29 01 00 00 00 00 11 C0 00 00 00 14 00 3B 00 5F 00 7E 00 97 00 AB 00 BD
				29 01 00 00 00 00 11 C1 00 CF 01 07 01 31 01 72 01 A2 01 EB 02 25 02 27
				29 01 00 00 00 00 11 C2 02 5F 02 9E 02 C7 02 FB 03 20 03 54 03 64 03 76
				29 01 00 00 00 00 0D C3 03 8A 03 A0 03 B8 03 D3 03 F0 03 FF
				29 01 00 00 00 00 11 C4 00 00 00 17 00 43 00 69 00 89 00 A1 00 B6 00 C8
				29 01 00 00 00 00 11 C5 00 D9 01 0F 01 3A 01 79 01 A8 01 F0 02 29 02 2B
				29 01 00 00 00 00 11 C6 02 62 02 A0 02 C9 02 FA 03 1B 03 4B 03 5B 03 6C
				29 01 00 00 00 00 0D C7 03 81 03 97 03 B1 03 CE 03 EE 03 FF
				29 01 00 00 00 00 06 F0 55 AA 52 08 03
				29 01 00 00 00 00 06 B5 08 3C 3C 08 06
				29 01 00 00 00 00 06 BA 11 00 09 00 93
				29 01 00 00 00 00 06 BB 31 00 A9 00 A9
				29 01 00 00 00 00 06 BC 53 00 A9 00 A9
				29 01 00 00 00 00 06 F0 55 AA 52 08 00
				29 01 00 00 00 00 04 B8 00 00 02
				29 01 00 00 00 00 06 F0 55 AA 52 08 00
				23 01 00 00 00 00 02 C9 01
				23 01 00 00 00 00 02 E3 00
				29 01 00 00 00 00 10 BD 00 AC 08 08 00 01 59 00 00 01 01 00 00 00 AC
				29 01 00 00 00 00 06 F0 55 AA 52 00 00
				29 01 00 00 00 00 05 FF AA 55 A5 80
				23 01 00 00 00 00 02 6F 01
				23 01 00 00 00 00 02 F3 10
				29 01 00 00 00 00 05 FF AA 55 A5 00
				15 01 00 00 00 00 02 58 00
				15 01 00 00 00 00 02 90 02
				39 01 00 00 00 00 05 2B 00 00 0E FF
				15 01 00 00 00 00 02 35 00
				05 01 00 00 00 00 01 29];
		qcom,mdss-dsi-on-command = [05 01 00 00 0A 00 01 11];
		qcom,mdss-dsi-off-command = [05 01 00 00 14 00 01 28
				05 01 00 00 64 00 01 10];
		qcom,mdss-dsi-on-command-state = "dsi_lp_mode";
		qcom,mdss-dsi-off-command-state = "dsi_hs_mode";
		qcom,mdss-dsi-te-pin-select = <1>;
		qcom,mdss-dsi-wr-mem-start = <0x2c>;
		qcom,mdss-dsi-wr-mem-continue = <0x3c>;
		qcom,mdss-dsi-te-dcs-command = <1>;
		qcom,mdss-dsi-te-check-enable;
		qcom,mdss-dsi-te-using-te-pin;
		qcom,mdss-dsi-lane-0-state;
		qcom,mdss-dsi-lane-1-state;
		qcom,mdss-dsi-lane-2-state;
		qcom,mdss-dsi-lane-3-state;
		qcom,mdss-dsi-panel-timings = [E6 38 26 00 68 66 32 3C 2C 03 04 00 ];
		qcom,mdss-dsi-t-clk-post = <0x02>;
		qcom,mdss-dsi-t-clk-pre = <0x2B>;
		qcom,mdss-dsi-tx-eot-append;
		qcom,mdss-dsi-lp11-init;
		qcom,mdss-dsi-bl-min-level = <1>;
		qcom,mdss-dsi-bl-max-level = <4095>;
		qcom,mdss-brightness-max-level = <255>;
		qcom,mdss-dsi-bl-pmic-control-type = "bl_ctrl_wled";

		qcom,mdss-dsi-compression = "fbc";
		qcom,mdss-dsi-fbc-enable;
		qcom,mdss-dsi-fbc-ver2-mode;
		qcom,mdss-dsi-fbc-bpp = <8>;
		qcom,mdss-dsi-fbc-packing = <1>;
		qcom,mdss-dsi-fbc-2d-pred-mode;
		qcom,mdss-dsi-fbc-slice-height = <4>;
		qcom,mdss-dsi-fbc-quant-error;
		qcom,mdss-dsi-fbc-bias = <2>;
		qcom,mdss-dsi-fbc-vlc-mode;
		qcom,mdss-dsi-fbc-bflc-mode;
		qcom,mdss-dsi-fbc-lossy-mode-idx = <3>;
		qcom,mdss-dsi-fbc-pat-mode;
		qcom,mdss-dsi-fbc-budget-ctrl = <5>;
		qcom,mdss-dsi-fbc-block-budget = <59>;
		qcom,mdss-dsi-fbc-h-line-budget = <675>;
		qcom,mdss-dsi-fbc-lossless-threshold = <0x200>;
		qcom,mdss-dsi-fbc-lossy-threshold = <192>;
		qcom,mdss-dsi-fbc-rgb-threshold = <4>;
		qcom,mdss-dsi-fbc-max-pred-err = <3>;

		somc,mdss-dsi-disp-on-in-hs = <0>;
		somc,mdss-dsi-wait-time-before-on-cmd = <0>;
		somc,mdss-dsi-lane-config = [02 00 EF 00 20 00 00 01 FF
				02 00 EF 00 40 00 00 01 FF
				02 00 EF 40 20 00 00 01 FF
				02 00 EF 40 00 00 00 01 FF
				00 00 45 80 00 00 00 01 97];
		somc,pw-on-rst-seq = <0 10>, <1 10>;
		somc,pw-off-rst-b-seq = <0 0>;
		somc,lcd-id = <1>;
		somc,lcd-id-adc = <1087000 1231000>;
		somc,dsi-index = <0>;

		somc,poll-enable;
		somc,poll-intervals = <10000>;
		somc,poll-esd-reg-adress = <0x0A>;
		somc,poll-esd-reg-val = <0x9C>;
	};

	dsi_dual_1_jdi_novatek_4k2k_cut2_cmd: somc,dual_1_jdi_novatek_4k2k_cut2_cmd_panel {
		qcom,mdss-dsi-panel-name = "4";
		qcom,mdss-dsi-panel-controller = <&mdss_dsi1>;
		qcom,mdss-dsi-panel-destination = "display_2";
		qcom,mdss-dsi-panel-type = "dsi_cmd_mode";
		qcom,mdss-dsi-panel-width = <1080>;
		qcom,mdss-dsi-panel-height = <3840>;
		qcom,mdss-dsi-bpp = <24>;
		qcom,mdss-dsi-h-back-porch = <8>;
		qcom,mdss-dsi-h-pulse-width = <8>;
		qcom,mdss-dsi-h-front-porch = <172>;
		qcom,mdss-dsi-v-back-porch = <8>;
		qcom,mdss-dsi-v-pulse-width = <8>;
		qcom,mdss-dsi-v-front-porch = <691>;
		qcom,mdss-pan-physical-width-dimension = <68>;
		qcom,mdss-pan-physical-height-dimension = <121>;
		qcom,mdss-dsi-panel-framerate = <60>;
		qcom,mdss-dsi-virtual-channel-id = <0>;
		qcom,mdss-dsi-stream = <0>;
		qcom,mdss-dsi-h-sync-skew = <0>;
		qcom,mdss-dsi-h-left-border = <0>;
		qcom,mdss-dsi-h-right-border = <0>;
		qcom,mdss-dsi-v-top-border = <0>;
		qcom,mdss-dsi-v-bottom-border = <0>;
		qcom,mdss-dsi-underflow-color = <0x0>;
		qcom,mdss-dsi-border-color = <0>;
		qcom,mdss-dsi-h-sync-pulse = <1>;
		qcom,mdss-dsi-traffic-mode = "non_burst_sync_event";
		qcom,mdss-dsi-bllp-eof-power-mode;
		qcom,mdss-dsi-bllp-power-mode;
		qcom,mdss-dsi-dma-trigger = "trigger_sw";
		qcom,mdss-dsi-mdp-trigger = "none";
		qcom,mdss-dsi-te-pin-select = <1>;
		qcom,mdss-dsi-wr-mem-start = <0x2c>;
		qcom,mdss-dsi-wr-mem-continue = <0x3c>;
		qcom,mdss-dsi-te-dcs-command = <1>;
		qcom,mdss-dsi-te-check-enable;
		qcom,mdss-dsi-te-using-te-pin;
		qcom,mdss-dsi-lane-0-state;
		qcom,mdss-dsi-lane-1-state;
		qcom,mdss-dsi-lane-2-state;
		qcom,mdss-dsi-lane-3-state;
		qcom,mdss-dsi-panel-timings = [E6 38 26 00 68 66 32 3C 2C 03 04 00 ];
		qcom,mdss-dsi-t-clk-post = <0x02>;
		qcom,mdss-dsi-t-clk-pre = <0x2B>;
		qcom,mdss-dsi-tx-eot-append;
		qcom,mdss-dsi-lp11-init;
		qcom,mdss-dsi-bl-min-level = <1>;
		qcom,mdss-dsi-bl-max-level = <4095>;
		qcom,mdss-brightness-max-level = <255>;

		qcom,mdss-dsi-compression = "fbc";
		qcom,mdss-dsi-fbc-enable;
		qcom,mdss-dsi-fbc-ver2-mode;
		qcom,mdss-dsi-fbc-bpp = <8>;
		qcom,mdss-dsi-fbc-packing = <1>;
		qcom,mdss-dsi-fbc-2d-pred-mode;
		qcom,mdss-dsi-fbc-slice-height = <4>;
		qcom,mdss-dsi-fbc-quant-error;
		qcom,mdss-dsi-fbc-bias = <2>;
		qcom,mdss-dsi-fbc-vlc-mode;
		qcom,mdss-dsi-fbc-bflc-mode;
		qcom,mdss-dsi-fbc-lossy-mode-idx = <3>;
		qcom,mdss-dsi-fbc-pat-mode;
		qcom,mdss-dsi-fbc-budget-ctrl = <5>;
		qcom,mdss-dsi-fbc-block-budget = <59>;
		qcom,mdss-dsi-fbc-h-line-budget = <675>;
		qcom,mdss-dsi-fbc-lossless-threshold = <0x200>;
		qcom,mdss-dsi-fbc-lossy-threshold = <192>;
		qcom,mdss-dsi-fbc-rgb-threshold = <4>;
		qcom,mdss-dsi-fbc-max-pred-err = <3>;

		somc,mdss-dsi-lane-config = [02 00 EF 00 20 00 00 01 FF
				02 00 EF 00 40 00 00 01 FF
				02 00 EF 40 20 00 00 01 FF
				02 00 EF 40 00 00 00 01 FF
				00 00 45 80 00 00 00 01 97];
		somc,lcd-id = <1>;
		somc,lcd-id-adc = <1087000 1231000>;
		somc,dsi-index = <1>;
	};
};
