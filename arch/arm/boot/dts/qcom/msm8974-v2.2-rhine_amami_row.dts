/* arch/arm/boot/dts/qcom/msm8974-v2.2-rhine_amami_row.dts
 *
 * Copyright (c) 2013, The Linux Foundation. All rights reserved.
 * Copyright (C) 2013 Sony Mobile Communications AB.
 *
 * Author: Kouhei Fujiya <Kouhei.X.Fujiya@sonymobile.com>
 *
 * This program is free software; you can redistribute it and/or modify
 * it under the terms of the GNU General Public License version 2 and
 * only version 2 as published by the Free Software Foundation.
 *
 * This program is distributed in the hope that it will be useful,
 * but WITHOUT ANY WARRANTY; without even the implied warranty of
 * MERCHANTABILITY or FITNESS FOR A PARTICULAR PURPOSE.  See the
 * GNU General Public License for more details.
 */

/dts-v1/;

#include "msm8974-v2.2.dtsi"
#include "msm8974-mtp.dtsi"
#include "msm8974-rhine_common.dtsi"
#include "msm8974-rhine_amami_row.dtsi"
#include "msm8974-rhine_amami_row_camera.dtsi"
#include "dsi-panel-somc-amami.dtsi"

/ {
	model = "SoMC Amami ROW";
	compatible = "somc,amami-row", "qcom,msm8974";
	qcom,board-id = <8 0>;
};
