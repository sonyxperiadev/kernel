/* Copyright (c) 2013, The Linux Foundation. All rights reserved.
 *
 * This program is free software; you can redistribute it and/or modify
 * it under the terms of the GNU General Public License version 2 and
 * only version 2 as published by the Free Software Foundation.
 *
 * This program is distributed in the hope that it will be useful,
 * but WITHOUT ANY WARRANTY; without even the implied warranty of
 * MERCHANTABILITY or FITNESS FOR A PARTICULAR PURPOSE.  See the
 * GNU General Public License for more details.
 */

/*---------------------------------------------------------------------------
 * This file is autogenerated file using gcdb parser. Please do not edit it.
 * Update input XML file to add a new entry or update variable in this file
 * VERSION = "1.0"
 *---------------------------------------------------------------------------*/
&mdss_mdp {
	dsi_nt35521_720_vid_jdi: qcom,mdss_dsi_nt35521_720p_video_jdi {
		compatible = "qcom,mdss-dsi-panel-jdi";
		qcom,mdss-dsi-panel-name = "nt35521 720p video mode dsi panel jdi";
		qcom,mdss-dsi-panel-controller = <&mdss_dsi0>;
		qcom,mdss-dsi-panel-type = "dsi_video_mode";
		qcom,mdss-dsi-panel-destination = "display_1";
		qcom,mdss-dsi-panel-framerate = <60>;
		qcom,mdss-dsi-virtual-channel-id = <0>;
		qcom,mdss-dsi-stream = <0>;
		qcom,mdss-pan-physical-width-dimension = <65>;
		qcom,mdss-pan-physical-height-dimension = <116>;
		qcom,mdss-dsi-panel-width = <720>;
		qcom,mdss-dsi-panel-height = <1280>;
		qcom,mdss-dsi-h-front-porch = <114>;
		qcom,mdss-dsi-h-back-porch = <50>;
		qcom,mdss-dsi-h-pulse-width = <10>;
		qcom,mdss-dsi-h-sync-skew = <0>;
		qcom,mdss-dsi-v-back-porch = <10>;
		qcom,mdss-dsi-v-front-porch = <13>;
		qcom,mdss-dsi-v-pulse-width = <1>;
		qcom,mdss-dsi-h-left-border = <0>;
		qcom,mdss-dsi-h-right-border = <0>;
		qcom,mdss-dsi-v-top-border = <0>;
		qcom,mdss-dsi-v-bottom-border = <0>;
		qcom,mdss-dsi-bpp = <24>;
		qcom,mdss-dsi-color-order = <0>;
		qcom,mdss-dsi-underflow-color = <0xff>;
		qcom,mdss-dsi-border-color = <0>;
		qcom,mdss-dsi-pixel-packing = <0>;
		qcom,mdss-dsi-on-command-0 = [
				29 01 00 00 00 00 06 F0 55 AA 52 08 00
				23 01 00 00 00 00 02 B6 14
				29 01 00 00 00 00 05 B8 00 00 14 0A
				23 01 00 00 00 00 02 BA 00
				29 01 00 00 00 00 03 BB 63 63
				29 01 00 00 00 00 06 BD 02 7F 0D 0B 00
				29 01 00 00 00 00 04 D9 00 02 00
				29 01 00 00 00 00 06 F0 55 AA 52 00 00

				29 01 00 00 00 00 06 F0 55 AA 52 08 01
				29 01 00 00 00 00 03 B0 0D 0D
				29 01 00 00 00 00 03 B1 0D 0D
				29 01 00 00 00 00 03 B3 30 30
				29 01 00 00 00 00 03 B4 1B 1B
				29 01 00 00 00 00 03 B6 05 05
				29 01 00 00 00 00 03 B7 05 05
				29 01 00 00 00 00 03 B8 05 05
				29 01 00 00 00 00 03 B9 45 45
				29 01 00 00 00 00 03 BA 36 36
				29 01 00 00 00 00 03 BC 50 00
				29 01 00 00 00 00 03 BD 50 00
				23 01 00 00 00 00 02 BE 80
				23 01 00 00 00 00 02 BF 80
				23 01 00 00 00 00 02 C1 01
				29 01 00 00 00 00 04 C7 61 00 00
				23 01 00 00 00 00 02 CA 00
				29 01 00 00 00 00 04 CF 00 50 50
				29 01 00 00 00 00 06 F0 55 AA 52 00 00

				29 01 00 00 00 00 06 F0 55 AA 52 08 02
				29 01 00 00 00 00 11 B0 00 00 00 0F 00 29 00 3D 00 50 00 6F 00 8A 00 B6
				29 01 00 00 00 00 11 B1 00 DC 01 17 01 47 01 90 01 CB 01 CD 02 02 02 3E
				29 01 00 00 00 00 11 B2 02 71 02 B8 02 EC 03 37 03 6A 03 87 03 A0 03 A2
				29 01 00 00 00 00 05 B3 03 B6 03 CC
				29 01 00 00 00 00 11 B4 00 00 00 0F 00 29 00 3D 00 50 00 6F 00 8A 00 B6
				29 01 00 00 00 00 11 B5 00 DC 01 17 01 47 01 90 01 CB 01 CD 02 02 02 3E
				29 01 00 00 00 00 11 B6 02 71 02 B8 02 EC 03 37 03 6A 03 87 03 A0 03 A2
				29 01 00 00 00 00 05 B7 03 B6 03 CC

				29 01 00 00 00 00 11 B8 00 00 00 0F 00 29 00 3D 00 50 00 6F 00 8A 00 B6
				29 01 00 00 00 00 11 B9 00 DC 01 17 01 47 01 90 01 CB 01 CD 02 02 02 3E
				29 01 00 00 00 00 11 BA 02 71 02 B8 02 EC 03 37 03 6A 03 87 03 A0 03 A2
				29 01 00 00 00 00 05 BB 03 B6 03 CC
				29 01 00 00 00 00 11 BC 00 00 00 0F 00 29 00 3D 00 50 00 6F 00 8A 00 B6
				29 01 00 00 00 00 11 BD 00 DC 01 17 01 47 01 90 01 CB 01 CD 02 02 02 3E
				29 01 00 00 00 00 11 BE 02 71 02 B8 02 EC 03 37 03 6A 03 87 03 A0 03 A2
				29 01 00 00 00 00 05 BF 03 B7 03 CC

				29 01 00 00 00 00 11 C0 00 00 00 0F 00 29 00 3D 00 50 00 6F 00 8A 00 B6
				29 01 00 00 00 00 11 C1 00 DC 01 17 01 47 01 90 01 CB 01 CD 02 02 02 3E
				29 01 00 00 00 00 11 C2 02 71 02 B8 02 EC 03 37 03 6A 03 87 03 A0 03 A2
				29 01 00 00 00 00 05 C3 03 B6 03 CC
				29 01 00 00 00 00 11 C4 00 00 00 0F 00 29 00 3D 00 50 00 6F 00 8A 00 B6
				29 01 00 00 00 00 11 C5 00 DC 01 17 01 47 01 90 01 CB 01 CD 02 02 02 3E
				29 01 00 00 00 00 11 C6 02 71 02 B8 02 EC 03 37 03 6A 03 87 03 A0 03 A2
				29 01 00 00 00 00 05 C7 03 B6 03 CC
				23 01 00 00 00 00 02 EE 00
				29 01 00 00 00 00 06 F0 55 AA 52 00 00

				29 01 00 00 00 00 06 F0 55 AA 52 08 03
				29 01 00 00 00 00 03 B0 F5 00
				29 01 00 00 00 00 03 B1 F5 00
				29 01 00 00 00 00 06 B2 03 00 4C 00 01
				29 01 00 00 00 00 06 B6 03 00 4C 00 01
				29 01 00 00 00 00 06 BA 35 00 4C 00 01
				29 01 00 00 00 00 06 BB 35 00 4C 00 01
				29 01 00 00 00 00 05 C0 30 00 00 00
				29 01 00 00 00 00 05 C1 30 00 00 00
				29 01 00 00 00 00 05 C2 12 00 00 00
				29 01 00 00 00 00 05 C3 21 00 00 00
				23 01 00 00 00 00 02 C4 40
				29 01 00 00 00 00 06 F0 55 AA 52 00 00

				29 01 00 00 00 00 06 F0 55 AA 52 08 05
				29 01 00 00 00 00 03 B3 17 26
				29 01 00 00 00 00 03 B7 17 26
				29 01 00 00 00 00 06 BD 03 01 01 0F 0F
				23 01 00 00 00 00 02 C0 03
				23 01 00 00 00 00 02 C4 A6
				29 01 00 00 00 00 03 C8 05 30
				29 01 00 00 00 00 03 C9 01 11
				29 01 00 00 00 00 04 CC 00 00 04
				29 01 00 00 00 00 04 CD 00 00 04
				29 01 00 00 00 00 04 CE 00 00 04
				29 01 00 00 00 00 04 CF 00 00 04
				23 01 00 00 00 00 02 D0 00
				29 01 00 00 00 00 05 D1 02 00 00 04
				29 01 00 00 00 00 05 D2 02 00 00 02
				23 01 00 00 00 00 02 E5 06
				23 01 00 00 00 00 02 E6 06
				23 01 00 00 00 00 02 E7 06
				23 01 00 00 00 00 02 E8 06
				23 01 00 00 00 00 02 EC 06
				29 01 00 00 00 00 06 F0 55 AA 52 00 00

				29 01 00 00 00 00 06 F0 55 AA 52 08 06
				29 01 00 00 00 00 03 B0 2E 00
				29 01 00 00 00 00 03 B1 08 10
				29 01 00 00 00 00 03 B2 12 14
				29 01 00 00 00 00 03 B3 16 31
				29 01 00 00 00 00 03 B4 31 31
				29 01 00 00 00 00 03 B5 31 31
				29 01 00 00 00 00 03 B6 31 34
				29 01 00 00 00 00 03 B7 2B 2A
				29 01 00 00 00 00 03 B8 34 2C
				29 01 00 00 00 00 03 B9 29 34
				29 01 00 00 00 00 03 BA 34 29
				29 01 00 00 00 00 03 BB 2C 34
				29 01 00 00 00 00 03 BC 2A 2B
				29 01 00 00 00 00 03 BD 34 31
				29 01 00 00 00 00 03 BE 31 31
				29 01 00 00 00 00 03 BF 31 31
				29 01 00 00 00 00 03 C0 31 17
				29 01 00 00 00 00 03 C1 15 13
				29 01 00 00 00 00 03 C2 11 09
				29 01 00 00 00 00 03 C3 01 2E

				29 01 00 00 00 00 03 C4 2E 2D
				29 01 00 00 00 00 03 C5 01 17
				29 01 00 00 00 00 03 C6 15 13
				29 01 00 00 00 00 03 C7 11 31
				29 01 00 00 00 00 03 C8 31 31
				29 01 00 00 00 00 03 C9 31 31
				29 01 00 00 00 00 03 CA 31 34
				29 01 00 00 00 00 03 CB 2B 2A
				29 01 00 00 00 00 03 CC 34 2C
				29 01 00 00 00 00 03 CD 29 34
				29 01 00 00 00 00 03 CE 34 29
				29 01 00 00 00 00 03 CF 2C 34
				29 01 00 00 00 00 03 D0 2A 2B
				29 01 00 00 00 00 03 D1 34 31
				29 01 00 00 00 00 03 D2 31 31
				29 01 00 00 00 00 03 D3 31 31
				29 01 00 00 00 00 03 D4 31 10
				29 01 00 00 00 00 03 D5 12 14
				29 01 00 00 00 00 03 D6 16 00
				29 01 00 00 00 00 03 D7 2D 2E

				29 01 00 00 00 00 06 D8 00 00 00 00 00
				29 01 00 00 00 00 06 D9 00 00 00 00 00
				29 01 00 00 00 00 03 E5 34 34
				29 01 00 00 00 00 03 E6 34 34
				23 01 00 00 00 00 02 E7 00
				29 01 00 00 00 00 06 F0 55 AA 52 00 00

				//Modify backlight leds's freq to 65.1kHz
				29 01 00 00 00 00 06 F0 55 AA 52 08 00
				29 01 00 00 00 00 04 D9 02 03 00
				29 01 00 00 00 00 06 F0 55 AA 52 00 00

				/*Disable HS mode MIPI can receive command that is avoid ESD issue*/
				29 01 00 00 00 00 06 F0 55 AA 52 08 00
				29 01 00 00 00 00 03 B1 6C 21
				29 01 00 00 00 00 06 F0 55 AA 52 00 00
				29 01 00 00 00 00 02 35 00

				05 01 00 00 78 00 02 11 00
				05 01 00 00 01 00 02 29 00
				29 01 00 00 00 00 02 53 24
		];
		qcom,mdss-dsi-on-command-61 = [

				//Modify backlight leds's freq to 65.1kHz
				29 01 00 00 00 00 06 F0 55 AA 52 08 00
				29 01 00 00 00 00 04 D9 02 03 00
				29 01 00 00 00 00 06 F0 55 AA 52 00 00

				/*Disable HS mode MIPI can receive command that is avoid ESD issue*/
				29 01 00 00 00 00 06 F0 55 AA 52 08 00
				29 01 00 00 00 00 03 B1 6C 21
				29 01 00 00 00 00 06 F0 55 AA 52 00 00
				29 01 00 00 00 00 02 35 00

				05 01 00 00 78 00 02 11 00
				05 01 00 00 01 00 02 29 00
				29 01 00 00 00 00 02 53 24
		];
		qcom,mdss-dsi-off-command = [05 01 00 00 32 00 02 28 00
					05 01 00 00 96 00 02 10 00];
		qcom,mdss-dsi-on-command-state = "dsi_lp_mode";
		qcom,mdss-dsi-off-command-state = "dsi_hs_mode";
		qcom,mdss-dsi-h-sync-pulse = <1>;
		qcom,mdss-dsi-traffic-mode = <2>;
		qcom,mdss-dsi-lane-map = <0>;
		qcom,mdss-dsi-bllp-eof-power-mode;
		qcom,mdss-dsi-bllp-power-mode;
		qcom,mdss-dsi-lane-0-state;
		qcom,mdss-dsi-lane-1-state;
		qcom,mdss-dsi-lane-2-state;
		qcom,mdss-dsi-lane-3-state;
		qcom,mdss-dsi-panel-timings = [93 1F 17 00 2F 2E 1C 21 26 03 04 00];
		qcom,mdss-dsi-t-clk-post = <0x20>;
		qcom,mdss-dsi-t-clk-pre = <0x2D>;
		qcom,mdss-dsi-bl-min-level = <1>;
		qcom,mdss-dsi-bl-max-level = <255>;
		qcom,mdss-dsi-dma-trigger = <4>;
		qcom,mdss-dsi-mdp-trigger = <0>;
		qcom,mdss-dsi-bl-pmic-control-type = "bl_ctrl_dcs";
		qcom,mdss-dsi-reset-sequence = <1 20>, <0 1>, <1 20>;

	};
};
