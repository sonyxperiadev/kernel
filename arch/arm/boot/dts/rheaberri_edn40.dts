/dts-v1/;


/ {
	#address-cells = <1>;
	#size-cells = <1>;
	model = "Broadcom RheaBerri EDN40 board";
	compatible = "Broadcom,rhea";

	chosen {
	};

	pinmux {
		compatible = "Broadcom,rhea-pinmux";
		reg = <0x35004800 147>;		/* base address and # of pins */
		data = <
		0x00000003 /* pad 0x0*/
		0x00000023 /* pad 0x4*/
		0x00000020 /* pad 0x8*/
		0x00000020 /* pad 0xc*/
		0x00000043 /* pad 0x10*/
		0x00000443 /* pad 0x14*/
		0x00000080 /* pad 0x18*/
		0x00000052 /* pad 0x1c*/
		0x00000043 /* pad 0x20*/
		0x00000323 /* pad 0x24*/
		0x00000423 /* pad 0x28*/
		0x00000223 /* pad 0x2c*/
		0x00000443 /* pad 0x30*/
		0x00000443 /* pad 0x34*/
		0x00000423 /* pad 0x38*/
		0x00000223 /* pad 0x3c*/
		0x00000223 /* pad 0x40*/
		0x00000223 /* pad 0x44*/
		0x00000223 /* pad 0x48*/
		0x00000023 /* pad 0x4c*/
		0x00000023 /* pad 0x50*/
		0x00000423 /* pad 0x54*/
		0x00000403 /* pad 0x58*/
		0x00000223 /* pad 0x5c*/
		0x00000223 /* pad 0x60*/
		0x00000223 /* pad 0x64*/
		0x00000223 /* pad 0x68*/
		0x00000023 /* pad 0x6c*/
		0x00000043 /* pad 0x70*/
		0x00000403 /* pad 0x74*/
		0x00000403 /* pad 0x78*/
		0x00000120 /* pad 0x7c*/
		0x00000120 /* pad 0x80*/
		0x00000123 /* pad 0x84*/
		0x00000123 /* pad 0x88*/
		0x00000123 /* pad 0x8c*/
		0x00000123 /* pad 0x90*/
		0x00000123 /* pad 0x94*/
		0x00000123 /* pad 0x98*/
		0x00000123 /* pad 0x9c*/
		0x00000123 /* pad 0xa0*/
		0x00000123 /* pad 0xa4*/
		0x00000123 /* pad 0xa8*/
		0x00000023 /* pad 0xac*/
		0x00000243 /* pad 0xb0*/
		0x00000243 /* pad 0xb4*/
		0x00000043 /* pad 0xb8*/
		0x00000023 /* pad 0xbc*/
		0x00000423 /* pad 0xc0*/
		0x00000323 /* pad 0xc4*/
		0x00000023 /* pad 0xc8*/
		0x00000423 /* pad 0xcc*/
		0x00000423 /* pad 0xd0*/
		0x00000443 /* pad 0xd4*/
		0x00000423 /* pad 0xd8*/
		0x00000123 /* pad 0xdc*/
		0x00000123 /* pad 0xe0*/
		0x00000023 /* pad 0xe4*/
		0x00000205 /* pad 0xe8*/
		0x00000205 /* pad 0xec*/
		0x00000205 /* pad 0xf0*/
		0x00000423 /* pad 0xf4*/
		0x00000200 /* pad 0xf8*/
		0x00000200 /* pad 0xfc*/
		0x00000200 /* pad 0x100*/
		0x00000200 /* pad 0x104*/
		0x00000205 /* pad 0x108*/
		0x00000003 /* pad 0x10c*/
		0x00000023 /* pad 0x110*/
		0x00000023 /* pad 0x114*/
		0x00000023 /* pad 0x118*/
		0x00000023 /* pad 0x11c*/
		0x00000023 /* pad 0x120*/
		0x00000023 /* pad 0x124*/
		0x00000023 /* pad 0x128*/
		0x00000023 /* pad 0x12c*/
		0x00000023 /* pad 0x130*/
		0x00000023 /* pad 0x134*/
		0x00000443 /* pad 0x138*/
		0x00000423 /* pad 0x13c*/
		0x00000423 /* pad 0x140*/
		0x00000423 /* pad 0x144*/
		0x00000423 /* pad 0x148*/
		0x00000423 /* pad 0x14c*/
		0x00000423 /* pad 0x150*/
		0x00000423 /* pad 0x154*/
		0x00000423 /* pad 0x158*/
		0x00000343 /* pad 0x15c*/
		0x00000443 /* pad 0x160*/
		0x00000003 /* pad 0x164*/
		0x00000003 /* pad 0x168*/
		0x00000020 /* pad 0x16c*/
		0x00000020 /* pad 0x170*/
		0x00000023 /* pad 0x174*/
		0x00000020 /* pad 0x178*/
		0x00000005 /* pad 0x17c*/
		0x00000043 /* pad 0x180*/
		0x00000052 /* pad 0x184*/
		0x00000045 /* pad 0x188*/
		0x00000045 /* pad 0x18c*/
		0x00000045 /* pad 0x190*/
		0x00000057 /* pad 0x194*/
		0x00000037 /* pad 0x198*/
		0x00000037 /* pad 0x19c*/
		0x00000037 /* pad 0x1a0*/
		0x00000037 /* pad 0x1a4*/
		0x00000037 /* pad 0x1a8*/
		0x00000003 /* pad 0x1ac*/
		0x00001033 /* pad 0x1b0*/
		0x00000023 /* pad 0x1b4*/
		0x00000003 /* pad 0x1b8*/
		0x00000023 /* pad 0x1bc*/
		0x00000023 /* pad 0x1c0*/
		0x00000123 /* pad 0x1c4*/
		0x00000123 /* pad 0x1c8*/
		0x00000123 /* pad 0x1cc*/
		0x00000123 /* pad 0x1d0*/
		0x00000003 /* pad 0x1d4*/
		0x00000003 /* pad 0x1d8*/
		0x00000003 /* pad 0x1dc*/
		0x00000203 /* pad 0x1e0*/
		0x00000223 /* pad 0x1e4*/
		0x00001233 /* pad 0x1e8*/
		0x00000203 /* pad 0x1ec*/
		0x00000123 /* pad 0x1f0*/
		0x00000023 /* pad 0x1f4*/
		0x00000043 /* pad 0x1f8*/
		0x00000023 /* pad 0x1fc*/
		0x00000003 /* pad 0x200*/
		0x00000020 /* pad 0x204*/
		0x00000043 /* pad 0x208*/
		0x00000040 /* pad 0x20c*/
		0x00000123 /* pad 0x210*/
		0x00000123 /* pad 0x214*/
		0x00000123 /* pad 0x218*/
		0x00000123 /* pad 0x21c*/
		0x00000123 /* pad 0x220*/
		0x00000440 /* pad 0x224*/
		0x00000440 /* pad 0x228*/
		0x00000440 /* pad 0x22c*/
		0x00000123 /* pad 0x230*/
		0x00000040 /* pad 0x234*/
		0x00000052 /* pad 0x238*/
		0x00000023 /* pad 0x23c*/
		0x00000023 /* pad 0x240*/
		0x00000023 /* pad 0x244*/
		0x00000023 /* pad 0x248*/
			>;
	};

	/* gpio node must be consistent with pinmux node */
	gpio {
		compatible = "Broadcom,rhea-gpio";
		reg = <0x35003000 30>;		/* base address and # of exposed GPIOs */
		data = <
			44  0x00000001 /*Input*/
			111  0x00000001 /*Input*/
			123  0x00000001 /*Input*/
			124  0x00000001 /*Input*/
			4  0x00000001 /*Input*/
			5  0x00000001 /*Input*/
			12  0x00000001 /*Input*/
			13  0x00000001 /*Input*/
			28  0x00000001 /*Input*/
			34  0x00000001 /*Input*/
			100  0x00000001 /*Input*/
			122  0x00000000 /*Output*/
			121  0x00000001 /*Input*/
			38  0x00000001 /*Input*/
			41  0x00000000 /*Output*/
			115  0x00000001 /*Input*/
			68  0x00000001 /*Input*/
			69  0x00000001 /*Input*/
			78  0x00000001 /*Input*/
			77  0x00000001 /*Input*/
			76  0x00000001 /*Input*/
			75  0x00000001 /*Input*/
			74  0x00000001 /*Input*/
			73  0x00000001 /*Input*/
			72  0x00000001 /*Input*/
			70  0x00000001 /*Input*/
			29  0x00000001 /*Input*/
			105  0x00000001 /*Input*/
			104  0x00000001 /*Input*/
			103  0x00000001 /*Input*/
			>;
	};
};
