/* Copyright (c) 2013, The Linux Foundation. All rights reserved.
 *
 * This program is free software; you can redistribute it and/or modify
 * it under the terms of the GNU General Public License version 2 and
 * only version 2 as published by the Free Software Foundation.
 *
 * This program is distributed in the hope that it will be useful,
 * but WITHOUT ANY WARRANTY; without even the implied warranty of
 * MERCHANTABILITY or FITNESS FOR A PARTICULAR PURPOSE.  See the
 * GNU General Public License for more details.
 */

/*---------------------------------------------------------------------------
 * This file is autogenerated file using gcdb parser. Please do not edit it.
 * Update input XML file to add a new entry or update variable in this file
 * VERSION = "1.0"
 *---------------------------------------------------------------------------*/
&mdss_mdp {
	dsi_nt35521_720_vid_truly: qcom,mdss_dsi_nt35521_720p_video_truly {
		compatible = "qcom,mdss-dsi-panel-truly";
		qcom,mdss-dsi-panel-name = "nt35521 720p video mode dsi panel truly";
		qcom,mdss-dsi-panel-controller = <&mdss_dsi0>;
		qcom,mdss-dsi-panel-type = "dsi_video_mode";
		qcom,mdss-dsi-panel-destination = "display_1";
		qcom,mdss-dsi-panel-framerate = <60>;
		qcom,mdss-dsi-virtual-channel-id = <0>;
		qcom,mdss-dsi-stream = <0>;
		qcom,mdss-pan-physical-width-dimension = <65>;
		qcom,mdss-pan-physical-height-dimension = <116>;
		qcom,mdss-dsi-panel-width = <720>;
		qcom,mdss-dsi-panel-height = <1280>;
		qcom,mdss-dsi-h-front-porch = <632>; //800Mbps
		qcom,mdss-dsi-h-back-porch = <295>; //800Mbps
		qcom,mdss-dsi-h-pulse-width = <40>; //800Mbps
//		qcom,mdss-dsi-h-front-porch = <114>; //420Mbps
//		qcom,mdss-dsi-h-back-porch = <50>; //420Mbps
//		qcom,mdss-dsi-h-pulse-width = <10>; //420Mbps
		qcom,mdss-dsi-h-sync-skew = <0>;
		qcom,mdss-dsi-v-back-porch = <18>;
		qcom,mdss-dsi-v-front-porch = <18>;
		qcom,mdss-dsi-v-pulse-width = <1>;

		qcom,mdss-dsi-h-front-porch-lte = <232>; //514Mbps
		qcom,mdss-dsi-h-back-porch-lte = <112>; //514Mbps
		qcom,mdss-dsi-h-pulse-width-lte = <20>; //514Mbps
		qcom,mdss-dsi-v-back-porch-lte = <18>;
		qcom,mdss-dsi-v-front-porch-lte = <18>;
		qcom,mdss-dsi-v-pulse-width-lte = <1>;

		qcom,mdss-dsi-h-left-border = <0>;
		qcom,mdss-dsi-h-right-border = <0>;
		qcom,mdss-dsi-v-top-border = <0>;
		qcom,mdss-dsi-v-bottom-border = <0>;
		qcom,mdss-dsi-bpp = <24>;
		qcom,mdss-dsi-underflow-color = <0xff>;
		qcom,mdss-dsi-border-color = <0>;
		qcom,mdss-dsi-pixel-packing = "tight";
		qcom,mdss-dsi-on-command-63 = [
                        29 01 00 00 00 00 06 F0 55 AA 52 08 00
                        29 01 00 00 00 00 05 FF AA 55 A5 80
                        29 01 00 00 00 00 03 6F 11 00
                        29 01 00 00 00 00 03 F7 20 00
                        29 01 00 00 00 00 02 6F 01
                        29 01 00 00 00 00 02 B1 21
                        29 01 00 00 00 00 06 BD 01 A0 10 08 01
                        29 01 00 00 00 00 05 B8 01 02 0C 02
                        29 01 00 00 00 00 03 BB 11 11
                        29 01 00 00 00 00 03 BC 00 00
                        //UPDATE 0620
                        29 01 00 00 00 00 02 B6 02
                        //REGW B6 16
                        
                        29 01 00 00 00 00 06 F0 55 AA 52 08 01
                        29 01 00 00 00 00 03 B0 09 09
                        29 01 00 00 00 00 03 B1 09 09
                        
                        //VGMP=4.75V
                        29 01 00 00 00 00 03 BC 8C 00
                        29 01 00 00 00 00 03 BD 8C 00
                        29 01 00 00 00 00 02 CA 00
                        //MIPI VIDEO MODE
                        29 01 00 00 00 00 02 C0 04
                        29 01 00 00 00 00 02 BE B5
                        29 01 00 00 00 00 03 B3 35 35
                        29 01 00 00 00 00 03 B4 25 25
                        29 01 00 00 00 00 03 B9 43 43
                        29 01 00 00 00 00 03 BA 24 24
                        
                        //2013/11/14 G2.2
                        29 01 00 00 00 00 06 F0 55 AA 52 08 02
                        29 01 00 00 00 00 02 EE 03

//R(+) MCR cmd
                        29 01 00 00 00 00 11 B0 00 B2 00 B3 00 B6 00 C3 00 CE 00 E1 00 F3 01 11
                        29 01 00 00 00 00 11 B1 01 2E 01 5C 01 82 01 C3 01 FE 02 00 02 37 02 77
                        29 01 00 00 00 00 11 B2 02 A1 02 D7 02 FE 03 2C 03 4B 03 63 03 8F 03 90
                        29 01 00 00 00 00 05 B3 03 96 03 98
//G(+) MCR cmd
                        29 01 00 00 00 00 11 B4 00 81 00 8B 00 9C 00 A9 00 B5 00 CB 00 DF 01 02
                        29 01 00 00 00 00 11 B5 01 1F 01 51 01 7A 01 BF 01 FA 01 FC 02 34 02 76
                        29 01 00 00 00 00 11 B6 02 9F 02 D7 02 FC 03 2C 03 4A 03 63 03 8F 03 A2
                        29 01 00 00 00 00 05 B7 03 B8 03 BA
//B(+) MCR cmd
                        29 01 00 00 00 00 11 B8 00 01 00 02 00 0E 00 2A 00 41 00 67 00 87 00 B9
                        29 01 00 00 00 00 11 B9 00 E2 01 22 01 54 01 A3 01 E6 01 E7 02 24 02 67
                        29 01 00 00 00 00 11 BA 02 93 02 CD 02 F6 03 31 03 6C 03 E9 03 EF 03 F4
                        29 01 00 00 00 00 05 BB 03 F6 03 F7

                        
                        //TIMING SETTING
                        29 01 00 00 00 00 06 F0 55 AA 52 08 03
                        
                        29 01 00 00 00 00 03 B0 22 00
                        29 01 00 00 00 00 03 B1 22 00
                        
                        29 01 00 00 00 00 06 B2 05 00 60 00 00
                        29 01 00 00 00 00 06 B3 05 00 60 00 00
                        29 01 00 00 00 00 06 B4 05 00 60 00 00
                        29 01 00 00 00 00 06 B5 05 00 60 00 00
                        
                        29 01 00 00 00 00 06 BA 53 00 60 00 00
                        29 01 00 00 00 00 06 BB 53 00 60 00 00
                        29 01 00 00 00 00 06 BC 53 00 60 00 00
                        29 01 00 00 00 00 06 BD 53 00 60 00 00
                        
                        29 01 00 00 00 00 05 C0 00 34 00 00
                        29 01 00 00 00 00 05 C1 00 00 34 00
                        29 01 00 00 00 00 05 C2 00 00 34 00
                        29 01 00 00 00 00 05 C3 00 00 34 00
                        29 01 00 00 00 00 02 C4 60
                        29 01 00 00 00 00 02 C5 C0
                        29 01 00 00 00 00 02 C6 00
                        29 01 00 00 00 00 02 C7 00
                        
                        29 01 00 00 00 00 06 F0 55 AA 52 08 05
                        
                        29 01 00 00 00 00 03 B0 17 06
                        29 01 00 00 00 00 03 B1 17 06
                        29 01 00 00 00 00 03 B2 17 06
                        29 01 00 00 00 00 03 B3 17 06
                        29 01 00 00 00 00 03 B4 17 06
                        29 01 00 00 00 00 03 B5 17 06
                        29 01 00 00 00 00 03 B6 17 06
                        29 01 00 00 00 00 03 B7 17 06
                        29 01 00 00 00 00 02 B8 00
                        29 01 00 00 00 00 03 B9 00 03
                        29 01 00 00 00 00 03 BA 00 00
                        29 01 00 00 00 00 03 BB 02 03
                        29 01 00 00 00 00 03 BC 02 03
                        29 01 00 00 00 00 06 BD 03 03 00 03 03
                        29 01 00 00 00 00 02 C0 0B
                        29 01 00 00 00 00 02 C1 09
                        29 01 00 00 00 00 02 C2 A6
                        29 01 00 00 00 00 02 C3 05
                        29 01 00 00 00 00 02 C4 00
                        29 01 00 00 00 00 02 C5 02
                        29 01 00 00 00 00 02 C6 22
                        29 01 00 00 00 00 02 C7 03
                        29 01 00 00 00 00 03 C8 07 20
                        29 01 00 00 00 00 03 C9 03 20
                        29 01 00 00 00 00 03 CA 01 60
                        29 01 00 00 00 00 03 CB 01 60
                        29 01 00 00 00 00 04 CC 00 00 02
                        29 01 00 00 00 00 04 CD 00 00 02
                        29 01 00 00 00 00 04 CE 00 00 02
                        29 01 00 00 00 00 04 CF 00 00 02
                        29 01 00 00 00 00 06 D1 00 05 01 07 10
                        29 01 00 00 00 00 06 D2 10 05 05 03 10
                        29 01 00 00 00 00 06 D3 20 00 43 07 10
                        29 01 00 00 00 00 06 D4 30 00 43 07 10
                        29 01 00 00 00 00 08 D0 00 00 00 00 00 00 00
                        29 01 00 00 00 00 0C D5 00 00 00 00 00 00 00 00 00 00 00
                        29 01 00 00 00 00 0C D6 00 00 00 00 00 00 00 00 00 00 00
                        29 01 00 00 00 00 0C D7 00 00 00 00 00 00 00 00 00 00 00
                        29 01 00 00 00 00 06 D8 00 00 00 00 00
                        29 01 00 00 00 00 02 E5 06
                        29 01 00 00 00 00 02 E6 06
                        29 01 00 00 00 00 02 E7 00
                        29 01 00 00 00 00 02 E8 06
                        29 01 00 00 00 00 02 E9 06
                        29 01 00 00 00 00 02 EA 06
                        29 01 00 00 00 00 02 EB 00
                        29 01 00 00 00 00 02 EC 00
                        29 01 00 00 00 00 02 ED 30
                        
                        29 01 00 00 00 00 06 F0 55 AA 52 08 06
                        
                        29 01 00 00 00 00 03 B0 31 31
                        29 01 00 00 00 00 03 B1 31 31
                        29 01 00 00 00 00 03 B2 2D 2E
                        29 01 00 00 00 00 03 B3 31 34
                        29 01 00 00 00 00 03 B4 29 2A
                        29 01 00 00 00 00 03 B5 12 10
                        29 01 00 00 00 00 03 B6 18 16
                        29 01 00 00 00 00 03 B7 00 02
                        29 01 00 00 00 00 03 B8 08 31
                        29 01 00 00 00 00 03 B9 31 31
                        
                        29 01 00 00 00 00 03 BA 31 31
                        29 01 00 00 00 00 03 BB 31 08
                        29 01 00 00 00 00 03 BC 03 01
                        29 01 00 00 00 00 03 BD 17 19
                        29 01 00 00 00 00 03 BE 11 13
                        29 01 00 00 00 00 03 BF 2A 29
                        29 01 00 00 00 00 03 C0 34 31
                        29 01 00 00 00 00 03 C1 2E 2D
                        29 01 00 00 00 00 03 C2 31 31
                        29 01 00 00 00 00 03 C3 31 31
                        
                        29 01 00 00 00 00 03 C4 31 31
                        29 01 00 00 00 00 03 C5 31 31
                        29 01 00 00 00 00 03 C6 2E 2D
                        29 01 00 00 00 00 03 C7 31 34
                        29 01 00 00 00 00 03 C8 29 2A
                        29 01 00 00 00 00 03 C9 17 19
                        29 01 00 00 00 00 03 CA 11 13
                        29 01 00 00 00 00 03 CB 03 01
                        29 01 00 00 00 00 03 CC 08 31
                        29 01 00 00 00 00 03 CD 31 31
                        
                        29 01 00 00 00 00 03 CE 31 31
                        29 01 00 00 00 00 03 CF 31 08
                        29 01 00 00 00 00 03 D0 00 02
                        29 01 00 00 00 00 03 D1 12 10
                        29 01 00 00 00 00 03 D2 18 16
                        29 01 00 00 00 00 03 D3 2A 29
                        29 01 00 00 00 00 03 D4 34 31
                        29 01 00 00 00 00 03 D5 2D 2E
                        29 01 00 00 00 00 03 D6 31 31
                        29 01 00 00 00 00 03 D7 31 31
                        
                        29 01 00 00 00 00 03 E5 31 31
                        29 01 00 00 00 00 03 E6 31 31
                        
                        29 01 00 00 00 00 06 D8 00 00 00 00 00
                        29 01 00 00 00 00 06 D9 00 00 00 00 00
                        29 01 00 00 00 00 02 E7 00
                        
                        29 01 00 00 00 00 02 6F 02
                        29 01 00 00 00 00 02 F7 47
                        29 01 00 00 00 00 02 6F 0A
                        29 01 00 00 00 00 02 F7 02
                        29 01 00 00 00 00 02 6F 17
                        29 01 00 00 00 00 02 F4 60
                        
                        29 01 00 00 00 00 02 6F 01
                        29 01 00 00 00 00 02 F9 46
                        29 01 00 00 00 00 02 6F 11
                        29 01 00 00 00 00 02 F3 01
                        
                        29 01 00 00 00 00 02 35 00
                        
                        //CCMOFF
                        //CCMRUN
                        //Modify backlight leds's freq to 65.1kHz
                        29 01 00 00 00 00 06 F0 55 AA 52 08 00
                        29 01 00 00 00 00 04 D9 02 03 00
                        29 01 00 00 00 00 06 F0 55 AA 52 00 00

                        /*Disable HS mode MIPI can revice command for fix ESD isse*/
                        29 01 00 00 00 00 06 F0 55 AA 52 08 00
                        29 01 00 00 00 00 03 B1 6C 21
                        29 01 00 00 00 00 06 F0 55 AA 52 00 00
                        29 01 00 00 00 00 02 35 00

                        05 01 00 00 78 00 02 11 00
                        05 01 00 00 01 00 02 29 00
                        29 01 00 00 00 00 02 53 24

		];
		qcom,mdss-dsi-on-command-64 = [

				//Modify backlight leds's freq to 65.1kHz
				29 01 00 00 00 00 06 F0 55 AA 52 08 00
				29 01 00 00 00 00 04 D9 02 03 00
				29 01 00 00 00 00 06 F0 55 AA 52 00 00

				/*Disable HS mode MIPI can receive command that is avoid ESD issue*/
				29 01 00 00 00 00 06 F0 55 AA 52 08 00
				29 01 00 00 00 00 03 B1 6C 21
				29 01 00 00 00 00 06 F0 55 AA 52 00 00
				29 01 00 00 00 00 02 35 00

				05 01 00 00 78 00 02 11 00
				05 01 00 00 01 00 02 29 00
				29 01 00 00 00 00 02 53 24
		];

		qcom,mdss-dsi-off-command = [05 01 00 00 32 00 02 28 00
					05 01 00 00 96 00 02 10 00];
		qcom,mdss-dsi-on-command-state = "dsi_lp_mode";
		qcom,mdss-dsi-off-command-state = "dsi_hs_mode";
		qcom,mdss-dsi-h-sync-pulse = <1>;
		qcom,mdss-dsi-traffic-mode = "burst_mode";
		qcom,mdss-dsi-bllp-eof-power-mode;
		qcom,mdss-dsi-bllp-power-mode;
		qcom,mdss-dsi-lane-0-state;
		qcom,mdss-dsi-lane-1-state;
		qcom,mdss-dsi-lane-2-state;
		qcom,mdss-dsi-lane-3-state;
//		qcom,mdss-dsi-panel-timings = [93 1F 17 00 2F 2E 1C 21 26 03 04 00]; //420Mbps
		qcom,mdss-dsi-panel-timings =[D5 32 22 00 60 64 26 34 29 03 04 00];//800Mbsp
		qcom,mdss-dsi-panel-timings-lte =[94 20 14 00 46 4A 1A 24 18 03 04 00];//514Mbsp
		qcom,mdss-dsi-t-clk-post = <0x20>;
		qcom,mdss-dsi-t-clk-pre = <0x2D>;
		qcom,mdss-dsi-bl-min-level = <1>;
		qcom,mdss-dsi-bl-max-level = <255>;
		qcom,mdss-dsi-dma-trigger = "trigger_sw";
		qcom,mdss-dsi-mdp-trigger = "none";
		qcom,mdss-dsi-bl-pmic-control-type = "bl_ctrl_dcs";
		qcom,mdss-dsi-reset-sequence = <1 20>, <0 1>, <1 20>;

	};
};
