/* Copyright (c) 2013, The Linux Foundation. All rights reserved.
 * Copyright (C) 2014 Sony Mobile Communications AB.
 *
 * This program is free software; you can redistribute it and/or modify
 * it under the terms of the GNU General Public License version 2 and
 * only version 2 as published by the Free Software Foundation.
 *
 * This program is distributed in the hope that it will be useful,
 * but WITHOUT ANY WARRANTY; without even the implied warranty of
 * MERCHANTABILITY or FITNESS FOR A PARTICULAR PURPOSE.  See the
 * GNU General Public License for more details.
 *
 * NOTE: This file has been modified by Sony Mobile Communications AB.
 * Modifications are licensed under the License.
 */

/dts-v1/;
/include/ "msm8926.dtsi"
/include/ "msm8226-yukon_tianchi.dtsi"

/ {
	model = "SOMC TIANCHI";
	compatible = "somc,tianchi", "qcom,msm8926", "qcom,mtp";
	qcom,board-id = <8 0>;

	qcom,msm-id = <200 0>,
		      <224 0>,
		      <200 0x10001>,
		      <224 0x10001>;
};
