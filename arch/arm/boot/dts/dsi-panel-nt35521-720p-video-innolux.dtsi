/* Copyright (c) 2013, The Linux Foundation. All rights reserved.
 *
 * This program is free software; you can redistribute it and/or modify
 * it under the terms of the GNU General Public License version 2 and
 * only version 2 as published by the Free Software Foundation.
 *
 * This program is distributed in the hope that it will be useful,
 * but WITHOUT ANY WARRANTY; without even the implied warranty of
 * MERCHANTABILITY or FITNESS FOR A PARTICULAR PURPOSE.  See the
 * GNU General Public License for more details.
 */

/*---------------------------------------------------------------------------
 * This file is autogenerated file using gcdb parser. Please do not edit it.
 * Update input XML file to add a new entry or update variable in this file
 * VERSION = "1.0"
 *---------------------------------------------------------------------------*/
&mdss_mdp {
	dsi_nt35521_720_vid_innolux: qcom,mdss_dsi_nt35521_720p_video_innolux {
		compatible = "qcom,mdss-dsi-panel-innolux";
		qcom,mdss-dsi-panel-name = "nt35521 720p video mode dsi panel innolux";
		qcom,mdss-dsi-panel-controller = <&mdss_dsi0>;
		qcom,mdss-dsi-panel-type = "dsi_video_mode";
		qcom,mdss-dsi-panel-destination = "display_1";
		qcom,mdss-dsi-panel-framerate = <60>;
		qcom,mdss-dsi-virtual-channel-id = <0>;
		qcom,mdss-dsi-stream = <0>;
		qcom,mdss-pan-physical-width-dimension = <65>;
		qcom,mdss-pan-physical-height-dimension = <116>;
		qcom,mdss-dsi-panel-width = <720>;
		qcom,mdss-dsi-panel-height = <1280>;
		qcom,mdss-dsi-h-front-porch = <632>; //800Mbps
		qcom,mdss-dsi-h-back-porch = <295>; //800Mbps
		qcom,mdss-dsi-h-pulse-width = <40>; //800Mbps
//		qcom,mdss-dsi-h-front-porch = <114>; //420Mbps
//		qcom,mdss-dsi-h-back-porch = <50>; //420Mbps
//		qcom,mdss-dsi-h-pulse-width = <10>; //420Mbps
		qcom,mdss-dsi-h-sync-skew = <0>;
		qcom,mdss-dsi-v-back-porch = <18>;
		qcom,mdss-dsi-v-front-porch = <18>;
		qcom,mdss-dsi-v-pulse-width = <1>;
		qcom,mdss-dsi-h-left-border = <0>;
		qcom,mdss-dsi-h-right-border = <0>;
		qcom,mdss-dsi-v-top-border = <0>;
		qcom,mdss-dsi-v-bottom-border = <0>;
		qcom,mdss-dsi-bpp = <24>;
		qcom,mdss-dsi-color-order = <0>;
		qcom,mdss-dsi-underflow-color = <0xff>;
		qcom,mdss-dsi-border-color = <0>;
		qcom,mdss-dsi-pixel-packing = <0>;
		qcom,mdss-dsi-on-command-65 = [

		//Date:20140221
						29 01 00 00 00 00 05 FF AA 55 A5 80
						29 01 00 00 00 00 03 6F 11 00
						29 01 00 00 00 00 03 F7 20 00
						29 01 00 00 00 00 02 6F 06
						29 01 00 00 00 00 02 F7 A0
						29 01 00 00 00 00 02 6F 19
						29 01 00 00 00 00 02 F7 12
		
						29 01 00 00 00 00 06 F0 55 AA 52 08 00
						29 01 00 00 00 00 02 C8 83
		
						29 01 00 00 00 00 03 B1 6C 21
		
						29 01 00 00 00 00 02 B6 08
		
						29 01 00 00 00 00 02 6F 02
						29 01 00 00 00 00 02 B8 08
		
						29 01 00 00 00 00 03 BB 74 44
		
						29 01 00 00 00 00 03 BC 00 00
		
						29 01 00 00 00 00 06 BD 01 AC 10 10 01
		
						29 01 00 00 00 00 03 C5 01 07
		
						29 01 00 00 00 00 06 F0 55 AA 52 08 01
		
						29 01 00 00 00 00 03 B0 05 05
						29 01 00 00 00 00 03 B1 05 05
		
						29 01 00 00 00 00 03 BC A0 01
						29 01 00 00 00 00 03 BD A0 01
		
						29 01 00 00 00 00 02 CA 00
		
						29 01 00 00 00 00 02 C0 04
		
						29 01 00 00 00 00 02 BE 51
		
						29 01 00 00 00 00 03 B3 37 37
						29 01 00 00 00 00 03 B4 0F 0F
		
						29 01 00 00 00 00 03 B9 46 46
						29 01 00 00 00 00 03 BA 24 24
						//=======================================Page2
						29 01 00 00 00 00 06 F0 55 AA 52 08 02
		
						29 01 00 00 00 00 02 EE 01
						29 01 00 00 00 00 05 EF 09 06 15 18
		
						29 01 00 00 00 00 07 B0 00 00 00 1D 00 46
						29 01 00 00 00 00 02 6F 06
						29 01 00 00 00 00 07 B0 00 5C 00 71 00 9F
						29 01 00 00 00 00 02 6F 0C
						29 01 00 00 00 00 05 B0 00 C6 01 00
						29 01 00 00 00 00 07 B1 01 30 01 78 01 B2
						29 01 00 00 00 00 02 6F 06
						29 01 00 00 00 00 07 B1 02 0C 02 53 02 55
						29 01 00 00 00 00 02 6F 0C
						29 01 00 00 00 00 05 B1 02 98 02 E4
						29 01 00 00 00 00 07 B2 03 0D 03 4B 03 7C
						29 01 00 00 00 00 02 6F 06
						29 01 00 00 00 00 07 B2 03 9D 03 B7 03 D0
						29 01 00 00 00 00 02 6F 0C
						29 01 00 00 00 00 05 B2 03 DE 03 E2
						29 01 00 00 00 00 05 B3 03 F0 03 F2
						//=======================================Page2
		
						29 01 00 00 00 00 06 F0 55 AA 52 08 06
						29 01 00 00 00 00 03 B0 29 2A
						29 01 00 00 00 00 03 B1 10 12
						29 01 00 00 00 00 03 B2 14 16
						29 01 00 00 00 00 03 B3 18 1A
						29 01 00 00 00 00 03 B4 08 0A
						29 01 00 00 00 00 03 B5 2E 2E
						29 01 00 00 00 00 03 B6 2E 2E
						29 01 00 00 00 00 03 B7 2E 2E
						29 01 00 00 00 00 03 B8 2E 00
						29 01 00 00 00 00 03 B9 2E 2E
						29 01 00 00 00 00 03 BA 2E 2E
						29 01 00 00 00 00 03 BB 01 2E
						29 01 00 00 00 00 03 BC 2E 2E
						29 01 00 00 00 00 03 BD 2E 2E
						29 01 00 00 00 00 03 BE 2E 2E
						29 01 00 00 00 00 03 BF 0B 09
						29 01 00 00 00 00 03 C0 1B 19
						29 01 00 00 00 00 03 C1 17 15
						29 01 00 00 00 00 03 C2 13 11
						29 01 00 00 00 00 03 C3 2A 29
						29 01 00 00 00 00 03 E5 2E 2E
		
						29 01 00 00 00 00 03 C4 29 2A
						29 01 00 00 00 00 03 C5 1B 19
						29 01 00 00 00 00 03 C6 17 15
						29 01 00 00 00 00 03 C7 13 11
						29 01 00 00 00 00 03 C8 01 0B
						29 01 00 00 00 00 03 C9 2E 2E
						29 01 00 00 00 00 03 CA 2E 2E
						29 01 00 00 00 00 03 CB 2E 2E
						29 01 00 00 00 00 03 CC 2E 09
						29 01 00 00 00 00 03 CD 2E 2E
						29 01 00 00 00 00 03 CE 2E 2E
						29 01 00 00 00 00 03 CF 08 2E
						29 01 00 00 00 00 03 D0 2E 2E
						29 01 00 00 00 00 03 D1 2E 2E
						29 01 00 00 00 00 03 D2 2E 2E
						29 01 00 00 00 00 03 D3 0A 00
						29 01 00 00 00 00 03 D4 10 12
						29 01 00 00 00 00 03 D5 14 16
						29 01 00 00 00 00 03 D6 18 1A
						29 01 00 00 00 00 03 D7 2A 29
						29 01 00 00 00 00 03 E6 2E 2E
						29 01 00 00 00 00 06 D8 00 00 00 00 00
						29 01 00 00 00 00 06 D9 00 00 00 00 00
						29 01 00 00 00 00 02 E7 00
		
						29 01 00 00 00 00 06 F0 55 AA 52 08 03
						29 01 00 00 00 00 03 B0 00 00
						29 01 00 00 00 00 03 B1 00 00
						29 01 00 00 00 00 06 B2 05 00 00 00 00
		
						29 01 00 00 00 00 06 B6 05 00 00 00 00
						29 01 00 00 00 00 06 B7 05 00 00 00 00
		
						29 01 00 00 00 00 06 BA 57 00 00 00 00
						29 01 00 00 00 00 06 BB 57 00 00 00 00
		
						29 01 00 00 00 00 05 C0 00 00 00 00
						29 01 00 00 00 00 05 C1 00 00 00 00
		
						29 01 00 00 00 00 02 C4 60
						29 01 00 00 00 00 02 C5 40
		
						29 01 00 00 00 00 06 F0 55 AA 52 08 05
						29 01 00 00 00 00 06 BD 03 01 03 03 03
						29 01 00 00 00 00 03 B0 17 06
						29 01 00 00 00 00 03 B1 17 06
						29 01 00 00 00 00 03 B2 17 06
						29 01 00 00 00 00 03 B3 17 06
						29 01 00 00 00 00 03 B4 17 06
						29 01 00 00 00 00 03 B5 17 06
		
						29 01 00 00 00 00 02 B8 00
						29 01 00 00 00 00 02 B9 00
						29 01 00 00 00 00 02 BA 00
						29 01 00 00 00 00 02 BB 02
						29 01 00 00 00 00 02 BC 00
		
						29 01 00 00 00 00 02 C0 07
		
						29 01 00 00 00 00 02 C4 80
						29 01 00 00 00 00 02 C5 A4
		
						29 01 00 00 00 00 03 C8 05 30
						29 01 00 00 00 00 03 C9 01 31
		
						29 01 00 00 00 00 04 CC 00 00 3C
						29 01 00 00 00 00 04 CD 00 00 3C
		
						29 01 00 00 00 00 06 D1 00 05 09 07 10
						29 01 00 00 00 00 06 D2 00 05 0E 07 10
		
						29 01 00 00 00 00 02 E5 06
						29 01 00 00 00 00 02 E6 06
						29 01 00 00 00 00 02 E7 06
						29 01 00 00 00 00 02 E8 06
						29 01 00 00 00 00 02 E9 06
						29 01 00 00 00 00 02 EA 06
		
						29 01 00 00 00 00 02 ED 30
		
						29 01 00 00 00 00 02 6F 11
						29 01 00 00 00 00 02 F3 01
		
						29 01 00 00 00 00 02 35 00

                //Modify backlight leds's freq to 65.1kHz
                29 01 00 00 00 00 06 F0 55 AA 52 08 00
                29 01 00 00 00 00 04 D9 02 03 00
                29 01 00 00 00 00 06 F0 55 AA 52 00 00
                
                /*Disable HS mode MIPI can revice command for fix ESD isse*/
                29 01 00 00 00 00 06 F0 55 AA 52 08 00
                29 01 00 00 00 00 03 B1 6C 21
                29 01 00 00 00 00 06 F0 55 AA 52 00 00
                29 01 00 00 00 00 02 35 00

                05 01 00 00 78 00 02 11 00
                05 01 00 00 00 00 02 29 00
                29 01 00 00 00 00 02 53 24
		];

		qcom,mdss-dsi-on-command-66 = [

				//Modify backlight leds's freq to 65.1kHz
				29 01 00 00 00 00 06 F0 55 AA 52 08 00
				29 01 00 00 00 00 04 D9 02 03 00
				29 01 00 00 00 00 06 F0 55 AA 52 00 00

				/*Disable HS mode MIPI can receive command that is avoid ESD issue*/
				29 01 00 00 00 00 06 F0 55 AA 52 08 00
				29 01 00 00 00 00 03 B1 6C 21
				29 01 00 00 00 00 06 F0 55 AA 52 00 00
				29 01 00 00 00 00 02 35 00

				05 01 00 00 78 00 02 11 00
				05 01 00 00 01 00 02 29 00
				29 01 00 00 00 00 02 53 24
		];

		qcom,mdss-dsi-off-command = [05 01 00 00 32 00 02 28 00
					05 01 00 00 96 00 02 10 00];
		qcom,mdss-dsi-on-command-state = "dsi_lp_mode";
		qcom,mdss-dsi-off-command-state = "dsi_hs_mode";
		qcom,mdss-dsi-h-sync-pulse = <1>;
		qcom,mdss-dsi-traffic-mode = <2>;
		qcom,mdss-dsi-lane-map = <0>;
		qcom,mdss-dsi-bllp-eof-power-mode;
		qcom,mdss-dsi-bllp-power-mode;
		qcom,mdss-dsi-lane-0-state;
		qcom,mdss-dsi-lane-1-state;
		qcom,mdss-dsi-lane-2-state;
		qcom,mdss-dsi-lane-3-state;
//		qcom,mdss-dsi-panel-timings = [93 1F 17 00 2F 2E 1C 21 26 03 04 00]; //420Mbps
		qcom,mdss-dsi-panel-timings =[D5 32 22 00 60 64 26 34 29 03 04 00];//800Mbsp
		qcom,mdss-dsi-t-clk-post = <0x20>;
		qcom,mdss-dsi-t-clk-pre = <0x2D>;
		qcom,mdss-dsi-bl-min-level = <1>;
		qcom,mdss-dsi-bl-max-level = <255>;
		qcom,mdss-dsi-dma-trigger = <4>;
		qcom,mdss-dsi-mdp-trigger = <0>;
		qcom,mdss-dsi-bl-pmic-control-type = "bl_ctrl_dcs";
		qcom,mdss-dsi-reset-sequence = <1 20>, <0 1>, <1 20>;

	};
};
