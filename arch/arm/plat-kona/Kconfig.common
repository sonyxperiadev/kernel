## arch/sh/configs/ul2_defconfig
```kconfig
CONFIG_EXPERIMENTAL=y
CONFIG_SYSVIPC=y
CONFIG_BSD_PROCESS_ACCT=y
CONFIG_IKCONFIG=y
CONFIG_IKCONFIG_PROC=y
CONFIG_LOG_BUF_SHIFT=14
CONFIG_BLK_DEV_INITRD=y
CONFIG_PROFILING=y
CONFIG_MODULES=y
CONFIG_MODULE_UNLOAD=y
# CONFIG_BLK_DEV_BSG is not set
# CONFIG_IOSCHED_DEADLINE is not set
# CONFIG_IOSCHED_CFQ is not set
CONFIG_CPU_SUBTYPE_SH7366=y
CONFIG_MEMORY_SIZE=0x01f00000
CONFIG_NUMA=y
# CONFIG_MIGRATION is not set
# CONFIG_SH_DSP is not set
# CONFIG_SH_TIMER_CMT is not set
CONFIG_HIGH_RES_TIMERS=y
CONFIG_HZ_100=y
CONFIG_KEXEC=y
CONFIG_PREEMPT=y
CONFIG_CMDLINE_OVERWRITE=y
CONFIG_CMDLINE="console=ttySC0,115200 root=/dev/nfs ip=dhcp"
CONFIG_NET=y
CONFIG_PACKET=y
CONFIG_UNIX=y
CONFIG_INET=y
CONFIG_IP_PNP=y
CONFIG_IP_PNP_DHCP=y
# CONFIG_INET_LRO is not set
# CONFIG_IPV6 is not set
CONFIG_CFG80211=y
CONFIG_MAC80211=y
CONFIG_MAC80211_RC_PID=y
# CONFIG_MAC80211_RC_MINSTREL is not set
CONFIG_UEVENT_HELPER_PATH="/sbin/hotplug"
CONFIG_MTD=y
CONFIG_MTD_CONCAT=y
CONFIG_MTD_PARTITIONS=y
CONFIG_MTD_CHAR=y
CONFIG_MTD_BLOCK=y
CONFIG_MTD_CFI=y
CONFIG_MTD_CFI_AMDSTD=y
CONFIG_MTD_RAM=y
CONFIG_BLK_DEV_RAM=y
CONFIG_BLK_DEV_SD=y
CONFIG_ATA=y
CONFIG_PATA_PLATFORM=y
CONFIG_NETDEVICES=y
CONFIG_NET_ETHERNET=y
# CONFIG_NETDEV_1000 is not set
# CONFIG_NETDEV_10000 is not set
CONFIG_LIBERTAS=m
CONFIG_LIBERTAS_SDIO=m
CONFIG_LIBERTAS_DEBUG=y
CONFIG_USB_USBNET=y
# CONFIG_USB_NET_NET1080 is not set
# CONFIG_USB_NET_CDC_SUBSET is not set
# CONFIG_USB_NET_ZAURUS is not set
# CONFIG_INPUT_MOUSEDEV is not set
# CONFIG_INPUT_KEYBOARD is not set
# CONFIG_INPUT_MOUSE is not set
# CONFIG_SERIO is not set
# CONFIG_VT is not set
CONFIG_SERIAL_SH_SCI=y
CONFIG_SERIAL_SH_SCI_NR_UARTS=1
CONFIG_SERIAL_SH_SCI_CONSOLE=y
# CONFIG_UNIX98_PTYS is not set
# CONFIG_LEGACY_PTYS is not set
# CONFIG_IPMI_HANDLER is not set
CONFIG_HW_RANDOM=y
CONFIG_HW_RANDOM_BCMHANA=y
# CONFIG_HW_RANDOM_TIMERIOMEM is not set
# CONFIG_R3964 is not set
# CONFIG_RAW_DRIVER is not set
# CONFIG_TCG_TPM is not set
# CONFIG_I2C is not set
# CONFIG_SPI is not set

#
# PPS support
#
# CONFIG_PPS is not set
# CONFIG_W1 is not set
# CONFIG_POWER_SUPPLY is not set
CONFIG_HWMON=y
# CONFIG_HWMON_VID is not set
# CONFIG_HWMON_DEBUG_CHIP is not set

#
# Native drivers
#
# CONFIG_SENSORS_F71805F is not set
# CONFIG_SENSORS_F71882FG is not set
# CONFIG_SENSORS_IT87 is not set
# CONFIG_SENSORS_PC87360 is not set
# CONFIG_SENSORS_PC87427 is not set
# CONFIG_SENSORS_SMSC47M1 is not set
# CONFIG_SENSORS_SMSC47B397 is not set
# CONFIG_SENSORS_VT1211 is not set
# CONFIG_SENSORS_W83627HF is not set
# CONFIG_SENSORS_W83627EHF is not set
# CONFIG_THERMAL is not set
# CONFIG_WATCHDOG is not set
CONFIG_SSB_POSSIBLE=y

#
# Sonics Silicon Backplane
#
# CONFIG_SSB is not set

#
# Multifunction device drivers
#
# CONFIG_MFD_CORE is not set
# CONFIG_MFD_SM501 is not set
# CONFIG_MFD_SH_MOBILE_SDHI is not set
# CONFIG_HTC_PASIC3 is not set
# CONFIG_MFD_TMIO is not set
# CONFIG_REGULATOR is not set
# CONFIG_MEDIA_SUPPORT is not set

#
# Graphics support
#
# CONFIG_VGASTATE is not set
# CONFIG_VIDEO_OUTPUT_CONTROL is not set
# CONFIG_FB is not set
# CONFIG_BACKLIGHT_LCD_SUPPORT is not set

#
# Display device support
#
# CONFIG_DISPLAY_SUPPORT is not set
# CONFIG_SOUND is not set
# CONFIG_HID_SUPPORT is not set
CONFIG_USB=y
CONFIG_USB_MON=y
CONFIG_USB_R8A66597_HCD=y
CONFIG_USB_STORAGE=y
CONFIG_MMC=y
CONFIG_EXT2_FS=y
CONFIG_EXT3_FS=y
# CONFIG_EXT3_DEFAULTS_TO_ORDERED is not set
CONFIG_VFAT_FS=y
CONFIG_PROC_KCORE=y
CONFIG_TMPFS=y
CONFIG_HUGETLBFS=y
CONFIG_CRAMFS=y
CONFIG_NFS_FS=y
CONFIG_ROOT_NFS=y
CONFIG_NFSD=y
CONFIG_NLS_CODEPAGE_437=y
CONFIG_NLS_CODEPAGE_932=y
CONFIG_NLS_ISO8859_1=y
# CONFIG_ENABLE_WARN_DEPRECATED is not set
# CONFIG_ENABLE_MUST_CHECK is not set
# CONFIG_RCU_CPU_STALL_DETECTOR is not set
CONFIG_CRYPTO_MICHAEL_MIC=y
# CONFIG_CRYPTO_ANSI_CPRNG is not set
```

## backports/Kconfig
```kconfig
config BACKPORT_INTEGRATE
	bool
	def_bool y

config BACKPORT_DIR
	string
	default "backports/"

config BACKPORT_VERSION
	string
	default "v4.19-rc5-1-1-g17729e9d"

config BACKPORT_KERNEL_VERSION
	string
	default "v4.19-rc4-0-g7876320f8880"

config BACKPORT_KERNEL_NAME
	string
	default "Linux"

menuconfig BACKPORT_LINUX
	bool "Backport Linux v4.19-rc4-0-g7876320f8880 (backports v4.19-rc5-1-1-g17729e9d)"
	default n
	---help---
	  Enabling this will let give you the opportunity to use features and
	  drivers backported from Linux v4.19-rc4-0-g7876320f8880
	  on the kernel your are using. This is experimental and you should
	  say no unless you'd like to help test things or want to help debug
	  this should we run into any issues.

if BACKPORT_LINUX

source "$BACKPORT_DIR/Kconfig.versions"
source "$BACKPORT_DIR/Kconfig.sources"
# source "$BACKPORT_DIR/Kconfig.local"

endif # BACKPORT_LINUX
```

## backports/Kconfig.versions
```kconfig
config BACKPORT_KERNEL_4_10
    def_bool y
config BACKPORT_KERNEL_4_12
    def_bool y
config BACKPORT_KERNEL_4_18
    def_bool y
config BACKPORT_KERNEL_4_19
    def_bool y
```

## backports/compat/Kconfig
```kconfig
#
# backport Kconfig
#
# Some options are user-selectable ("BPAUTO_USERSEL_*")
#
# Most options, however, follow a few different schemes:
#
# A) An option that is selected by drivers ("select FOO") will be
#    changed to "select BPAUTO_FOO" (if the option BPAUTO_FOO
#    exists). The option BPAUTO_FOO then controls setting of the
#    BPAUTO_BUILD_FOO option, which is a module, like this:
#
# config BPAUTO_BUILD_FOO
#	tristate
#	# or bool
#
#	# not possible on kernel < X.Y, build will fail if any
#	# drivers are allowed to build on kernels < X.Y
#	depends on KERNEL_X_Y
#
#	# don't build the backport code if FOO is in the kernel
#	# already, but only if the kernel version is also >= X.Z;
#	# this is an example of backporting where the version of
#	# the FOO subsystem that we need is only available from
#	# kernel version X.Z
#	depends on !FOO || KERNEL_X_Z
#
#	# build if driver needs it (it selects BPAUTO_FOO)
#	default m if BPAUTO_FOO
#
#	# or for build-testing (BPAUTO_USERSEL_BUILD_ALL is enabled)
#	default m if BACKPORT_BPAUTO_USERSEL_BUILD_ALL
#
# config BPAUTO_FOO
#	bool
#
# This only works as-is if the kernel code is usable on any version,
# otherwise the "&& !FOO" part needs to be different.
#
#
# B) An option for code always present on some kernels (e.g. KFIFO).
#    This simply depends on/sets the default based on the version:
#
# config BPAUTO_BUILD_KFIFO
#	def_bool y
#	depends on KERNEL_2_6_36
#
#
# C) similarly, a kconfig symbol for an option, e.g.
#    BPAUTO_OPTION_SOME_FIX (no examples provided) check git log
#
#
# Variations are obviously possible.
#

config BACKPORT_BP_MODULES
	option modules
	depends on !BP_MODULES
	bool
	default MODULES

	help
	This symbol is necessary for the newer kconf tool, it looks
	for the "option modules" to control the 'm' state.

config BACKPORT_BPAUTO_BUILD_CORDIC
	tristate
	depends on !BPAUTO_BUILD_CORDIC
	depends on !CORDIC
	depends on KERNEL_3_1
	default m if BACKPORT_BPAUTO_CORDIC
	default m if BACKPORT_BPAUTO_USERSEL_BUILD_ALL
	#module-name cordic
	#c-file lib/cordic.c

config BACKPORT_BPAUTO_CORDIC
	bool
	depends on !BPAUTO_CORDIC

config BACKPORT_BPAUTO_MII
	bool
	depends on !BPAUTO_MII

config BACKPORT_BPAUTO_BUILD_LEDS
	bool
	depends on !BPAUTO_BUILD_LEDS
	depends on !NEW_LEDS || LEDS_CLASS=n || !LEDS_TRIGGERS
	default y if BACKPORT_BPAUTO_NEW_LEDS
	default y if BACKPORT_BPAUTO_LEDS_CLASS
	default y if BACKPORT_BPAUTO_LEDS_TRIGGERS

config BACKPORT_BPAUTO_NEW_LEDS
	bool
	depends on !BPAUTO_NEW_LEDS

config BACKPORT_BPAUTO_LEDS_CLASS
	bool
	depends on !BPAUTO_LEDS_CLASS

config BACKPORT_BPAUTO_LEDS_TRIGGERS
	bool
	depends on !BPAUTO_LEDS_TRIGGERS

config BACKPORT_BPAUTO_USERSEL_BUILD_ALL
	bool "Build all compat code"
	depends on !BPAUTO_USERSEL_BUILD_ALL
	help
	  This option selects all the compat code options
	  that would otherwise only be selected by drivers.

	  It's only really useful for compat testing, so
	  you probably shouldn't enable it.

config BACKPORT_BPAUTO_CRYPTO_SKCIPHER
	tristate
	depends on !BPAUTO_CRYPTO_SKCIPHER
	depends on KERNEL_4_3
	default y if BACKPORTED_LIB80211_CRYPT_WEP
	default y if BACKPORTED_LIB80211_CRYPT_TKIP
	#c-file crypto/skcipher.c
	#module-name skcipher

config BACKPORT_BPAUTO_WANT_DEV_COREDUMP
	bool
	depends on !BPAUTO_WANT_DEV_COREDUMP

config BACKPORT_BPAUTO_BUILD_WANT_DEV_COREDUMP
	bool
	depends on !BPAUTO_BUILD_WANT_DEV_COREDUMP
	default n if DEV_COREDUMP
	default n if DISABLE_DEV_COREDUMP
	default y if BACKPORT_BPAUTO_WANT_DEV_COREDUMP
	#h-file linux/devcoredump.h
	#c-file drivers/base/devcoredump.c

config BACKPORT_BPAUTO_RHASHTABLE
	bool
	depends on !BPAUTO_RHASHTABLE
	# current API of rhashtable was introduced in version 4.9
	# (the one including rhltable)
	depends on KERNEL_4_9
	# not very nice - but better than always having it
	default y if BACKPORTED_MAC80211
	#h-file linux/rhashtable.h
	#h-file linux/rhashtable-types.h
	#c-file lib/rhashtable.c

config BACKPORT_BPAUTO_BUCKET_LOCKS
	bool
	depends on !BPAUTO_BUCKET_LOCKS
	# the API of bucket_locks that we need was introduced in version 4.16
	depends on KERNEL_4_16
	default y if BACKPORT_BPAUTO_RHASHTABLE
	#c-file lib/bucket_locks.c

config BACKPORT_BPAUTO_REFCOUNT
	bool
	depends on !BPAUTO_REFCOUNT
	default y
	depends on KERNEL_4_11
	#h-file linux/refcount.h
	#c-file lib/refcount.c

config BACKPORT_BPAUTO_SYSTEM_DATA_VERIFICATION
	bool
	depends on !BPAUTO_SYSTEM_DATA_VERIFICATION

config BACKPORT_BPAUTO_BUILD_SYSTEM_DATA_VERIFICATION
	bool
	depends on !BPAUTO_BUILD_SYSTEM_DATA_VERIFICATION
	default y if BACKPORT_BPAUTO_SYSTEM_DATA_VERIFICATION
	depends on KERNEL_4_7 || !SYSTEM_DATA_VERIFICATION
	select BACKPORT_BPAUTO_ASN1_DECODER
	select BACKPORT_BPAUTO_PUBLIC_KEY
	select BACKPORT_BPAUTO_PKCS7
	#h-file linux/oid_registry.h
	#c-file lib/oid_registry.c

config BACKPORT_BPAUTO_PUBLIC_KEY
	bool
	depends on !BPAUTO_PUBLIC_KEY
	#h-file crypto/public_key.h

config BACKPORT_BPAUTO_ASN1_DECODER
	bool
	depends on !BPAUTO_ASN1_DECODER
	#h-file linux/asn1_decoder.h
	#c-file lib/asn1_decoder.c

config BACKPORT_BPAUTO_PKCS7
	bool
	depends on !BPAUTO_PKCS7
	#h-file crypto/pkcs7.h
```

## backports/drivers/bcma/Kconfig
```kconfig
# SPDX-License-Identifier: GPL-2.0
config BACKPORT_BCMA_POSSIBLE
	bool
	depends on !BCMA_POSSIBLE
	depends on HAS_IOMEM && HAS_DMA
	default y

menuconfig BACKPORT_BCMA
	tristate "Broadcom specific AMBA"
	depends on !BCMA
	depends on BACKPORT_BCMA_POSSIBLE
	help
	  Bus driver for Broadcom specific Advanced Microcontroller Bus
	  Architecture.

if BACKPORT_BCMA

# Support for Block-I/O. SELECT this from the driver that needs it.
config BACKPORT_BCMA_BLOCKIO
	bool
	depends on !BCMA_BLOCKIO

config BACKPORT_BCMA_HOST_PCI_POSSIBLE
	bool
	depends on !BCMA_HOST_PCI_POSSIBLE
	depends on PCI = y
	default y

config BACKPORT_BCMA_HOST_PCI
	bool "Support for BCMA on PCI-host bus"
	depends on !BCMA_HOST_PCI
	depends on BACKPORT_BCMA_HOST_PCI_POSSIBLE
	select BACKPORT_BCMA_DRIVER_PCI
	default y

config BACKPORT_BCMA_HOST_SOC
	bool "Support for BCMA in a SoC"
	depends on !BCMA_HOST_SOC
	depends on HAS_IOMEM
	help
	  Host interface for a Broadcom AIX bus directly mapped into
	  the memory. This only works with the Broadcom SoCs from the
	  BCM47XX line.

	  If unsure, say N

config BACKPORT_BCMA_DRIVER_PCI
	bool "BCMA Broadcom PCI core driver"
	depends on !BCMA_DRIVER_PCI
	depends on PCI
	default y
	help
	  BACKPORT_BCMA bus may have many versions of PCIe core. This driver
	  supports:
	  1) PCIe core working in clientmode
	  2) PCIe Gen 2 clientmode core

	  In general PCIe (Gen 2) clientmode core is required on PCIe
	  hosted buses. It's responsible for initialization and basic
	  hardware management.
	  This driver is also prerequisite for a hostmode PCIe core
	  support.

config BACKPORT_BCMA_DRIVER_PCI_HOSTMODE
	bool "Driver for PCI core working in hostmode"
	depends on !BCMA_DRIVER_PCI_HOSTMODE
	depends on MIPS && BACKPORT_BCMA_DRIVER_PCI && PCI_DRIVERS_LEGACY && BACKPORT_BCMA = y
	help
	  PCI core hostmode operation (external PCI bus).

config BACKPORT_BCMA_DRIVER_MIPS
	bool "BCMA Broadcom MIPS core driver"
	depends on !BCMA_DRIVER_MIPS
	depends on MIPS || COMPILE_TEST
	help
	  Driver for the Broadcom MIPS core attached to Broadcom specific
	  Advanced Microcontroller Bus.

	  If unsure, say N

config BACKPORT_BCMA_PFLASH
	bool
	depends on !BCMA_PFLASH
	depends on BACKPORT_BCMA_DRIVER_MIPS
	default y

config BACKPORT_BCMA_SFLASH
	bool "ChipCommon-attached serial flash support"
	depends on !BCMA_SFLASH
	depends on BACKPORT_BCMA_HOST_SOC
	default y
	help
	  Some cheap devices have serial flash connected to the ChipCommon
	  instead of independent SPI controller. It requires using a separated
	  driver that implements ChipCommon specific interface communication.

	  Enabling this symbol will let bcma recognize serial flash and register
	  it as platform device.

config BACKPORT_BCMA_NFLASH
	bool
	depends on !BCMA_NFLASH
	depends on BACKPORT_BCMA_DRIVER_MIPS
	default y

config BACKPORT_BCMA_DRIVER_GMAC_CMN
	bool "BCMA Broadcom GBIT MAC COMMON core driver"
	depends on !BCMA_DRIVER_GMAC_CMN
	help
	  Driver for the Broadcom GBIT MAC COMMON core attached to Broadcom
	  specific Advanced Microcontroller Bus.

	  If unsure, say N

config BACKPORT_BCMA_DRIVER_GPIO
	bool "BCMA GPIO driver"
	depends on !BCMA_DRIVER_GPIO
	depends on GPIOLIB
	select GPIOLIB_IRQCHIP if BACKPORT_BCMA_HOST_SOC
	help
	  Driver to provide access to the GPIO pins of the bcma bus.

	  If unsure, say N

config BACKPORT_BCMA_DEBUG
	bool "BCMA debugging"
	depends on !BCMA_DEBUG
	help
	  This turns on additional debugging messages.

	  If unsure, say N

endif # BACKPORT_BCMA
```
