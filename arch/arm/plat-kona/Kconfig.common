## backports/drivers/net/wireless/Kconfig
```kconfig
#
# Wireless LAN device configuration
#

menuconfig BACKPORT_WLAN
	bool "Wireless LAN"
	depends on !WLAN
	depends on !S390
	depends on NET
	depends on WIRELESS
	default y
	---help---
	  This section contains all the pre 802.11 and 802.11 wireless
	  device drivers. For a complete list of drivers and documentation
	  on them refer to the wireless wiki:

	  http://wireless.kernel.org/en/users/Drivers

if BACKPORT_WLAN

config BACKPORT_WIRELESS_WDS
	bool "mac80211-based legacy WDS support" if EXPERT
	depends on !WIRELESS_WDS
	help
	  This option enables the deprecated WDS support, the newer
	  mac80211-based 4-addr AP/client support supersedes it with
	  a much better feature set (HT, VHT, ...)

	  We plan to remove this option and code, so if you find
	  that you have to enable it, please let us know on the
	  linux-wireless@vger.kernel.org mailing list, so we can
	  help you migrate to 4-addr AP/client (or, if it's really
	  necessary, give up on our plan of removing it).

source "$BACKPORT_DIR/drivers/net/wireless/admtek/Kconfig"
source "$BACKPORT_DIR/drivers/net/wireless/ath/Kconfig"
source "$BACKPORT_DIR/drivers/net/wireless/atmel/Kconfig"
source "$BACKPORT_DIR/drivers/net/wireless/broadcom/Kconfig"
source "$BACKPORT_DIR/drivers/net/wireless/cisco/Kconfig"
source "$BACKPORT_DIR/drivers/net/wireless/intel/Kconfig"
source "$BACKPORT_DIR/drivers/net/wireless/intersil/Kconfig"
source "$BACKPORT_DIR/drivers/net/wireless/marvell/Kconfig"
source "$BACKPORT_DIR/drivers/net/wireless/mediatek/Kconfig"
source "$BACKPORT_DIR/drivers/net/wireless/ralink/Kconfig"
source "$BACKPORT_DIR/drivers/net/wireless/realtek/Kconfig"
source "$BACKPORT_DIR/drivers/net/wireless/rsi/Kconfig"
source "$BACKPORT_DIR/drivers/net/wireless/st/Kconfig"
source "$BACKPORT_DIR/drivers/net/wireless/ti/Kconfig"
source "$BACKPORT_DIR/drivers/net/wireless/zydas/Kconfig"
source "$BACKPORT_DIR/drivers/net/wireless/quantenna/Kconfig"

config BACKPORT_PCMCIA_RAYCS
	depends on n
	tristate "Aviator/Raytheon 2.4GHz wireless support"
	depends on !PCMCIA_RAYCS
	depends on PCMCIA
	depends on WIRELESS_EXT
	depends on WEXT_SPY
	depends on WEXT_PRIV
	---help---
	  Say Y here if you intend to attach an Aviator/Raytheon PCMCIA
	  (PC-card) wireless Ethernet networking card to your computer.
	  Please read the file <file:Documentation/networking/ray_cs.txt> for
	  details.

	  To compile this driver as a module, choose M here: the module will be
	  called ray_cs.  If unsure, say N.

config BACKPORT_PCMCIA_WL3501
	depends on n
	tristate "Planet WL3501 PCMCIA cards"
	depends on !PCMCIA_WL3501
	depends on BACKPORT_CFG80211 && PCMCIA
	depends on WIRELESS_EXT
	depends on WEXT_SPY
	help
	  A driver for WL3501 PCMCIA 802.11 wireless cards made by Planet.
	  It has basic support for Linux wireless extensions and initial
	  micro support for ethtool.

config BACKPORT_MAC80211_HWSIM
	tristate "Simulated radio testing tool for mac80211"
	depends on !MAC80211_HWSIM
	depends on BACKPORT_MAC80211
	---help---
	  This driver is a developer testing tool that can be used to test
	  IEEE 802.11 networking stack (mac80211) functionality. This is not
	  needed for normal wireless LAN usage and is only for testing. See
	  Documentation/networking/mac80211_hwsim for more information on how
	  to use this tool.

	  To compile this driver as a module, choose M here: the module will be
	  called mac80211_hwsim.  If unsure, say N.

config BACKPORT_USB_NET_RNDIS_WLAN
	tristate "Wireless RNDIS USB support"
	depends on !USB_NET_RNDIS_WLAN
	depends on USB
	depends on BACKPORT_CFG80211
	select BACKPORT_USB_NET_DRIVERS
	select BACKPORT_USB_USBNET
	select BACKPORT_USB_NET_CDCETHER
	select BACKPORT_USB_NET_RNDIS_HOST
	---help---
	  This is a driver for wireless RNDIS devices.
	  These are USB based adapters found in devices such as:

	  Buffalo WLI-U2-KG125S
	  U.S. Robotics USR5421
	  Belkin F5D7051
	  Linksys WUSB54GSv2
	  Linksys WUSB54GSC
	  Asus WL169gE
	  Eminent EM4045
	  BT Voyager 1055
	  Linksys WUSB54GSv1
	  U.S. Robotics USR5420
	  BUFFALO WLI-USB-G54

	  All of these devices are based on Broadcom 4320 chip which is the
	  only wireless RNDIS chip known to date.

	  If you choose to build a module, it'll be called rndis_wlan.

endif # BACKPORT_WLAN
```

## backports/drivers/net/wireless/admtek/Kconfig
```kconfig
config BACKPORT_WLAN_VENDOR_ADMTEK
	bool "ADMtek devices"
	depends on !WLAN_VENDOR_ADMTEK
	default y
	---help---
	  If you have a wireless card belonging to this class, say Y.

	  Note that the answer to this question doesn't directly affect the
	  kernel: saying N will just cause the configurator to skip all the
	  questions about these cards. If you say Y, you will be asked for
	  your specific card in the following questions.

if BACKPORT_WLAN_VENDOR_ADMTEK

config BACKPORT_ADM8211
	tristate "ADMtek ADM8211 support"
	depends on !ADM8211
	depends on BACKPORT_MAC80211 && PCI
	depends on CRC32
	depends on EEPROM_93CX6
	---help---
	  This driver is for BACKPORT_ADM8211A, BACKPORT_ADM8211B, and BACKPORT_ADM8211C based cards.
	  These are PCI/mini-PCI/Cardbus 802.11b chips found in cards such as:

	  Xterasys Cardbus XN-2411b
	  Blitz NetWave Point PC
	  TrendNet 221pc
	  Belkin F5D6001
	  SMC 2635W
	  Linksys WPC11 v1
	  Fiberline FL-WL-200X
	  3com Office Connect (3CRSHPW796)
	  Corega WLPCIB-11
	  SMC 2602W V2 EU
	  D-Link DWL-520 Revision C

	  However, some of these cards have been replaced with other chips
	  like the BACKPORT_RTL8180L (Xterasys Cardbus XN-2411b, Belkin F5D6001) or
	  the Ralink RT2400 (SMC2635W) without a model number change.

	  Thanks to Infineon-ADMtek for their support of this driver.

endif # BACKPORT_WLAN_VENDOR_ADMTEK
```

## backports/drivers/net/wireless/ath/ath10k/Kconfig
```kconfig
config BACKPORT_ATH10K
	tristate "Atheros 802.11ac wireless cards support"
	depends on !ATH10K
	depends on BACKPORT_MAC80211 && HAS_DMA
	select BACKPORT_ATH_COMMON
	depends on CRC32
	depends on WANT_DEV_COREDUMP
	select BACKPORT_ATH10K_CE
	---help---
	  This module adds support for wireless adapters based on
	  Atheros IEEE 802.11ac family of chipsets.

	  If you choose to build a module, it'll be called ath10k.

config BACKPORT_ATH10K_CE
	bool
	depends on !ATH10K_CE

config BACKPORT_ATH10K_PCI
	tristate "Atheros ath10k PCI support"
	depends on !ATH10K_PCI
	depends on BACKPORT_ATH10K && PCI
	---help---
	  This module adds support for PCIE bus

config BACKPORT_ATH10K_AHB
	bool "Atheros ath10k AHB support"
	depends on !ATH10K_AHB
	depends on BACKPORT_ATH10K_PCI && OF && RESET_CONTROLLER
	---help---
	  This module adds support for AHB bus

config BACKPORT_ATH10K_SDIO
	tristate "Atheros ath10k SDIO support (EXPERIMENTAL)"
	depends on !ATH10K_SDIO
	depends on BACKPORT_ATH10K && MMC
	---help---
	  This module adds experimental support for SDIO/MMC bus. Currently
	  work in progress and will not fully work.

config BACKPORT_ATH10K_USB
	tristate "Atheros ath10k USB support (EXPERIMENTAL)"
	depends on !ATH10K_USB
	depends on BACKPORT_ATH10K && USB
	---help---
	  This module adds experimental support for USB bus. Currently
	  work in progress and will not fully work.

config BACKPORT_ATH10K_SNOC
	tristate "Qualcomm ath10k SNOC support (EXPERIMENTAL)"
	depends on !ATH10K_SNOC
	depends on BACKPORT_ATH10K && ARCH_QCOM
	---help---
	  This module adds support for integrated WCN3990 chip connected
	  to system NOC(SNOC). Currently work in progress and will not
	  fully work.

config BACKPORT_ATH10K_DEBUG
	bool "Atheros ath10k debugging"
	depends on !ATH10K_DEBUG
	depends on BACKPORT_ATH10K
	---help---
	  Enables debug support

	  If unsure, say Y to make it easier to debug problems.

config BACKPORT_ATH10K_DEBUGFS
	bool "Atheros ath10k debugfs support"
	depends on !ATH10K_DEBUGFS
	depends on BACKPORT_ATH10K && DEBUG_FS
	---help---
	  Enabled debugfs support

	  If unsure, say Y to make it easier to debug problems.

config BACKPORT_ATH10K_SPECTRAL
	bool "Atheros ath10k spectral scan support"
	depends on !ATH10K_SPECTRAL
	depends on BACKPORT_ATH10K_DEBUGFS
	depends on RELAY
	default n
	---help---
	  Say Y to enable access to the FFT/spectral data via debugfs.

config BACKPORT_ATH10K_TRACING
	bool "Atheros ath10k tracing support"
	depends on !ATH10K_TRACING
	depends on BACKPORT_ATH10K
	depends on EVENT_TRACING
	---help---
	  Select this to ath10k use tracing infrastructure.

config BACKPORT_ATH10K_DFS_CERTIFIED
	bool "Atheros DFS support for certified platforms"
	depends on !ATH10K_DFS_CERTIFIED
	depends on ATH10K && BACKPORT_CFG80211_CERTIFICATION_ONUS
	default n
	---help---
	This option enables DFS support for initiating radiation on
	ath10k.
```

## backports/drivers/net/wireless/atmel/Kconfig
```kconfig
config BACKPORT_WLAN_VENDOR_ATMEL
	bool "Atmel devices"
	depends on !WLAN_VENDOR_ATMEL
	default y
	---help---
	  If you have a wireless card belonging to this class, say Y.

	  Note that the answer to this question doesn't directly affect the
	  kernel: saying N will just cause the configurator to skip all the
	  questions about these cards. If you say Y, you will be asked for
	  your specific card in the following questions.

if BACKPORT_WLAN_VENDOR_ATMEL

config BACKPORT_ATMEL
      tristate "Atmel at76c50x chipset  802.11b support"
	depends on !ATMEL
      depends on BACKPORT_CFG80211 && (PCI || PCMCIA)
      depends on WIRELESS_EXT
      depends on WEXT_PRIV
      depends on FW_LOADER
      depends on CRC32
       ---help---
        A driver 802.11b wireless cards based on the Atmel fast-vnet
        chips. This driver supports standard Linux wireless extensions.

        Many  cards based on this chipset do not have flash memory
        and need their firmware loaded at start-up. If yours is
        one of these, you will need to provide a firmware image
        to be loaded into the card by the driver. The Atmel
        firmware package can be downloaded from
        <http://www.thekelleys.org.uk/atmel>

config BACKPORT_PCI_ATMEL
      tristate "Atmel at76c506 PCI cards"
	depends on !PCI_ATMEL
      depends on BACKPORT_ATMEL && PCI
       ---help---
        Enable support for PCI and mini-PCI cards containing the
        Atmel at76c506 chip.

config BACKPORT_PCMCIA_ATMEL
	tristate "Atmel at76c502/at76c504 PCMCIA cards"
	depends on !PCMCIA_ATMEL
	depends on BACKPORT_ATMEL && PCMCIA
	depends on WIRELESS_EXT
	depends on FW_LOADER
	depends on CRC32
	---help---
	  Enable support for PCMCIA cards containing the
	  Atmel at76c502 and at76c504 chips.

config BACKPORT_AT76C50X_USB
        tristate "Atmel at76c503/at76c505/at76c505a USB cards"
	depends on !AT76C50X_USB
        depends on BACKPORT_MAC80211 && USB
        depends on FW_LOADER
        ---help---
          Enable support for USB Wireless devices using Atmel at76c503,
          at76c505 or at76c505a chips.

endif # BACKPORT_WLAN_VENDOR_ATMEL
```

## backports/drivers/net/wireless/broadcom/Kconfig
```kconfig
config BACKPORT_WLAN_VENDOR_BROADCOM
	bool "Broadcom devices"
	depends on !WLAN_VENDOR_BROADCOM
	default y
	---help---
	  If you have a wireless card belonging to this class, say Y.

	  Note that the answer to this question doesn't directly affect the
	  kernel: saying N will just cause the configurator to skip all the
	  questions about these cards. If you say Y, you will be asked for
	  your specific card in the following questions.

if BACKPORT_WLAN_VENDOR_BROADCOM

source "$BACKPORT_DIR/drivers/net/wireless/broadcom/b43/Kconfig"
source "$BACKPORT_DIR/drivers/net/wireless/broadcom/b43legacy/Kconfig"
source "$BACKPORT_DIR/drivers/net/wireless/broadcom/brcm80211/Kconfig"

endif # BACKPORT_WLAN_VENDOR_BROADCOM
```

## backports/drivers/net/wireless/intel/Kconfig
```kconfig
config BACKPORT_WLAN_VENDOR_INTEL
	bool "Intel devices"
	depends on !WLAN_VENDOR_INTEL
	default y
	---help---
	  If you have a wireless card belonging to this class, say Y.

	  Note that the answer to this question doesn't directly affect the
	  kernel: saying N will just cause the configurator to skip all the
	  questions about these cards. If you say Y, you will be asked for
	  your specific card in the following questions.

if BACKPORT_WLAN_VENDOR_INTEL

source "$BACKPORT_DIR/drivers/net/wireless/intel/ipw2x00/Kconfig"
source "$BACKPORT_DIR/drivers/net/wireless/intel/iwlegacy/Kconfig"
source "$BACKPORT_DIR/drivers/net/wireless/intel/iwlwifi/Kconfig"

endif # BACKPORT_WLAN_VENDOR_INTEL
```

## backports/drivers/net/wireless/intersil/Kconfig
```kconfig
config BACKPORT_WLAN_VENDOR_INTERSIL
	bool "Intersil devices"
	depends on !WLAN_VENDOR_INTERSIL
	default y
	---help---
	  If you have a wireless card belonging to this class, say Y.

	  Note that the answer to this question doesn't directly affect the
	  kernel: saying N will just cause the configurator to skip all the
	  questions about these cards. If you say Y, you will be asked for
	  your specific card in the following questions.

if BACKPORT_WLAN_VENDOR_INTERSIL

source "$BACKPORT_DIR/drivers/net/wireless/intersil/hostap/Kconfig"
source "$BACKPORT_DIR/drivers/net/wireless/intersil/orinoco/Kconfig"
source "$BACKPORT_DIR/drivers/net/wireless/intersil/p54/Kconfig"

config BACKPORT_PRISM54
	tristate 'Intersil Prism GT/Duette/Indigo PCI/Cardbus (DEPRECATED)'
	depends on !PRISM54
	depends on PCI
	depends on WIRELESS_EXT
	depends on WEXT_SPY
	depends on WEXT_PRIV
	depends on FW_LOADER
	---help---
	  This enables support for FullMAC PCI/Cardbus prism54 devices. This
	  driver is now deprecated in favor for the SoftMAC driver, p54pci.
	  p54pci supports FullMAC PCI/Cardbus devices as well.

	  For more information refer to the p54 wiki:

	  http://wireless.kernel.org/en/users/Drivers/p54

	  Note: You need a motherboard with DMA support to use any of these cards

	  When built as module you get the module prism54

endif # BACKPORT_WLAN_VENDOR_INTERSIL
```

## backports/drivers/net/wireless/marvell/Kconfig
```kconfig
config BACKPORT_WLAN_VENDOR_MARVELL
	bool "Marvell devices"
	depends on !WLAN_VENDOR_MARVELL
	default y
	---help---
	  If you have a wireless card belonging to this class, say Y.

	  Note that the answer to this question doesn't directly affect the
	  kernel: saying N will just cause the configurator to skip all the
	  questions about these cards. If you say Y, you will be asked for
	  your specific card in the following questions.

if BACKPORT_WLAN_VENDOR_MARVELL

source "$BACKPORT_DIR/drivers/net/wireless/marvell/libertas/Kconfig"
source "$BACKPORT_DIR/drivers/net/wireless/marvell/libertas_tf/Kconfig"
source "$BACKPORT_DIR/drivers/net/wireless/marvell/mwifiex/Kconfig"

config BACKPORT_MWL8K
	tristate "Marvell 88W8xxx PCI/PCIe Wireless support"
	depends on !MWL8K
	depends on BACKPORT_MAC80211 && PCI
	---help---
	  This driver supports Marvell TOPDOG 802.11 wireless cards.

	  To compile this driver as a module, choose M here: the module
	  will be called mwl8k.  If unsure, say N.

endif # BACKPORT_WLAN_VENDOR_MARVELL
```

## backports/drivers/net/wireless/marvell/libertas_tf/Kconfig
```kconfig
config BACKPORT_LIBERTAS_THINFIRM
	tristate "Marvell 8xxx Libertas WLAN driver support with thin firmware"
	depends on !LIBERTAS_THINFIRM
	depends on BACKPORT_MAC80211
	depends on FW_LOADER
	---help---
	  A library for Marvell Libertas 8xxx devices using thinfirm.

config BACKPORT_LIBERTAS_THINFIRM_DEBUG
	bool "Enable full debugging output in the Libertas thin firmware module."
	depends on !LIBERTAS_THINFIRM_DEBUG
	depends on BACKPORT_LIBERTAS_THINFIRM
	---help---
	  Debugging support.

config BACKPORT_LIBERTAS_THINFIRM_USB
	tristate "Marvell Libertas 8388 USB 802.11b/g cards with thin firmware"
	depends on !LIBERTAS_THINFIRM_USB
	depends on BACKPORT_LIBERTAS_THINFIRM && USB
	---help---
	  A driver for Marvell Libertas 8388 USB devices using thinfirm.
```
